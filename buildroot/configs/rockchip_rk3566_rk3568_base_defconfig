## buildroot/configs/rockchip_rk3568_uvc_defconfig
```kconfig
#include "audio.config"
#include "base.config"
#include "base_extra.config"
#include "bt.config"
#include "camera.config"
# // #include "camera_gst.config"
#include "debug.config"
#include "debug2.config"
# //#include "weston.config"
#include "gpu_dummy.config"
#include "network.config"
#include "ntfs.config"
#include "video_mpp.config"
#include "rk356x_arm64.config"
#include "test.config"
#include "wifi.config"
BR2_PACKAGE_RKWIFIBT_AP6398S=y
BR2_PACKAGE_RKWIFIBT_BTUART="ttyS8"
BR2_ROOTFS_OVERLAY="board/rockchip/rk356x/fs-overlay-uvc/"
BR2_PACKAGE_CAMERA_ENGINE_RKAIQ_FORCE_INSTALL_TO_ROOTFS=y
BR2_PACKAGE_RK_OEM=y
BR2_PACKAGE_RK_OEM_RESOURCE_DIR="$(TOPDIR)/../device/rockchip/oem/oem_uvcc"
BR2_PACKAGE_RKNPU2=y
BR2_PACKAGE_UVC_APP=y
BR2_PACKAGE_UAC_APP=y
BR2_PACKAGE_LIBIPCPROTOCOL=y
#BR2_PACKAGE_DBSERVER=y
BR2_PACKAGE_AISERVER=y
BR2_PACKAGE_AISERVER_SHM_SERVER=y
#BR2_PACKAGE_AISERVER_USE_ROCKX=y
BR2_PACKAGE_CALLFUNIPC=y
BR2_PACKAGE_DBSERVER=y
BR2_PACKAGE_ISP2_IPC=y
BR2_PACKAGE_ISP2_IPC_DBUS=y
BR2_PACKAGE_ISP2_IPC_DBSERVER=y
BR2_PACKAGE_DBUS_GLIB=y
BR2_PACKPAG_ISP2_IPC_FORCE_INSTALL_TO_ROOTFS=y
BR2_PACKAGE_AISERVER_RKVO=y
BR2_PACKAGE_ROCKIT_MPI=y
BR2_PACKAGE_GDB=y
BR2_PACKAGE_GDB_DEBUGGER=y
```

## buildroot/configs/rockchip_rk356x_libs_defconfig
```kconfig
#include "rk356x_arm64.config"
#include "audio.config"
#include "video_mpp.config"
#include "base.config"
#include "camera.config"
#include "gpu_dummy.config"
BR2_ROOTFS_POST_BUILD_SCRIPT="../device/rockchip/common/post-build.sh board/rockchip/rk356x/post-script-bsp.sh"
BR2_ROOTFS_POST_SCRIPT_ARGS="$(BR2_DEFCONFIG)"
BR2_PACKAGE_CAMERA_ENGINE_RKAIQ_IQFILE="ov5695_TongJu_CHT842-MD.xml"
BR2_PACKAGE_RKNPU=y
BR2_PACKAGE_RKNPU_USE_RKNN_API=y
BR2_PACKAGE_ROCKCHIP=y
BR2_PACKAGE_E2FSPROGS=y
BR2_PACKAGE_E2FSPROGS_RESIZE2FS=y
BR2_PACKAGE_BASH=y
```

## buildroot/configs/rockchip_rk356x_nand_recovery_defconfig
```kconfig
#include "base.config"
#include "base_extra.config"
#include "rk356x_arm64.config"
#include "ubifs.config"
#include "recovery_updateEngine.config"
BR2_ROOTFS_OVERLAY="board/rockchip/common/recovery-ubifs-overlay"
```

## buildroot/configs/rockchip_rk356x_nvr_spi_nand_defconfig
```kconfig
#include "base_nvr.config"
#include "audio.config"
#include "gpu_dummy.config"
#include "network_only_eth.config"
#include "video_mpp.config"
#include "rk356x_arm64.config"
#include "ubifs.config"
BR2_ROOTFS_OVERLAY="board/rockchip/rk356x/fs-overlay-nvr/"
```

## buildroot/configs/rockchip_rk356x_robot_defconfig
```kconfig
#include "base.config"
#include "base_extra.config"
#include "audio.config"
#include "network.config"
#include "video_mpp.config"
#include "rk356x_arm64.config"
#include "ubifs.config"
#include "test.config"
#include "camera.config"
#include "wifi.config"
#include "debug.config"
#include "bt.config"
BR2_TARGET_GENERIC_HOSTNAME="rk356x_robot"
BR2_TARGET_GENERIC_ISSUE="Welcome to RK356X Buildroot For Robot"
BR2_ROOTFS_OVERLAY:="board/rockchip/common/robot/base board/rockchip/common/wifi"
BR2_PACKAGE_RKWIFIBT_RTL8821CS=y
BR2_PACKAGE_RKWIFIBT_BTUART="ttyS1"
BR2_PACKAGE_LINUX_SERIAL_TEST=y
```

## buildroot/configs/rockchip_rk3588_defconfig
```kconfig
#include "audio.config"
#include "audio_gst.config"
#include "base.config"
#include "base_extra.config"
#include "benchmark.config"
#include "bt.config"
#include "camera.config"
#include "camera_gst.config"
#include "debug.config"
#include "debug2.config"
#include "weston.config"
#include "gpu.config"
#include "network.config"
#include "ntfs.config"
#include "video_mpp.config"
#include "video_gst.config"
#include "video_gst_rtsp.config"
#include "rk3588_arm64.config"
#include "test.config"
#include "wifi.config"

BR2_PACKAGE_RKWIFIBT_AP6275P=y
BR2_PACKAGE_RKWIFIBT_BTUART="ttyS8"
BR2_PACKAGE_RKNPU2=y
BR2_PACKAGE_PULSEAUDIO=y
BR2_PACKAGE_PULSEAUDIO_DAEMON=y
```

## buildroot/configs/rockchip_rk3588_ipc_defconfig
```kconfig
#include "audio.config"
#include "base.config"
#include "base_extra.config"
#include "debug.config"
#include "debug2.config"
#include "rk3588_arm64.config"
#include "test.config"
#include "video_mpp.config"
#include "gpu_dummy.config"
#include "wifi.config"
BR2_ROOTFS_OVERLAY="board/rockchip/rk3588/fs-overlay-ipc/"
BR2_PACKAGE_CAMERA_ENGINE_RKAIQ_IQFILE="isp21/ov5695_TongJu_CHT842-MD.json isp21/gc8034_RK-CMK-8M-2-v1_CK8401.json"
BR2_PACKAGE_CAMERA_ENGINE_RKAIQ_RKISP_DEMO=y
BR2_PACKAGE_GSTREAMER1_ROCKCHIP=y
BR2_PACKAGE_RKWIFIBT_AP6398S=y
BR2_PACKAGE_RKWIFIBT_BTUART="ttyS1"
BR2_PACKAGE_ROCKCHIP_MALI_HAS_OPENCL=y
BR2_PACKAGE_RECOVERY=y
BR2_PACKAGE_RECOVERY_UPDATEENGINEBIN=y
# BR2_PACKAGE_ROCKIT_TGI is not set
BR2_PACKAGE_ROCKIT_MPI=y
BR2_PACKAGE_IPCWEB_BACKEND=y
# BR2_PACKAGE_IPCWEB_BACKEND_JWT is not set
BR2_PACKAGE_IPCWEB_BACKEND_USE_RKIPC=y
BR2_PACKAGE_RKIPC=y
BR2_PACKAGE_RKIPC_RK3588=y
BR2_PACKAGE_GSTREAMER1=y
BR2_PACKAGE_GDB_DEBUGGER=y
BR2_PACKAGE_FREETYPE=y
BR2_PACKAGE_JPEG=y
BR2_PACKAGE_LIBV4L=y
BR2_PACKAGE_LIBV4L_UTILS=y
BR2_PACKAGE_DHCPCD=y
BR2_PACKAGE_FCGIWRAP=y
BR2_PACKAGE_NGINX=y
BR2_PACKAGE_NGINX_HTTP_FLV_LIVE=y
BR2_PACKAGE_WPA_SUPPLICANT=y
BR2_PACKAGE_WPA_SUPPLICANT_DEBUG_SYSLOG=y
BR2_PACKAGE_WPA_SUPPLICANT_CLI=y
BR2_PACKAGE_WPA_SUPPLICANT_WPA_CLIENT_SO=y
```

## buildroot/configs/rockchip_rk3588_nvr_defconfig
```kconfig
#include "base_nvr.config"
#include "audio.config"
#include "gpu_dummy.config"
#include "network_only_eth.config"
#include "video_mpp.config"
#include "rk356x_arm64.config"
#include "gcc_arm_10_aarch64.config"

BR2_ROOTFS_OVERLAY="board/rockchip/rk3588/fs-overlay-nvr/"
```

## buildroot/configs/rockchip_rk3588_ramboot_defconfig
```kconfig
#include "base/base.config"
#include "chips/rk3588_aarch64.config"
#include "tee_aarch64_v2.config"
# BR2_PACKAGE_ANDROID_TOOLS is reset to default
# BR2_PACKAGE_INPUT_EVENT_DAEMON is reset to default
BR2_PACKAGE_LUKSMETA=y
# BR2_PACKAGE_PM_UTILS is reset to default
# BR2_PACKAGE_UPDATE is reset to default
# BR2_PACKAGE_UTIL_LINUX_MOUNT is reset to default
# BR2_PACKAGE_VENDOR_STORAGE is reset to default
# BR2_ROOTFS_DEVICE_CREATION_DYNAMIC_EUDEV is reset to default
BR2_ROOTFS_OVERLAY+="board/rockchip/common/security-ramdisk-overlay/"
```

## buildroot/configs/rockchip_rv1108_cvr_defconfig
```kconfig
#include "rv1108_arm.config"
#include "rv1108_base.config"
#include "rv1108_cvr.config"
BR2_PACKAGE_IO=y
BR2_PACKAGE_DOSFSTOOLS=y
BR2_PACKAGE_DOSFSTOOLS_FATLABEL=y
BR2_PACKAGE_DOSFSTOOLS_FSCK_FAT=y
BR2_PACKAGE_DOSFSTOOLS_MKFS_FAT=y
BR2_PACKAGE_PARTED=y
BR2_PACKAGE_ANDROID_TOOLS=y
BR2_PACKAGE_ALSA_LIB=y
BR2_PACKAGE_RKMEDIA_ALSA_CAPTURE=y
```

## buildroot/configs/rockchip_rv1108_lock_defconfig
```kconfig
#include "rv1108_arm.config"
#include "rv1108_base.config"
#include "rv1108_lock.config"
#include "network.config"
#include "busybox_minimal.config"
BR2_PACKAGE_DROPBEAR=n
BR2_PACKAGE_ADK_MEDIA=y
BR2_PACKAGE_ADK_MEDIA_WAV_PLAYBACK=y
BR2_PACKAGE_RV1108_MINIGUI_ENABLE_FREETYPE=y
```

## buildroot/configs/rockchip_rv1126_battery_evb_defconfig
```kconfig
#include "tinyrootfs.config"
#include "arm_a7.config"
#include "gcc8.config"
#include "camera.config"
BR2_CCACHE=y
BR2_TARGET_GENERIC_HOSTNAME="RV1126_RV1109"
BR2_TARGET_GENERIC_ISSUE="Welcome to Battery EVB"
BR2_TARGET_GENERIC_GETTY_PORT="ttyFIQ0"
BR2_TARGET_GENERIC_GETTY_BAUDRATE_1500000=y
BR2_ROOTFS_OVERLAY="board/rockchip/rv1126_rv1109/fs-overlay-battery-evb"
BR2_PACKAGE_RV1126_RV1109=y
BR2_PACKAGE_CAMERA_ENGINE_RKAIQ_IQFILE="os04c10_DW-RV04C_2G2P650IR-F21.xml"
BR2_PACKAGE_CAMERA_ENGINE_RKAIQ_IQFILE_USE_BIN=y
BR2_PACKAGE_ROCKCHIP_MPP_ALLOCATOR_DRM=y
BR2_PACKAGE_RKWIFIBT=y
BR2_PACKAGE_RKWIFIBT_AP6203BM=y
BR2_PACKAGE_ROCKCHIP_RGA=y
BR2_PACKAGE_VENDOR_STORAGE_LIBRARY=y
BR2_PACKAGE_RKMEDIA=y
# BR2_PACKAGE_ROCKIT_TGI is not set
BR2_PACKAGE_ROCKIT_MPI=y
# BR2_PACKAGE_MINIGUI_SOFTWARE_SCALE is not set
BR2_PACKAGE_RKNPU_USE_MINI_DRIVER=y
BR2_PACKAGE_ROCKX=y
# BR2_PACKAGE_ROCKX_FACE_DETECTION is not set
# BR2_PACKAGE_ROCKX_FACE_LANDMARK is not set
# BR2_PACKAGE_ROCKX_POSE_BODY is not set
# BR2_PACKAGE_ROCKX_POSE_FINGER is not set
BR2_PACKAGE_COMMON_ALGORITHM=y
BR2_PACKAGE_COMMON_ALGORITHM_ANR=y
BR2_PACKAGE_THUNDERBOOT=y
BR2_PACKAGE_THUNDERBOOT_BATIPC_LAUNCH=y
BR2_THUNDERBOOT_INSTALL_MODULES="dw_mmc-rockchip.ko,rk_sdmmc_ops.ko,sdmmc_vendor_storage.ko,snd-soc-rk-codec-digital.ko,snd-soc-dummy-codec.ko,snd-soc-rockchip-pdm.ko,snd-soc-es7202.ko"
BR2_THUNDERBOOT_EMMC=y
BR2_THUNDERBOOT_SIMPLIFY_USB=y
BR2_THUNDERBOOT_USB_ADBD=y
BR2_PACKAGE_RKIPC=y
BR2_PACKAGE_RKIPC_RV1126_BATTERY_IPC=y
BR2_PACKAGE_ALSA_UTILS=y
BR2_PACKAGE_ALSA_UTILS_ALSACONF=y
# BR2_PACKAGE_ALSA_UTILS_ALSACTL is not set
BR2_PACKAGE_ALSA_UTILS_AMIXER=y
BR2_PACKAGE_ALSA_UTILS_APLAY=y
BR2_PACKAGE_E2FSPROGS=y
BR2_PACKAGE_E2FSPROGS_RESIZE2FS=y
# BR2_PACKAGE_ALSA_LIB_ALOAD is not set
# BR2_PACKAGE_ALSA_LIB_RAWMIDI is not set
# BR2_PACKAGE_ALSA_LIB_HWDEP is not set
# BR2_PACKAGE_ALSA_LIB_SEQ is not set
# BR2_PACKAGE_ALSA_LIB_ALISP is not set
# BR2_PACKAGE_ALSA_LIB_OLD_SYMBOLS is not set
BR2_PACKAGE_EXPAT=y
BR2_PACKAGE_LIBGLIB2=y
# BR2_PACKAGE_IFUPDOWN_SCRIPTS is not set
BR2_PACKAGE_WPA_SUPPLICANT=y
BR2_PACKAGE_WPA_SUPPLICANT_EAP=y
```

## buildroot/configs/rockchip_rv1126_evb_dualcam_tb_defconfig
```kconfig
#include "tinyrootfs.config"
#include "arm_a7.config"
#include "gcc8.config"
#include "camera.config"
BR2_CCACHE=y
BR2_TARGET_GENERIC_HOSTNAME="RV1126_RV1109"
BR2_TARGET_GENERIC_ISSUE="Welcome to RV1126 tinyrootfs"
BR2_TARGET_GENERIC_GETTY_PORT="ttyFIQ0"
BR2_TARGET_GENERIC_GETTY_BAUDRATE_1500000=y
BR2_ROOTFS_OVERLAY="board/rockchip/rv1126_rv1109/fs-overlay-evb-tb"
BR2_PACKAGE_RV1126_RV1109=y
BR2_PACKAGE_CAMERA_ENGINE_RKAIQ_IQFILE="ov2718_YT-RV1109-3-V1_M43-4IR-2MP-F2.xml gc2053_YT-RV1109-2-V1_40IR-2MP-F20.xml"
BR2_PACKAGE_CAMERA_ENGINE_RKAIQ_IQFILE_USE_BIN=y
BR2_PACKAGE_RKMEDIA=y
BR2_PACKAGE_RKMEDIA_V4L2_CAPTURE=y
BR2_PACKAGE_RKMEDIA_USE_AIQ=y
BR2_PACKAGE_DRM_DISPLAY_OUTPUT=y
BR2_PACKAGE_RKMEDIA_RKRGA=y
BR2_PACKAGE_RKMEDIA_EXAMPLES=y
BR2_PACKAGE_THUNDERBOOT=y
BR2_THUNDERBOOT_SIMPLIFY_USB=y
BR2_THUNDERBOOT_USB_ADBD=y
BR2_PACKAGE_LIBDRM_INSTALL_TESTS=y
BR2_PACKAGE_CJSON=y
BR2_PACKAGE_EXPAT=y
BR2_PACKAGE_JSON_C=y
BR2_PACKAGE_LIBGLIB2=y
# BR2_PACKAGE_IFUPDOWN_SCRIPTS is not set
```

## buildroot/configs/rockchip_rv1126_evb_spi_nor_tb_defconfig
```kconfig
#include "tinyrootfs.config"
#include "arm_a7.config"
#include "gcc8.config"
#include "camera.config"
BR2_CCACHE=y
BR2_TARGET_GENERIC_HOSTNAME="RV1126_RV1109"
BR2_TARGET_GENERIC_ISSUE="Welcome to RV1126 tinyrootfs"
BR2_TARGET_GENERIC_GETTY_PORT="ttyFIQ0"
BR2_TARGET_GENERIC_GETTY_BAUDRATE_1500000=y
BR2_ROOTFS_OVERLAY="board/rockchip/rv1126_rv1109/fs-overlay-evb-tb"
BR2_PACKAGE_RV1126_RV1109=y
BR2_PACKAGE_CAMERA_ENGINE_RKAIQ_IQFILE="os04a10_CMK-OT1607-FV1_M12-40IRC-4MP-F16.xml"
BR2_PACKAGE_CAMERA_ENGINE_RKAIQ_IQFILE_USE_BIN=y
BR2_PACKAGE_RKMEDIA_V4L2_CAPTURE=y
BR2_PACKAGE_RKMEDIA_USE_AIQ=y
BR2_PACKAGE_DRM_DISPLAY_OUTPUT=y
BR2_PACKAGE_RKMEDIA_MPP=y
# BR2_PACKAGE_RKMEDIA_MPP_DECODER is not set
BR2_PACKAGE_RKMEDIA_ALSA=y
BR2_PACKAGE_RKMEDIA_ALSA_PLAYBACK=y
BR2_PACKAGE_RKMEDIA_ALSA_CAPTURE=y
BR2_PACKAGE_RKMEDIA_AUDIO_ALGORITHM=y
BR2_PACKAGE_RKMEDIA_AUDIO_CODEC=y
BR2_PACKAGE_RKMEDIA_AUDIO_ENCODER=y
BR2_PACKAGE_RKMEDIA_AUDIO_DECODER=y
BR2_PACKAGE_RKMEDIA_RKRGA=y
BR2_PACKAGE_RKMEDIA_LIVE555=y
BR2_PACKAGE_RKMEDIA_RTSP_SERVER=y
BR2_PACKAGE_RKMEDIA_RTSP_SERVER_H264=y
# BR2_PACKAGE_MINIGUI_SOFTWARE_SCALE is not set
BR2_PACKAGE_MEDIASERVER=y
BR2_PACKAGE_MEDIASERVE_CONFIG="evb_tb.conf"
# BR2_PACKAGE_MEDIASERVE_DBUS is not set
BR2_PACKAGE_MEDIASERVE_LINKAPI=y
# BR2_PACKAGE_MEDIASERVE_MINILOGGER is not set
BR2_PACKAGE_MEDIASERVE_TB=y
BR2_PACKAGE_ISP2_IPC=y
BR2_PACKAGE_THUNDERBOOT=y
BR2_THUNDERBOOT_ETH=y
BR2_THUNDERBOOT_SOUND=y
BR2_THUNDERBOOT_SIMPLIFY_USB=y
BR2_THUNDERBOOT_USB_ADBD=y
BR2_PACKAGE_LIBDRM_INSTALL_TESTS=y
BR2_PACKAGE_EXPAT=y
BR2_PACKAGE_JSON_C=y
BR2_PACKAGE_LIBGLIB2=y
# BR2_PACKAGE_IFUPDOWN_SCRIPTS is not set
```

## buildroot/configs/rockchip_rv1126_robot_defconfig
```kconfig
#include "base.config"
#include "base_extra.config"
#include "debug.config"
#include "audio.config"
#include "wifi.config"
#include "network.config"
#include "video_mpp.config"
#include "rv1126_rv1109_arm.config"
#include "camera.config"
#include "updateEngine.config"
BR2_ROOTFS_OVERLAY="board/rockchip/rv1126_rv1109/fs-overlay-robot/"
BR2_PACKAGE_CAMERA_ENGINE_RKAIQ_IQFILE="os04a10_CMK-OT1607-FV1_M12-40IRC-4MP-F16.xml"
BR2_PACKAGE_RKWIFIBT_AP6256=y
BR2_PACKAGE_RKMEDIA=y
BR2_PACKAGE_RKMEDIA_V4L2_CAPTURE=y
BR2_PACKAGE_RKMEDIA_USE_AIQ=y
BR2_PACKAGE_RKMEDIA_MPP=y
BR2_PACKAGE_RKMEDIA_ALSA=y
BR2_PACKAGE_RKMEDIA_ALSA_PLAYBACK=y
BR2_PACKAGE_RKMEDIA_ALSA_CAPTURE=y
BR2_PACKAGE_RKMEDIA_AUDIO_ALGORITHM=y
BR2_PACKAGE_RKMEDIA_AUDIO_CODEC=y
BR2_PACKAGE_RKMEDIA_AUDIO_ENCODER=y
BR2_PACKAGE_RKMEDIA_AUDIO_DECODER=y
BR2_PACKAGE_RKMEDIA_RKRGA=y
BR2_PACKAGE_RKMEDIA_RKNN=y
BR2_PACKAGE_RKMEDIA_MOVE_DETECTION=y
BR2_PACKAGE_RKMEDIA_EXAMPLES=y
BR2_PACKAGE_RKMEDIA_LIVE555=y
BR2_PACKAGE_RKMEDIA_RTSP_SERVER=y
BR2_PACKAGE_RKMEDIA_RTSP_SERVER_H264=y
BR2_PACKAGE_RKMEDIA_RTSP_SERVER_H265=y
BR2_PACKAGE_ISP2_IPC=y
BR2_PACKAGE_JSON_C=y
BR2_PACKAGE_JSON_FOR_MODERN_CPP=y
BR2_TARGET_ROOTFS_EXT2_MKFS_OPTIONS="-O ^64bit,^huge_file"
```

## buildroot/configs/rockchip_rv1126_robot_recovery_defconfig
```kconfig
#include "base.config"
#include "base_extra.config"
#include "rv1126_rv1109_arm.config"
#include "recovery_updateEngine.config"
BR2_TARGET_ROOTFS_EXT2_MKFS_OPTIONS="-O ^64bit,^huge_file"
```

## buildroot/configs/rockchip_rv1126_rv1109_cvr_defconfig
```kconfig
#include "base.config"
#include "base_extra.config"
#include "debug.config"
#include "audio.config"
#include "wifi.config"
#include "network.config"
#include "bt.config"
#include "video_mpp.config"
#include "rv1126_rv1109_arm.config"
#include "camera.config"
#include "updateEngine.config"
BR2_TARGET_GENERIC_HOSTNAME="RV1126/RV1109"
BR2_TARGET_GENERIC_ISSUE="Welcome to RV1126/RV1109 CVR Demo Buildroot"
BR2_ROOTFS_OVERLAY="board/rockchip/rv1126_rv1109/fs-overlay-sysv/ board/rockchip/rv1126_rv1109/fs-overlay-cvr"
BR2_PACKAGE_CAMERA_ENGINE_RKAIQ_IQFILE="os04a10_CMK-OT1607-FV1_M12-40IRC-4MP-F16.xml"
BR2_PACKAGE_CAMERA_ENGINE_RKAIQ_RKISP_DEMO=y
BR2_PACKAGE_RKWIFIBT_AP6256=y
BR2_PACKAGE_RKWIFIBT_BTUART="ttyS0"
BR2_PACKAGE_RKMEDIA_V4L2_CAPTURE=y
BR2_PACKAGE_RKMEDIA_USE_AIQ=y
BR2_PACKAGE_DRM_DISPLAY_OUTPUT=y
BR2_PACKAGE_RKMEDIA_MPP=y
BR2_PACKAGE_RKMEDIA_ALSA=y
BR2_PACKAGE_RKMEDIA_ALSA_PLAYBACK=y
BR2_PACKAGE_RKMEDIA_ALSA_CAPTURE=y
BR2_PACKAGE_RKMEDIA_AUDIO_ALGORITHM=y
BR2_PACKAGE_RKMEDIA_AUDIO_CODEC=y
BR2_PACKAGE_RKMEDIA_AUDIO_ENCODER=y
BR2_PACKAGE_RKMEDIA_AUDIO_DECODER=y
BR2_PACKAGE_RKMEDIA_RKRGA=y
BR2_PACKAGE_RKMEDIA_MOVE_DETECTION=y
BR2_PACKAGE_RKMEDIA_OCCLUSION_DETECTION=y
BR2_PACKAGE_RKMEDIA_EXAMPLES=y
BR2_PACKAGE_RKMEDIA_LIVE555=y
BR2_PACKAGE_RKMEDIA_RTSP_SERVER=y
BR2_PACKAGE_RKMEDIA_RTSP_SERVER_H264=y
BR2_PACKAGE_RKMEDIA_RTSP_SERVER_H265=y
BR2_PACKAGE_RKADK=y
BR2_PACKAGE_RKADK_ROCKIT=y
# BR2_PACKAGE_MINIGUI_SOFTWARE_SCALE is not set
BR2_PACKAGE_RK_OEM=y
BR2_PACKAGE_RK_OEM_RESOURCE_DIR="$(TOPDIR)/../device/rockchip/oem/oem_cvr"
BR2_PACKAGE_MINILOGGER=y
BR2_PACKAGE_PCBA_ADB_TEST=y
BR2_PACKAGE_CVR_APP=y
BR2_PACKAGE_RKFSMK=y
BR2_PACKAGE_DBUS_GLIB=y
BR2_PACKAGE_EXIV2=y
BR2_PACKAGE_FREETYPE=y
BR2_PACKAGE_PIXMAN=y
BR2_PACKAGE_JSON_FOR_MODERN_CPP=y
BR2_PACKAGE_LIBCGICC=y
BR2_PACKAGE_AVAHI=y
BR2_PACKAGE_AVAHI_DAEMON=y
BR2_PACKAGE_AVAHI_LIBDNSSD_COMPATIBILITY=y
BR2_PACKAGE_CONNMAN=y
BR2_PACKAGE_CONNMAN_WIFI=y
BR2_PACKAGE_CONNMAN_LOOPBACK=y
BR2_PACKAGE_CONNMAN_CLIENT=y
BR2_PACKAGE_FCGIWRAP=y
BR2_PACKAGE_NGINX=y
BR2_PACKAGE_NGINX_HTTP_SSL_MODULE=y
BR2_PACKAGE_NGINX_DEBUG=y
BR2_PACKAGE_NGINX_HTTP_FLV_LIVE=y
# BR2_PACKAGE_NTP_NTPD is not set
```
