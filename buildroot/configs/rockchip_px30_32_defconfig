## buildroot/configs/rockchip_px30_32_defconfig
```kconfig
#include "rk3326_arm.config"
#include "audio_gst.config"
#include "base.config"
#include "base_extra.config"
#include "gpu.config"
#include "weston.config"
#include "video_mpp.config"
#include "video_gst.config"
#include "audio.config"
#include "camera.config"
#include "camera_gst.config"
#include "test.config"
#include "debug.config"
#include "benchmark.config"
#include "wifi.config"
#include "network.config"
#include "bt.config"
BR2_CCACHE=y
BR2_TARGET_GENERIC_HOSTNAME="px30_32"
BR2_TARGET_GENERIC_ISSUE="Welcome to PX30 Buildroot"
BR2_ROOTFS_OVERLAY="board/rockchip/px30/fs-overlay-32/"
BR2_PACKAGE_RKWIFIBT_AP6212A1=y
BR2_PACKAGE_RKWIFIBT_BTUART="ttyS1"
BR2_PACKAGE_DOSFSTOOLS_FATLABEL=y
BR2_PACKAGE_DOSFSTOOLS_FSCK_FAT=y
BR2_PACKAGE_FATRESIZE=y
BR2_PACKAGE_PARTED=y
BR2_PACKAGE_SLT_GPU_LIGHT=y
```

## buildroot/configs/rockchip_px30_64_opensource_defconfig
```kconfig
#include "rk3326_arm64.config"
#include "audio_gst.config"
#include "base.config"
#include "base_extra.config"
#include "gpu.config"
#include "weston.config"
#include "video_mpp.config"
#include "video_gst.config"
#include "audio.config"
#include "camera.config"
#include "camera_gst.config"
#include "test.config"
#include "debug.config"
#include "benchmark.config"
#include "wifi.config"
#include "network.config"
#include "bt.config"
BR2_TARGET_GENERIC_HOSTNAME="px30_64"
BR2_TARGET_GENERIC_ISSUE="Welcome to PX30 Buildroot"
BR2_ROOTFS_OVERLAY="board/rockchip/px30/fs-overlay-64/"
BR2_PACKAGE_RKWIFIBT_AP6212A1=y
BR2_PACKAGE_RKWIFIBT_BTUART="ttyS1"
BR2_PACKAGE_ROCKCHIP_MALI_WITHOUT_CL=y
BR2_PACKAGE_DOSFSTOOLS_FATLABEL=y
BR2_PACKAGE_DOSFSTOOLS_FSCK_FAT=y
BR2_PACKAGE_FATRESIZE=y
BR2_PACKAGE_PARTED=y
```

## buildroot/configs/rockchip_px30_robot32_defconfig
```kconfig
#include "rk3326_arm.config"
#include "base.config"
#include "base_extra.config"
#include "gpu.config"
#include "video_mpp.config"
#include "audio.config"
#include "camera.config"
#include "debug.config"
#include "wifi.config"
#include "network.config"
BR2_TARGET_GENERIC_HOSTNAME="PX30_robot"
BR2_TARGET_GENERIC_ISSUE="Welcome to PX30 Buildroot"
BR2_ROOTFS_OVERLAY="board/rockchip/px30/fs-overlay-32/"
BR2_PACKAGE_RKWIFIBT_AP6212A1=y
BR2_PACKAGE_RKWIFIBT_BTUART="ttyS1"
```

## buildroot/configs/rockchip_px3se_defconfig
```kconfig
#include "base.config"
#include "base_extra.config"
#include "gpu.config"
#include "weston.config"
#include "video_mpp.config"
#include "video_gst.config"
#include "audio.config"
#include "camera.config"
#include "camera_gst.config"
#include "test.config"
#include "debug.config"
#include "benchmark.config"
#include "wifi.config"
#include "network.config"
#include "bt.config"
#include "px3se_arm.config"
BR2_TARGET_GENERIC_HOSTNAME="px3se"
BR2_TARGET_GENERIC_ISSUE="Welcome to PX3se Buildroot"
BR2_PACKAGE_RKWIFIBT_RTL8723DS=y
```

## buildroot/configs/rockchip_rk1806_ficial_gate_defconfig
```kconfig
#include "rk1806_arm.config"
#include "base.config"
#include "base_extra.config"
#include "debug.config"
#include "audio.config"
#include "wifi.config"
#include "network.config"
#include "video_mpp.config"
#include "rk1806_webserver.config"
#include "camera.config"
BR2_TARGET_GENERIC_HOSTNAME="rk1806"
BR2_TARGET_GENERIC_ISSUE="Welcome to RK1806 Buildroot"

BR2_PACKAGE_RKWIFIBT_AP6212A1=y

BR2_PACKAGE_MINIGUI_ENABLE_RGA=y
BR2_PACKAGE_MINIGUI_ENABLE_FREETYPE=y
BR2_PACKAGE_MINIGUI_ENABLE_PNG=y
BR2_PACKAGE_MINIGUI_SOFTWARE_SCALE=n
BR2_PACKAGE_FICIAL_GATE=y
# BR2_PACKAGE_CAMERA_ENGINE_RKISP_3A_SERVICE is not set
BR2_PACKAGE_RKNPU_NOT_RUN_RKNN_SERVER=y

BR2_TOOLCHAIN_GLIBC_GCONV_LIBS_COPY=y
BR2_TOOLCHAIN_GLIBC_GCONV_LIBS_LIST="GBK"

BR2_PACKAGE_RKFACIAL=y
```

## buildroot/configs/rockchip_rk1806_thunder_boot_defconfig
```kconfig
#include "rk1806_arm.config"
#include "base.config"
#include "base_extra.config"
#include "debug.config"
#include "camera.config"
BR2_TARGET_GENERIC_HOSTNAME="rk1806"
BR2_TARGET_GENERIC_ISSUE="Welcome to RK1806 Buildroot"
BR2_PACKAGE_CAMERA_ENGINE_RKISP_3A_SPEEDUP_DIR_ETC=y
BR2_PACKAGE_CAMERA_ENGINE_RKISP_IQFILE="ps5268_default_default.xml"
BR2_PACKAGE_RKNPU=y
BR2_PACKAGE_RKNPU_NOT_RUN_RKNN_SERVER=y
BR2_PACKAGE_RKNPU_USE_MINI_DRIVER=y
BR2_PACKAGE_FACE_DETECT=y
```

## buildroot/configs/rockchip_rk1808-multi_defconfig
```kconfig
#include "base.config"
BR2_aarch64=y
BR2_cortex_a35=y
BR2_PACKAGE_RK1808=y
BR2_ROOTFS_OVERLAY="board/rockchip/rk1808_multi/fs-overlay-64/"
BR2_ROOTFS_DEVICE_CREATION_DYNAMIC_EUDEV=y
BR2_PACKAGE_PROCRANK_LINUX=y
BR2_PACKAGE_IO=y
BR2_PACKAGE_LIBUSB=y
BR2_PACKAGE_USBDEVICE=y
BR2_PACKAGE_RKNPU=y
BR2_PACKAGE_LIBXML2=y
BR2_PACKAGE_ABOOTIMG=y
BR2_PACKAGE_LIBV4L=y
BR2_PACKAGE_LIBV4L_UTILS=y
BR2_PACKAGE_ROCKCHIP_RGA=y
BR2_PACKAGE_LIBDRM_INSTALL_TESTS=y
```

## buildroot/configs/rockchip_rk1808_ai_camera_defconfig
```kconfig
#include "rk1808_arm64.config"
#include "base.config"
#include "base_extra.config"
#include "debug.config"
#include "video_mpp.config"
BR2_ROOTFS_OVERLAY="board/rockchip/rk1808/fs-overlay-64/"
BR2_TARGET_GENERIC_HOSTNAME="rk1808"
BR2_TARGET_GENERIC_ISSUE="Welcome to RK1808 Buildroot"
BR2_PACKAGE_ROCKCHIP_TEST=y
BR2_PACKAGE_RKNPU=y
BR2_PACKAGE_UVC_APP=y
BR2_PACKAGE_APP_DEMO=y
BR2_PACKAGE_APP_DEMO_NPU_UVC_CONNECTION=y
BR2_PACKAGE_ROCKX=y
BR2_PACKAGE_LIBV4L=y
```

## buildroot/configs/rockchip_rk1808_compute_stick_defconfig
```kconfig
#include "rk1808_arm64.config"
#include "base.config"
#include "base_extra.config"
#include "debug.config"
BR2_ROOTFS_OVERLAY="board/rockchip/rk1808/fs-overlay-64/"
BR2_TARGET_GENERIC_HOSTNAME="rk1808"
BR2_TARGET_GENERIC_ISSUE="Welcome to RK1808 Buildroot"
BR2_PACKAGE_ROCKCHIP_TEST=y
BR2_PACKAGE_RKNPU=y
BR2_PACKAGE_RKNPU_NTB=y
```

## buildroot/configs/rockchip_rk1808_defconfig
```kconfig
#include "rk1808_arm64.config"
#include "base.config"
#include "base_extra.config"
#include "debug.config"
#include "audio.config"
#include "wifi.config"
#include "network.config"
#include "bt.config"
#include "video_mpp.config"
#include "weston.config"
#include "video_mpp.config"
#include "video_gst.config"
#include "video_gst_rtsp.config"
#include "audio.config"
#include "audio_gst.config"
#include "camera.config"
#include "camera_gst.config"
BR2_ROOTFS_OVERLAY="board/rockchip/rk1808/fs-overlay-64/"
BR2_TARGET_GENERIC_HOSTNAME="rk1808"
BR2_TARGET_GENERIC_ISSUE="Welcome to RK1808 Buildroot"
BR2_PACKAGE_RKWIFIBT_AP6212A1=y
BR2_PACKAGE_ROCKCHIP_TEST=y
BR2_PACKAGE_LIBPNG=y
BR2_PACKAGE_LIBPNG_12=y
BR2_PACKAGE_MINIGUI=y
BR2_PACKAGE_MINIGUI_ENABLE_RGA=y
BR2_PACKAGE_MINIGUI_ENABLE_FREETYPE=y
BR2_PACKAGE_MINIGUI_ENABLE_PNG=y
BR2_PACKAGE_RKNPU=y
BR2_PACKAGE_RKNN_DEMO=y
BR2_PACKAGE_RKWIFIBT_BTUART="ttyS4"
BR2_PACKAGE_MESA3D=y
BR2_PACKAGE_MESA3D_GALLIUM_DRIVER_SWRAST=y
BR2_PACKAGE_MESA3D_OPENGL_EGL=y
BR2_PACKAGE_MESA3D_OPENGL_ES=y
BR2_PACKAGE_QCAMERA=y
BR2_PACKAGE_QLAUNCHER=y
BR2_PACKAGE_QFM=y
BR2_PACKAGE_QPLAYER=y
BR2_PACKAGE_QLAUNCHER=y
BR2_PACKAGE_LIBDRM=y
BR2_PACKAGE_LIBDRM_INSTALL_TESTS=y
BR2_PACKAGE_UVC_APP=y
BR2_PACKAGE_APP_DEMO=y
BR2_PACKAGE_APP_DEMO_NPU_UVC_CONNECTION=y
BR2_PACKAGE_ROCKX=y
BR2_PACKAGE_ROCKCHIP_UTILS=y
```

## buildroot/configs/rockchip_rk3036_defconfig
```kconfig
#include "base/base.config"
#include "chips/rk3036_arm.config"
#include "font/chinese.config"
#include "fs/ntfs.config"
#include "gpu/gpu.config"
#include "multimedia/audio.config"
#include "multimedia/gst/audio.config"
#include "multimedia/gst/rtsp.config"
#include "multimedia/gst/video.config"
#include "multimedia/mpp.config"
#include "wifibt/bt.config"
#include "wifibt/wireless.config"
#include "benchmark.config"
#include "debug.config"
#include "powermanager.config"
#include "weston.config"
# BR2_PREFER_ROCKCHIP_RGA is not set
BR2_PACKAGE_ANDROID_TOOLS=y
BR2_PACKAGE_ANDROID_TOOLS_STATIC=y

BR2_PACKAGE_BUSYBOX=y
BR2_PACKAGE_BUSYBOX_STATIC=y

BR2_PACKAGE_GDB=y
BR2_PACKAGE_GDB_STATIC=y
BR2_PACKAGE_GDB_DEBUGGER=y

BR2_PACKAGE_LIBDRM=y
BR2_PACKAGE_LIBDRM_STATIC=y

BR2_PACKAGE_LINUX_TOOLS_PERF=y
BR2_PACKAGE_LINUX_TOOLS_PERF_STATIC=y

BR2_PACKAGE_NCURSES=y
BR2_PACKAGE_NCURSES_STATIC=y

BR2_PACKAGE_PROCPS_NG=y
BR2_PACKAGE_PROCPS_NG_STATIC=y

BR2_PACKAGE_PROCRANK_LINUX=y
BR2_PACKAGE_PROCRANK_LINUX_STATIC=y

BR2_PACKAGE_RKTOOLKIT=y
BR2_PACKAGE_RKTOOLKIT_STATIC=y

BR2_PACKAGE_STRACE=y
BR2_PACKAGE_STRACE_STATIC=y
```

## buildroot/configs/rockchip_rk3126c_defconfig
```kconfig
#include "rk312x_arm.config"
#include "base.config"
#include "base_extra.config"
#include "gpu.config"
#include "weston.config"
#include "video_mpp.config"
#include "video_gst.config"
#include "audio.config"
#include "audio_gst.config"
#include "camera.config"
#include "camera_gst.config"
#include "wifi.config"
#include "network.config"
#include "ubifs.config"
BR2_TARGET_GENERIC_HOSTNAME="rk3126c"
BR2_TARGET_GENERIC_ISSUE="Welcome to RK3126C Buildroot"
BR2_PACKAGE_RKWIFIBT_RK915=y
BR2_PACKAGE_SBC=y
BR2_PACKAGE_EVTEST=y
BR2_PACKAGE_LIBBSD=y
BR2_PACKAGE_ROCKCHIP_TEST=y
# BR2_PACKAGE_NOTO_SANS_SC is not set
# BR2_PACKAGE_SOURCE_HAN_SANS_CN is not set
```

## buildroot/configs/rockchip_rk3126c_dpf_defconfig
```kconfig
#include "rk3126c_arm.config"
#include "base.config"
#include "base_extra.config"
#include "gpu.config"
#include "video_mpp.config"
#include "audio.config"
#include "wifi.config"
#include "network.config"
BR2_TARGET_GENERIC_HOSTNAME="rk3126c"
BR2_TARGET_GENERIC_ISSUE="Welcome to RK3126C Buildroot"
BR2_PACKAGE_RKWIFIBT_RTL8723DS=y
BR2_PACKAGE_MINIGUI=y
BR2_PACKAGE_MINIGUI_ENABLE_FREETYPE=y
BR2_PACKAGE_MINIGUI_ENABLE_PNG=y
BR2_PACKAGE_MINIGUI_DESKTOP=y
BR2_PACKAGE_RKSCRIPT=y
BR2_PACKAGE_DEVICEIO=y
BR2_PACKAGE_SDL2=y
BR2_PACKAGE_SDL2_KMSDRM=y
BR2_PACKAGE_SDL2_OPENGLES=y
BR2_PACKAGE_WAYLAND=y
BR2_PACKAGE_READLINE=y
BR2_PACKAGE_BLUEZ5_UTILS=y
BR2_PACKAGE_NTP=y
BR2_PACKAGE_NTP_NTPDATE=y
BR2_PACKAGE_NTP_NTPTIME=y
```

## buildroot/configs/rockchip_rk312x_defconfig
```kconfig
#include "base/base.config"
#include "chips/rk312x_arm.config"
#include "font/chinese.config"
#include "fs/vfat.config"
#include "gpu/gpu.config"
#include "multimedia/audio.config"
#include "multimedia/camera.config"
#include "multimedia/gst/audio.config"
#include "multimedia/gst/camera.config"
#include "multimedia/gst/video.config"
#include "multimedia/mpp.config"
#include "wifibt/bt.config"
#include "wifibt/wireless.config"
#include "weston.config"
# BR2_PACKAGE_ROCKCHIP_RGA is not set
```

## buildroot/configs/rockchip_rk3229_defconfig
```kconfig
#include "rk3229_arm.config"
#include "base.config"
#include "base_extra.config"
#include "gpu.config"
#include "weston.config"
#include "video_mpp.config"
#include "video_gst.config"
#include "audio.config"
#include "camera.config"
#include "test.config"
#include "debug.config"
#include "benchmark.config"
#include "wifi.config"
#include "network.config"
#include "bt.config"
BR2_ROOTFS_OVERLAY="board/rockchip/rk3229/fs-overlay/"
BR2_TARGET_GENERIC_HOSTNAME="rk3229"
BR2_TARGET_GENERIC_ISSUE="Welcome to RK3229 Buildroot"
BR2_PACKAGE_RKWIFIBT_COMPATIBLE=y
```

## buildroot/configs/rockchip_rk3288_defconfig
```kconfig
#include "rk3288_arm.config"
#include "base.config"
#include "base_extra.config"
#include "gpu.config"
#include "weston.config"
#include "video_mpp.config"
#include "video_gst.config"
#include "powermanager.config"
#include "audio.config"
#include "audio_gst.config"
#include "camera.config"
#include "camera_gst.config"
#include "test.config"
#include "debug.config"
#include "benchmark.config"
#include "wifi.config"
#include "network.config"
#include "bt.config"
#include "ntfs.config"
BR2_ROOTFS_OVERLAY="board/rockchip/rk3288/fs-overlay/"
BR2_TARGET_GENERIC_HOSTNAME="rk3288"
BR2_TARGET_GENERIC_ISSUE="Welcome to RK3288 Buildroot"
BR2_PACKAGE_RKWIFIBT_AP6335=y
BR2_PACKAGE_RKWIFIBT_BTUART="ttyS0"
```
