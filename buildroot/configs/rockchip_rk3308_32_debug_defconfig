## buildroot/configs/rockchip_rk3399pro_defconfig
```kconfig
#include "base/base.config"
#include "chips/rk3399pro_aarch64.config"
#include "font/chinese.config"
#include "fs/exfat.config"
#include "fs/ntfs.config"
#include "fs/vfat.config"
#include "gpu/gpu.config"
#include "multimedia/audio.config"
#include "multimedia/camera.config"
#include "multimedia/gst/audio.config"
#include "multimedia/gst/camera.config"
#include "multimedia/gst/rtsp.config"
#include "multimedia/gst/video.config"
#include "multimedia/mpp.config"
#include "wifibt/bt.config"
#include "wifibt/wireless.config"
#include "benchmark.config"
#include "debug.config"
#include "powermanager.config"
#include "rknn_demo.conf"
#include "test.config"
#include "weston.config"
BR2_PACKAGE_NPU_POWERCTRL=y
BR2_PACKAGE_RKNPU_FW=y
```
