## buildroot/configs/rockchip_rk3308_32_debug_defconfig
```kconfig
#include "busybox.config"

BR2_arm=y
BR2_cortex_a35=y
BR2_ARM_FPU_NEON_FP_ARMV8=y
BR2_ARM_INSTRUCTIONS_THUMB2=y
BR2_JLEVEL=24
BR2_TOOLCHAIN_BUILDROOT_VENDOR="rockchip"
BR2_TOOLCHAIN_BUILDROOT_GLIBC=y
BR2_KERNEL_HEADERS_4_4=y
BR2_TOOLCHAIN_BUILDROOT_CXX=y
BR2_GCC_ENABLE_OPENMP=y
BR2_PACKAGE_HOST_GDB=y
BR2_TARGET_GENERIC_HOSTNAME="rockchip"
BR2_TARGET_GENERIC_ISSUE="Welcome to Rockchip"
BR2_TARGET_GENERIC_PASSWD_SHA256=y
BR2_ROOTFS_DEVICE_CREATION_DYNAMIC_EUDEV=y
# BR2_TARGET_ENABLE_ROOT_LOGIN is not set
# BR2_TARGET_GENERIC_GETTY is not set
BR2_TARGET_TZ_INFO=y
BR2_TARGET_LOCALTIME="Asia/Shanghai"
BR2_ROOTFS_OVERLAY="board/rockchip/rk3308/fs-overlay"
BR2_PACKAGE_ROCKCHIP=y
BR2_PACKAGE_SOFTAPSERVER=y
BR2_PACKAGE_WIFIAUTOSETUP=y
BR2_PACKAGE_RKWIFIBT=y
BR2_PACKAGE_RKWIFIBT_RTL8189FS=y
BR2_PACKAGE_EQ_DRC_PROCESS=y
BR2_PACKAGE_ALSA_LADSPA=y
BR2_PACKAGE_ROCKCHIP_TEST=y
BR2_PACKAGE_UPDATE=y
BR2_PACKAGE_VENDOR_STORAGE=y
BR2_PACKAGE_RKSCRIPT=y
BR2_PACKAGE_DEVICEIO=y
BR2_PACKAGE_ALSA_UTILS=y
BR2_PACKAGE_ALSA_UTILS_ALSACONF=y
BR2_PACKAGE_ALSA_UTILS_ACONNECT=y
BR2_PACKAGE_ALSA_UTILS_AMIXER=y
BR2_PACKAGE_ALSA_UTILS_APLAY=y
BR2_PACKAGE_ALSA_UTILS_SPEAKER_TEST=y
BR2_PACKAGE_ALSA_PLUGINS=y
BR2_PACKAGE_GMRENDER_RESURRECT=y
# BR2_PACKAGE_GSTREAMER1_PARSE is not set
# BR2_PACKAGE_GSTREAMER1_TRACE is not set
# BR2_PACKAGE_GSTREAMER1_GST_DEBUG is not set
# BR2_PACKAGE_GSTREAMER1_INSTALL_TOOLS is not set
BR2_PACKAGE_GST1_PLUGINS_BASE_PLUGIN_APP=y
BR2_PACKAGE_GST1_PLUGINS_BASE_PLUGIN_AUDIORATE=y
# BR2_PACKAGE_GST1_PLUGINS_BASE_PLUGIN_VIDEOSCALE is not set
BR2_PACKAGE_GST1_PLUGINS_BASE_PLUGIN_ALSA=y
BR2_PACKAGE_GST1_PLUGINS_GOOD=y
BR2_PACKAGE_GST1_PLUGINS_GOOD_PLUGIN_AUDIOFX=y
BR2_PACKAGE_GST1_PLUGINS_GOOD_PLUGIN_AUDIOPARSERS=y
BR2_PACKAGE_GST1_PLUGINS_GOOD_PLUGIN_AUTODETECT=y
# BR2_PACKAGE_GST1_PLUGINS_GOOD_PLUGIN_AVI is not set
BR2_PACKAGE_GST1_PLUGINS_GOOD_PLUGIN_ICYDEMUX=y
BR2_PACKAGE_GST1_PLUGINS_GOOD_PLUGIN_ID3DEMUX=y
BR2_PACKAGE_GST1_PLUGINS_GOOD_PLUGIN_MPG123=y
BR2_PACKAGE_GST1_PLUGINS_GOOD_PLUGIN_PULSE=y
BR2_PACKAGE_GST1_PLUGINS_GOOD_PLUGIN_SOUPHTTPSRC=y
BR2_PACKAGE_GST1_PLUGINS_GOOD_PLUGIN_SPEEX=y
BR2_PACKAGE_GST1_PLUGINS_BAD=y
BR2_PACKAGE_GST1_PLUGINS_BAD_PLUGIN_ID3TAG=y
BR2_PACKAGE_GST1_PLUGINS_BAD_PLUGIN_MPEGDEMUX=y
BR2_PACKAGE_GST1_PLUGINS_BAD_PLUGIN_MPEGTSDEMUX=y
BR2_PACKAGE_GST1_PLUGINS_BAD_PLUGIN_FAAD=y
BR2_PACKAGE_GST1_PLUGINS_BAD_PLUGIN_HLS=y
BR2_PACKAGE_GST1_PLUGINS_UGLY=y
BR2_PACKAGE_GST1_PLUGINS_UGLY_PLUGIN_MPEG2DEC=y
BR2_PACKAGE_PULSEAUDIO_DAEMON=y
BR2_PACKAGE_STRACE=y
BR2_PACKAGE_E2FSPROGS=y
BR2_PACKAGE_E2FSPROGS_RESIZE2FS=y
BR2_PACKAGE_MMC_UTILS=y
BR2_PACKAGE_DBUS_GLIB=y
BR2_PACKAGE_EVTEST=y
BR2_PACKAGE_GPTFDISK=y
BR2_PACKAGE_GPTFDISK_SGDISK=y
BR2_PACKAGE_I2C_TOOLS=y
BR2_PACKAGE_INPUT_EVENT_DAEMON=y
BR2_PACKAGE_USBMOUNT=y
BR2_PACKAGE_LIBID3TAG=y
BR2_PACKAGE_LIBMAD=y
BR2_PACKAGE_LIBSAMPLERATE=y
BR2_PACKAGE_LIBSOXR=y
BR2_PACKAGE_PORTAUDIO=y
BR2_PACKAGE_SBC=y
BR2_PACKAGE_TINYALSA=y
BR2_PACKAGE_CA_CERTIFICATES=y
BR2_PACKAGE_GNUTLS=y
BR2_PACKAGE_LIBDRM=y
BR2_PACKAGE_LIBDRM_INSTALL_TESTS=y
BR2_PACKAGE_JSON_C=y
BR2_PACKAGE_GLIB_NETWORKING=y
BR2_PACKAGE_LIBCURL=y
BR2_PACKAGE_NGHTTP2=y
BR2_PACKAGE_PCRE_16=y
BR2_PACKAGE_BLUEZ5_UTILS=y
BR2_PACKAGE_DHCPCD=y
BR2_PACKAGE_DNSMASQ=y
# BR2_PACKAGE_DNSMASQ_TFTP is not set
BR2_PACKAGE_HOSTAPD=y
# BR2_PACKAGE_HOSTAPD_ACS is not set
BR2_PACKAGE_IPERF3=y
BR2_PACKAGE_IPTABLES=y
BR2_PACKAGE_IW=y
BR2_PACKAGE_LRZSZ=y
BR2_PACKAGE_NTP=y
BR2_PACKAGE_NTP_SNTP=y
BR2_PACKAGE_NTP_NTPDATE=y
BR2_PACKAGE_WIRELESS_TOOLS=y
BR2_PACKAGE_WIRELESS_TOOLS_LIB=y
BR2_PACKAGE_WPA_SUPPLICANT=y
BR2_PACKAGE_WPA_SUPPLICANT_AUTOSCAN=y
BR2_PACKAGE_WPA_SUPPLICANT_CLI=y
BR2_PACKAGE_WPA_SUPPLICANT_WPA_CLIENT_SO=y
BR2_PACKAGE_ANDROID_TOOLS=y
BR2_PACKAGE_UTIL_LINUX_RFKILL=y
BR2_TARGET_ROOTFS_EXT2=y
BR2_TARGET_ROOTFS_EXT2_2r0=y
BR2_TARGET_ROOTFS_EXT2_SIZE="128M"
BR2_TARGET_ROOTFS_SQUASHFS=y
# BR2_TARGET_ROOTFS_TAR is not set
BR2_PACKAGE_HOST_MKE2IMG=y
BR2_PACKAGE_HOST_VBOOT_UTILS=y
```

## buildroot/configs/rockchip_rk3308_32_dueros_defconfig
```kconfig
#include "busybox.config"

BR2_arm=y
BR2_cortex_a35=y
BR2_ARM_ENABLE_NEON=y
BR2_ARM_FPU_NEON_FP_ARMV8=y
BR2_ARM_INSTRUCTIONS_THUMB2=y
# BR2_COMPILER_PARANOID_UNSAFE_PATH is not set
BR2_TOOLCHAIN_BUILDROOT_VENDOR="rockchip"
BR2_TOOLCHAIN_BUILDROOT_GLIBC=y
BR2_KERNEL_HEADERS_4_4=y
BR2_TOOLCHAIN_BUILDROOT_CXX=y
BR2_GCC_ENABLE_LTO=y
BR2_GCC_ENABLE_OPENMP=y
BR2_PACKAGE_HOST_GDB=y
BR2_TARGET_GENERIC_HOSTNAME="rockchip"
BR2_TARGET_GENERIC_ISSUE="Welcome to Rockchip"
BR2_TARGET_GENERIC_PASSWD_SHA256=y
BR2_ROOTFS_DEVICE_CREATION_DYNAMIC_EUDEV=y
# BR2_TARGET_ENABLE_ROOT_LOGIN is not set
# BR2_TARGET_GENERIC_GETTY is not set
BR2_TARGET_TZ_INFO=y
BR2_TARGET_LOCALTIME="Asia/Shanghai"
BR2_ROOTFS_OVERLAY="board/rockchip/rk3308/fs-overlay"
BR2_PACKAGE_ROCKCHIP=y
BR2_PACKAGE_DUERCLIENTSDK=y
BR2_PACKAGE_SOFTAP=y
BR2_PACKAGE_RKWIFIBT=y
BR2_PACKAGE_EQ_DRC_PROCESS=y
BR2_PACKAGE_ALSA_LADSPA=y
BR2_PACKAGE_CYPRESS_BSA=y
BR2_PACKAGE_UPDATE=y
BR2_PACKAGE_RKSCRIPT=y
BR2_PACKAGE_ALSA_UTILS=y
BR2_PACKAGE_ALSA_UTILS_ALSACONF=y
BR2_PACKAGE_ALSA_UTILS_ACONNECT=y
BR2_PACKAGE_ALSA_UTILS_AMIXER=y
BR2_PACKAGE_ALSA_UTILS_APLAY=y
BR2_PACKAGE_ALSA_UTILS_SPEAKER_TEST=y
BR2_PACKAGE_ALSA_PLUGINS=y
BR2_PACKAGE_GDB=y
BR2_PACKAGE_E2FSPROGS=y
BR2_PACKAGE_E2FSPROGS_RESIZE2FS=y
BR2_PACKAGE_USBMOUNT=y
BR2_PACKAGE_TINYALSA=y
BR2_PACKAGE_CA_CERTIFICATES=y
BR2_PACKAGE_READLINE=y
BR2_PACKAGE_DHCPCD=y
BR2_PACKAGE_DNSMASQ=y
# BR2_PACKAGE_DNSMASQ_TFTP is not set
BR2_PACKAGE_HOSTAPD=y
# BR2_PACKAGE_HOSTAPD_ACS is not set
# BR2_PACKAGE_IFUPDOWN_SCRIPTS is not set
BR2_PACKAGE_IW=y
BR2_PACKAGE_LRZSZ=y
BR2_PACKAGE_NTP=y
BR2_PACKAGE_NTP_NTPDATE=y
BR2_PACKAGE_WPA_SUPPLICANT=y
BR2_PACKAGE_WPA_SUPPLICANT_AUTOSCAN=y
BR2_PACKAGE_WPA_SUPPLICANT_WPS=y
BR2_PACKAGE_WPA_SUPPLICANT_CLI=y
BR2_PACKAGE_WPA_SUPPLICANT_WPA_CLIENT_SO=y
BR2_PACKAGE_ANDROID_TOOLS=y
BR2_PACKAGE_UTIL_LINUX_RFKILL=y
BR2_TARGET_ROOTFS_EXT2=y
BR2_TARGET_ROOTFS_EXT2_2r0=y
BR2_TARGET_ROOTFS_EXT2_SIZE="128M"
BR2_TARGET_ROOTFS_SQUASHFS=y
# BR2_TARGET_ROOTFS_TAR is not set
BR2_PACKAGE_HOST_MKE2IMG=y
BR2_PACKAGE_HOST_SQUASHFS=y
BR2_PACKAGE_HOST_VBOOT_UTILS=y
```

## buildroot/configs/rockchip_rk3308_h_32_release_defconfig
```kconfig
#include "base/base.config"
#include "chips/rk3308_arm.config"
#include "fs/vfat.config"
#include "multimedia/audio.config"
#include "wifibt/wireless.config"
#include "test.config"
BR2_PACKAGE_COREUTILS=y
BR2_PACKAGE_EVTEST=y
BR2_PACKAGE_I2C_TOOLS=y
BR2_PACKAGE_IO=y
BR2_PACKAGE_IW=y
BR2_PACKAGE_STRACE=y
BR2_TARGET_GENERIC_HOSTNAME="rk3308h_32"
```

## buildroot/configs/rockchip_rk3308_mini_release_defconfig
```kconfig
#include "busybox.config"

BR2_aarch64=y
BR2_cortex_a35=y
BR2_ARM_FPU_VFPV4=y
BR2_JLEVEL=24
BR2_TOOLCHAIN_BUILDROOT_VENDOR="rockchip"
BR2_TOOLCHAIN_BUILDROOT_GLIBC=y
BR2_KERNEL_HEADERS_4_4=y
BR2_TOOLCHAIN_BUILDROOT_CXX=y
BR2_GCC_ENABLE_OPENMP=y
BR2_PACKAGE_HOST_GDB=y
BR2_TARGET_GENERIC_HOSTNAME="rockchip"
BR2_TARGET_GENERIC_ISSUE="Welcome to Rockchip"
BR2_TARGET_GENERIC_PASSWD_SHA256=y
BR2_ROOTFS_DEVICE_CREATION_DYNAMIC_MDEV=y
# BR2_TARGET_ENABLE_ROOT_LOGIN is not set
# BR2_TARGET_GENERIC_GETTY is not set
BR2_ROOTFS_OVERLAY="board/rockchip/rk3308/fs-overlay"
BR2_PACKAGE_ROCKCHIP=y
BR2_PACKAGE_EXPAT=y
BR2_PACKAGE_LIBEVENT=y
BR2_PACKAGE_LIBGLIB2=y
# BR2_PACKAGE_IFUPDOWN_SCRIPTS is not set
BR2_PACKAGE_HTOP=y
BR2_PACKAGE_PROCRANK_LINUX=y
BR2_PACKAGE_UTIL_LINUX_LIBSMARTCOLS=y
BR2_TARGET_ROOTFS_EXT2=y
BR2_TARGET_ROOTFS_EXT2_4=y
BR2_TARGET_ROOTFS_EXT2_SIZE="128M"
BR2_TARGET_ROOTFS_SQUASHFS=y
# BR2_TARGET_ROOTFS_TAR is not set
BR2_PACKAGE_HOST_MKE2IMG=y
BR2_PACKAGE_HOST_VBOOT_UTILS=y
```

## buildroot/configs/rockchip_rk3308_recovery_defconfig
```kconfig
#include "base/base.config"
#include "base/recovery.config"
#include "chips/rk3308_arm.config"
BR2_PACKAGE_RECOVERY_NO_UI=y
BR2_PACKAGE_RECOVERY_RECOVERYBIN=y
BR2_PACKAGE_RECOVERY_UPDATEENGINEBIN=y
BR2_PACKAGE_RECOVERY_USE_UPDATEENGINE=y
```

## buildroot/configs/rockchip_rk3308_robot32_defconfig
```kconfig
#include "rk3308_arm.config"
#include "audio.config"
#include "base.config"
#include "wifi.config"
#include "network.config"
BR2_CCACHE=y
# base tools
BR2_PACKAGE_COREUTILS=y
BR2_PACKAGE_RECOVERY_USE_UPDATEENGINE=y
BR2_PACKAGE_RECOVERY_UPDATEENGINEBIN=y
BR2_PACKAGE_RKSCRIPT=y
BR2_PACKAGE_VENDOR_STORAGE=y
# partition init depends on udev
BR2_ROOTFS_DEVICE_CREATION_DYNAMIC_EUDEV=y
# BR2_PACKAGE_EUDEV_ENABLE_HWDB is not set
# adb feature
BR2_PACKAGE_USBDEVICE=y
BR2_PACKAGE_ANDROID_TOOLS=y
# fsck fs each startup
BR2_PACKAGE_E2FSPROGS=y
BR2_PACKAGE_E2FSPROGS_FSCK=y
BR2_PACKAGE_E2FSPROGS_RESIZE2FS=y
# debug tools
BR2_PACKAGE_EVTEST=y
BR2_PACKAGE_IO=y
BR2_PACKAGE_IW=y
BR2_PACKAGE_STRACE=y
BR2_ROOTFS_OVERLAY:="board/rockchip/common/robot/base"
BR2_TARGET_GENERIC_HOSTNAME="rk3308_robot32"
BR2_TARGET_GENERIC_ISSUE="Welcome to RK3308 Buildroot For Robot aarch32"
```

## buildroot/configs/rockchip_rk3308_robot_recovery_defconfig
```kconfig
#include "rk3308_arm.config"
#include "recovery.config"
#include "kernel.config"
#include "busybox.config"
#  - use glibc as the basic libc
BR2_TOOLCHAIN_BUILDROOT_GLIBC=y
#  - we use buildroot toolcharn here, may change to custom toolchain in the feature
BR2_TOOLCHAIN_BUILDROOT_CXX=y
#  - the post build script will be excuted after all fs-overlay copyed
BR2_ROOTFS_POST_BUILD_SCRIPT="../device/rockchip/common/post-build.sh"
BR2_ROOTFS_POST_SCRIPT_ARGS="$(BR2_DEFCONFIG)"
#  - specify this is rockchip package
BR2_PACKAGE_ROCKCHIP=y
#  - we need to support various rootfs, cpio for ramdisk, ext2/4 for large system, squashfs for small system
BR2_TARGET_ROOTFS_CPIO=y
BR2_TARGET_ROOTFS_CPIO_GZIP=y
# extra base subset is the basic subset of all rootfs, ramdisk.
#  - we have to use eudev, because wayland need udev support
BR2_ROOTFS_DEVICE_CREATION_DYNAMIC_EUDEV=y
#  - vensor storage tool is used to r/w SN, wifi/bt/lan mac
BR2_PACKAGE_VENDOR_STORAGE=y
#  - usb device package used to init and config udc like adb and usb mass storage
BR2_PACKAGE_USBDEVICE=y
#  - we need adb as the basic tool
BR2_PACKAGE_ANDROID_TOOLS=y
BR2_PACKAGE_RKSCRIPT=y
BR2_PACKAGE_RECOVERY_NO_UI=y
```

## buildroot/configs/rockchip_rk3326_64_defconfig
```kconfig
#include "base/base.config"
#include "chips/rk3326_aarch64.config"
#include "font/chinese.config"
#include "fs/vfat.config"
#include "gpu/gpu.config"
#include "multimedia/audio.config"
#include "multimedia/camera.config"
#include "multimedia/gst/audio.config"
#include "multimedia/gst/camera.config"
#include "multimedia/gst/video.config"
#include "multimedia/mpp.config"
#include "wifibt/bt.config"
#include "wifibt/wireless.config"
#include "benchmark.config"
#include "debug.config"
#include "powermanager.config"
#include "test.config"
#include "weston.config"
BR2_PACKAGE_SLT_GPU_LIGHT=y
BR2_TARGET_GENERIC_HOSTNAME="rk3326_64"
```

## buildroot/configs/rockchip_rk3326_robot32_defconfig
```kconfig
#include "rk3326_arm.config"
#include "base.config"
#include "base_extra.config"
#include "gpu.config"
#include "video_mpp.config"
#include "audio.config"
#include "camera.config"
#include "debug.config"
#include "wifi.config"
#include "network.config"
BR2_TARGET_GENERIC_HOSTNAME="rk3326_robot"
BR2_TARGET_GENERIC_ISSUE="Welcome to RK3326 Buildroot"
BR2_ROOTFS_OVERLAY="board/rockchip/rk3326/fs-overlay-32/"
BR2_PACKAGE_RKWIFIBT_AP6212A1=y
BR2_PACKAGE_RKWIFIBT_BTUART="ttyS1"
```

## buildroot/configs/rockchip_rk3326_robot64_defconfig
```kconfig
#include "rk3326_arm64.config"
#include "audio.config"
#include "base.config"
#include "wifi.config"
#include "network.config"
BR2_CCACHE=y
BR2_PACKAGE_PARTINIT=y
BR2_PACKAGE_RKSCRIPT=y
# partition init depends on udev
BR2_ROOTFS_DEVICE_CREATION_DYNAMIC_EUDEV=y
# BR2_PACKAGE_EUDEV_ENABLE_HWDB is not set
# adb feature
BR2_PACKAGE_USBDEVICE=y
BR2_PACKAGE_ANDROID_TOOLS=y
# fsck fs each startup
BR2_PACKAGE_E2FSPROGS=y
BR2_PACKAGE_E2FSPROGS_FSCK=y
BR2_PACKAGE_E2FSPROGS_RESIZE2FS=y
# some tools
BR2_PACKAGE_COREUTILS=y
BR2_PACKAGE_VENDOR_STORAGE=y
BR2_PACKAGE_UPDATE=y
BR2_PACKAGE_EVTEST=y
BR2_PACKAGE_IO=y
BR2_PACKAGE_STRACE=y
BR2_PACKAGE_IW=y
# camera
BR2_PACKAGE_CAMERA_ENGINE_RKISP_IQFILE="ov5695_TongJu_CHT842-MD.xml"
# wifi type
BR2_PACKAGE_RKWIFIBT_AP6212A1=y
BR2_ROOTFS_OVERLAY:="board/rockchip/common/robot/base board/rockchip/common/robot/fs-overlay-64"
BR2_TARGET_GENERIC_HOSTNAME="rk3326_robot64"
BR2_TARGET_GENERIC_ISSUE="Welcome to RK3326 Buildroot For Robot"
```

## buildroot/configs/rockchip_rk3328_defconfig
```kconfig
#include "rk3328_arm64.config"
#include "base.config"
#include "base_extra.config"
#include "gpu.config"
#include "weston.config"
#include "video_mpp.config"
#include "video_gst.config"
#include "video_gst_rtsp.config"
#include "audio.config"
#include "audio_gst.config"
#include "camera.config"
#include "camera_gst.config"
#include "test.config"
#include "debug.config"
#include "benchmark.config"
#include "wifi.config"
#include "network.config"
#include "bt.config"
BR2_ROOTFS_OVERLAY="board/rockchip/rk3328/fs-overlay-64/"
BR2_TARGET_GENERIC_HOSTNAME="rk3328"
BR2_TARGET_GENERIC_ISSUE="Welcome to RK3328 Buildroot"
BR2_PACKAGE_RKWIFIBT_AP6356=y
BR2_PACKAGE_RKWIFIBT_BTUART="ttyS0"
BR2_PACKAGE_RKSCRIPT_DEFAULT_PCM="rockchiphdmi"
```

## buildroot/configs/rockchip_rk3328_recovery_defconfig
```kconfig
#include "rk3328_arm64.config"
#include "base.config"
#include "base_extra.config"
#include "recovery.config"
BR2_PACKAGE_RECOVERY_NO_UI=y
```

## buildroot/configs/rockchip_rk3399_defconfig
```kconfig
#include "rk3399_arm64.config"
#include "base.config"
#include "base_extra.config"
#include "gpu.config"
#include "weston.config"
#include "video_mpp.config"
#include "video_gst.config"
#include "video_gst_rtsp.config"
#include "powermanager.config"
#include "audio.config"
#include "audio_gst.config"
#include "camera.config"
#include "camera_gst.config"
#include "test.config"
#include "debug.config"
#include "benchmark.config"
#include "wifi.config"
#include "network.config"
#include "bt.config"
#include "ntfs.config"
BR2_TARGET_GENERIC_GETTY_PORT="ttyFIQ0"
BR2_TARGET_GENERIC_GETTY_BAUDRATE_1500000=y
BR2_ROOTFS_OVERLAY="board/rockchip/rk3399/fs-overlay-64/"
BR2_TARGET_GENERIC_HOSTNAME="rk3399"
BR2_TARGET_GENERIC_ISSUE="Welcome to RK3399 Buildroot"
BR2_PACKAGE_RKWIFIBT_AP6255=y
BR2_PACKAGE_RKWIFIBT_BTUART="ttyS0"
```

## buildroot/configs/rockchip_rk3399pro-npu-multi-cam_defconfig
```kconfig
#include "base.config"
#include "camera.config"
BR2_aarch64=y
BR2_cortex_a35=y
BR2_ROOTFS_OVERLAY="board/rockchip/rk3399pro_npu/fs-overlay-64/"
BR2_ROOTFS_DEVICE_CREATION_DYNAMIC_EUDEV=y
BR2_PACKAGE_ROCKCHIP_TEST=y
BR2_PACKAGE_RKNPU=y
BR2_PACKAGE_RKNPU_PCIE=y
BR2_PACKAGE_RKNPU_ACM=y
BR2_PACKAGE_LIBUSB=y
BR2_PACKAGE_LIBXML2=y
BR2_PACKAGE_PROCRANK_LINUX=y
BR2_PACKAGE_IO=y
BR2_PACKAGE_ROCKCHIP_TEST=y
BR2_PACKAGE_RKSCRIPT=y
BR2_PACKAGE_LIBDRM=y
BR2_PACKAGE_LIBDRM_INSTALL_TESTS=y
BR2_PACKAGE_N4=y
#  - input event daemon used to handle key event, ie. power on/off system
BR2_PACKAGE_INPUT_EVENT_DAEMON=y
BR2_PACKAGE_PM_UTILS=y
BR2_PACKAGE_LRZSZ=y
```

## buildroot/configs/rockchip_rk3399pro-npu_defconfig
```kconfig
#include "base/base.config"
#include "chips/rk3399pro_npu_aarch64.config"
# BR2_PACKAGE_E2FSPROGS is reset to default
BR2_PACKAGE_IO=y
BR2_PACKAGE_LIBUSB=y
BR2_PACKAGE_LIBXML2=y
# BR2_PACKAGE_PM_UTILS is reset to default
BR2_PACKAGE_PROCRANK_LINUX=y
BR2_PACKAGE_RKNPU=y
BR2_PACKAGE_RKNPU_NTB=y
BR2_PACKAGE_ROCKCHIP_TEST=y
# BR2_PACKAGE_UPDATE is reset to default
# BR2_PACKAGE_USBMOUNT is reset to default
# BR2_PACKAGE_UTIL_LINUX_MOUNT is reset to default
# BR2_PACKAGE_VENDOR_STORAGE is reset to default
```
