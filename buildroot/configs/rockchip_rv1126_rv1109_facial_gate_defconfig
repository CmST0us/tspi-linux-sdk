## buildroot/configs/rockchip_rv1126_rv1109_uvcc_defconfig
```kconfig
#include "base.config"
#include "debug.config"
#include "audio.config"
#include "video_mpp.config"
#include "rv1126_rv1109_arm.config"
#include "camera.config"
BR2_ROOTFS_DEVICE_CREATION_DYNAMIC_EUDEV=y
BR2_ROOTFS_OVERLAY="board/rockchip/rv1126_rv1109/fs-overlay-uvc/"
BR2_PACKAGE_CAMERA_ENGINE_RKAIQ_IQFILE="os04a10_CMK-OT1607-FV1_M12-40IRC-4MP-F16.xml gc4c33_PCORW0009A_40IRC-4M.xml imx378_A12N01B_48IRC-12M-F18.xml"
BR2_PACKAGE_UVC_APP=y
BR2_PACKAGE_UAC_APP=y
BR2_PACKAGE_LIBIPCPROTOCOL=y
BR2_PACKAGE_DBSERVER=y
BR2_PACKAGE_AISERVER=y
BR2_PACKAGE_AISERVER_SHM_SERVER=y
BR2_PACKAGE_AISERVER_USE_ROCKX=y
BR2_PACKAGE_RK_OEM=y
BR2_PACKAGE_RK_OEM_RESOURCE_DIR="$(TOPDIR)/../device/rockchip/oem/oem_uvcc"
BR2_PACKAGE_CALLFUNIPC=y
BR2_PACKAGE_ISP2_IPC=y
BR2_PACKAGE_ISP2_IPC_DBUS=y
BR2_PACKAGE_ISP2_IPC_DBSERVER=y
BR2_PACKAGE_SMART_DISPLAY_SERVICE=y
BR2_PACKAGE_GDB=y
BR2_PACKAGE_GDB_DEBUGGER=y
BR2_PACKAGE_E2FSPROGS=y
BR2_PACKAGE_E2FSPROGS_RESIZE2FS=y
BR2_PACKAGE_DBUS_GLIB=y
BR2_PACKAGE_ANDROID_TOOLS=y
#- input event daemon used to handle key event, ie. power on/off system
BR2_PACKAGE_INPUT_EVENT_DAEMON=y
```

## buildroot/configs/rockchip_rv1126_rv1109_uvcc_mult_defconfig
```kconfig
#include "base.config"
#include "debug.config"
#include "audio.config"
#include "video_mpp.config"
#include "rv1126_rv1109_arm.config"
#include "camera.config"
BR2_ROOTFS_DEVICE_CREATION_DYNAMIC_EUDEV=y
BR2_ROOTFS_OVERLAY="board/rockchip/rv1126_rv1109/fs-overlay-uvc-mult/"
BR2_PACKAGE_CAMERA_ENGINE_RKAIQ_IQFILE="os04a10_CMK-OT1607-FV1_M12-40IRC-4MP-F16.xml"
BR2_PACKAGE_RK_OEM=y
BR2_PACKAGE_RK_OEM_RESOURCE_DIR="$(TOPDIR)/../device/rockchip/oem/oem_empty"
BR2_PACKAGE_MULT_UVC_DEMO=y
BR2_PACKAGE_GDB=y
BR2_PACKAGE_GDB_DEBUGGER=y
BR2_PACKAGE_E2FSPROGS=y
BR2_PACKAGE_E2FSPROGS_RESIZE2FS=y
BR2_PACKAGE_ROCKCHIP_UTILS=y
BR2_PACKAGE_ANDROID_TOOLS=y
```

## buildroot/configs/rockchip_rv1126_rv1109_uvcc_spi_nand_defconfig
```kconfig
#include "base.config"
#include "audio.config"
#include "video_mpp.config"
#include "rv1126_rv1109_arm.config"
#include "ubifs.config"
#include "camera.config"
BR2_ROOTFS_OVERLAY="board/rockchip/rv1126_rv1109/fs-overlay-spi-nand-uvc/"
BR2_ROOTFS_POST_BUILD_SCRIPT="../device/rockchip/common/post-build.sh board/rockchip/rv1126_rv1109/pack-uvc-oem.sh"
BR2_ROOTFS_POST_SCRIPT_ARGS="$(BR2_DEFCONFIG)"
BR2_PACKAGE_CAMERA_ENGINE_RKAIQ_IQFILE="gc4c33_PCORW0009A_40IRC-4M.xml"
BR2_PACKAGE_UVC_APP=y
BR2_PACKAGE_UAC_APP=y
BR2_PACKAGE_RECOVERY=y
BR2_PACKAGE_RECOVERY_BOOTCONTROL=y
BR2_PACKAGE_RECOVERY_USE_UPDATEENGINE=y
BR2_PACKAGE_RECOVERY_UPDATEENGINEBIN=y
BR2_PACKAGE_IO=y
BR2_PACKAGE_RKNPU_USE_MINI_DRIVER=y
BR2_PACKAGE_LIBIPCPROTOCOL=y
BR2_PACKAGE_DBSERVER=y
BR2_PACKAGE_AISERVER=y
BR2_PACKAGE_AISERVER_SHM_SERVER=y
BR2_PACKAGE_AISERVER_USE_ROCKX=y
BR2_PACKAGE_RK_OEM=y
BR2_PACKAGE_RK_OEM_RESOURCE_DIR="$(TOPDIR)/../device/rockchip/oem/oem_uvcc"
BR2_PACKAGE_CALLFUNIPC=y
BR2_PACKAGE_ISP2_IPC=y
BR2_PACKAGE_ISP2_IPC_DBUS=y
BR2_PACKAGE_ISP2_IPC_DBSERVER=y
BR2_PACKAGE_SMART_DISPLAY_SERVICE=y
BR2_PACKAGE_DBUS_GLIB=y
BR2_PACKAGE_ANDROID_TOOLS=y
BR2_PACKAGE_PROCPS_NG=y
```

## buildroot/configs/rockchip_rv1126_rv1109_uvcc_spi_nor_defconfig
```kconfig
#include "arm_a7.config"
#include "gcc8.config"
#include "audio.config"
#include "video_mpp.config"
#include "camera.config"
#include "busybox_minimal.config"
BR2_TARGET_GENERIC_HOSTNAME="RV1126_RV1109"
BR2_TARGET_GENERIC_ISSUE="Welcome to RV1126 rootfs"
BR2_TARGET_GENERIC_GETTY_PORT="ttyFIQ0"
BR2_TARGET_GENERIC_GETTY_BAUDRATE_1500000=y
BR2_PACKAGE_RV1126_RV1109=y
#  - io tool used to read/write register and memory
BR2_PACKAGE_IO=y
BR2_PACKAGE_RKSCRIPT=y
#  - use glibc as the basic libc
BR2_TOOLCHAIN_BUILDROOT_GLIBC=y
#  - we use buildroot toolcharn here, may change to custom toolchain in the feature
BR2_TOOLCHAIN_BUILDROOT_CXX=y
#  - the basic fs-overlay, will copy to rootfs after all package built
BR2_ROOTFS_OVERLAY="board/rockchip/common/base"
#  - the post build script will be excuted after all fs-overlay copyed
BR2_ROOTFS_POST_BUILD_SCRIPT="../device/rockchip/common/post-build.sh board/rockchip/rv1126_rv1109/pack-oem.sh"
BR2_ROOTFS_POST_SCRIPT_ARGS="$(BR2_DEFCONFIG)"
#  - specify this is rockchip package
BR2_PACKAGE_ROCKCHIP=y

BR2_ROOTFS_OVERLAY="board/rockchip/rv1126_rv1109/fs-overlay-spi-nor-uvc/"
BR2_PACKAGE_LIBIPCPROTOCOL=y
BR2_PACKAGE_RK_OEM=y
BR2_PACKAGE_RK_OEM_RESOURCE_DIR="$(TOPDIR)/../device/rockchip/oem/oem_uvcc"
BR2_PACKAGE_CAMERA_ENGINE_RKAIQ=y
BR2_PACKAGE_CAMERA_ENGINE_RKAIQ_IQFILE="os04a10_CMK-OT1607-FV1_M12-40IRC-4MP-F16.xml"
#BR2_PACKAGE_DBUS_GLIB=y
BR2_PACKAGE_ROCKIT=y
BR2_PACKAGE_AISERVER=y
BR2_PACKAGE_AISERVER_SHM_SERVER=y
BR2_PACKAGE_UAC_APP=y
BR2_PACKAGE_UVC_APP=y
BR2_PACKAGE_CALLFUNIPC=y
BR2_PACKAGE_ISP2_IPC=y
BR2_PACKAGE_ISP2_IPC_DBUS=y
BR2_PACKAGE_ISP2_IPC_DBSERVER=y
BR2_PACKAGE_DBSERVER=y

#  - usb device package used to init and config udc like adb and usb mass storage
BR2_PACKAGE_USBDEVICE=y
#  - we need adb as the basic tool
BR2_PACKAGE_ANDROID_TOOLS=y
BR2_PACKAGE_MTD=y
# BR2_PACKAGE_MTD_MTD_DEBUG is not set
# BR2_PACKAGE_MTD_NANDDUMP is not set
# BR2_PACKAGE_MTD_NANDTEST is not set
# BR2_PACKAGE_MTD_NANDWRITE is not set
# BR2_PACKAGE_MTD_MTDINFO is not set
# BR2_PACKAGE_MTD_UBIATTACH is not set
# BR2_PACKAGE_MTD_UBICRC32 is not set
# BR2_PACKAGE_MTD_UBIDETACH is not set
# BR2_PACKAGE_MTD_UBIFORMAT is not set
# BR2_PACKAGE_MTD_UBIMKVOL is not set
# BR2_PACKAGE_MTD_UBINFO is not set
# BR2_PACKAGE_MTD_UBINIZE is not set
# BR2_PACKAGE_MTD_UBIRENAME is not set
# BR2_PACKAGE_MTD_UBIRMVOL is not set
# BR2_PACKAGE_MTD_UBIRSVOL is not set
# BR2_PACKAGE_MTD_UBIUPDATEVOL is not set
# BR2_PACKAGE_MTD_UBIBLOCK is not set
BR2_PACKAGE_DBUS_GLIB=y
# BR2_PACKAGE_ALSA_LIB_ALOAD is not set
# BR2_PACKAGE_ALSA_LIB_SEQ is not set
# BR2_PACKAGE_ALSA_LIB_ALISP is not set
# BR2_PACKAGE_ALSA_LIB_OLD_SYMBOLS is not set
BR2_TARGET_ROOTFS_JFFS2=y
BR2_TARGET_ROOTFS_JFFS2_FLASH_64=y
BR2_TARGET_ROOTFS_SQUASHFS=y
BR2_TARGET_ROOTFS_SQUASHFS4_XZ=y
# BR2_TARGET_ROOTFS_TAR is not set
```

## buildroot/configs/rockchip_rv1126_sllock_defconfig
```kconfig
#include "tinyrootfs.config"
#include "arm_a7.config"
#include "gcc8.config"
#include "camera.config"
BR2_CCACHE=y
BR2_TARGET_GENERIC_HOSTNAME="RV1126_RV1109"
BR2_TARGET_GENERIC_ISSUE="Welcome to Battery EVB with sllock"
BR2_TARGET_GENERIC_GETTY_PORT="ttyFIQ0"
BR2_TARGET_GENERIC_GETTY_BAUDRATE_1500000=y
BR2_ROOTFS_OVERLAY="board/rockchip/rv1126_rv1109/fs-overlay-sllock"
BR2_PACKAGE_RV1126_RV1109=y
BR2_PACKAGE_CAMERA_ENGINE_RKAIQ_IQFILE="os04c10_DW-RV04C_2G2P650IR-F21.xml"
BR2_PACKAGE_CAMERA_ENGINE_RKAIQ_IQFILE_USE_BIN=y
BR2_PACKAGE_RKWIFIBT=y
BR2_PACKAGE_RKWIFIBT_AWNB197=y
BR2_PACKAGE_VENDOR_STORAGE=y
BR2_PACKAGE_RKMEDIA_V4L2_CAPTURE=y
BR2_PACKAGE_RKMEDIA_USE_AIQ=y
BR2_PACKAGE_DRM_DISPLAY_OUTPUT=y
BR2_PACKAGE_RKMEDIA_MPP=y
# BR2_PACKAGE_RKMEDIA_MPP_DECODER is not set
BR2_PACKAGE_RKMEDIA_ALSA=y
BR2_PACKAGE_RKMEDIA_ALSA_PLAYBACK=y
BR2_PACKAGE_RKMEDIA_ALSA_CAPTURE=y
BR2_PACKAGE_RKMEDIA_AUDIO_ALGORITHM=y
BR2_PACKAGE_RKMEDIA_RKRGA=y
BR2_PACKAGE_RKMEDIA_EXAMPLES=y
BR2_PACKAGE_RKMEDIA_LIVE555=y
BR2_PACKAGE_RKMEDIA_RTSP_SERVER=y
BR2_PACKAGE_RKMEDIA_RTSP_SERVER_H264=y
# BR2_PACKAGE_MINIGUI_SOFTWARE_SCALE is not set
BR2_PACKAGE_MEDIASERVER=y
BR2_PACKAGE_MEDIASERVE_CONFIG="tb_rtsp-link.conf"
# BR2_PACKAGE_MEDIASERVE_DBUS is not set
BR2_PACKAGE_MEDIASERVE_LINKAPI=y
BR2_PACKAGE_MEDIASERVE_LINKAPI_TUYA=y
BR2_PACKAGE_MEDIASERVE_LINKAPI_VENDOR=y
# BR2_PACKAGE_MEDIASERVE_MINILOGGER is not set
BR2_PACKAGE_MEDIASERVE_TB=y
BR2_PACKAGE_MEDIASERVE_ENABLE_CY43438=y
BR2_PACKAGE_RK_OEM=y
BR2_PACKAGE_RK_OEM_RESOURCE_DIR="$(TOPDIR)/../device/rockchip/oem/oem_empty"
BR2_PACKAGE_RK_OEM_IMAGE_FILESYSTEM_TYPE="ext2"
BR2_PACKAGE_ISP2_IPC=y
BR2_PACKAGE_SL_LOCK=y
BR2_PACKAGE_THUNDERBOOT=y
BR2_PACKAGE_THUNDERBOOT_BATIPC_LAUNCH=y
BR2_THUNDERBOOT_INSTALL_MODULES="dw_mmc-rockchip.ko,snd-soc-es8311.ko,rk_sdmmc_ops.ko,sdmmc_vendor_storage.ko"
BR2_THUNDERBOOT_EMMC=y
BR2_THUNDERBOOT_SIMPLIFY_USB=y
BR2_THUNDERBOOT_USB_ADBD=y
BR2_PACKAGE_ALSA_UTILS=y
# BR2_PACKAGE_ALSA_UTILS_ALSACTL is not set
BR2_PACKAGE_ALSA_UTILS_AMIXER=y
BR2_PACKAGE_ALSA_UTILS_APLAY=y
BR2_PACKAGE_E2FSPROGS=y
BR2_PACKAGE_E2FSPROGS_RESIZE2FS=y
# BR2_PACKAGE_ALSA_LIB_ALOAD is not set
# BR2_PACKAGE_ALSA_LIB_RAWMIDI is not set
# BR2_PACKAGE_ALSA_LIB_HWDEP is not set
# BR2_PACKAGE_ALSA_LIB_SEQ is not set
# BR2_PACKAGE_ALSA_LIB_ALISP is not set
# BR2_PACKAGE_ALSA_LIB_OLD_SYMBOLS is not set
BR2_PACKAGE_EXPAT=y
BR2_PACKAGE_JSON_C=y
BR2_PACKAGE_LIBGLIB2=y
# BR2_PACKAGE_IFUPDOWN_SCRIPTS is not set
BR2_PACKAGE_WPA_SUPPLICANT=y
BR2_PACKAGE_WPA_SUPPLICANT_EAP=y
```

## buildroot/configs/rockchip_rv1126_snapshot_defconfig
```kconfig
#include "tinyrootfs.config"
#include "arm_a7.config"
#include "gcc8.config"
#include "camera.config"
BR2_CCACHE=y
BR2_TARGET_GENERIC_HOSTNAME="RV1126_RV1109"
BR2_TARGET_GENERIC_ISSUE="Welcome to Battery EVB"
BR2_TARGET_GENERIC_GETTY_PORT="ttyFIQ0"
BR2_TARGET_GENERIC_GETTY_BAUDRATE_1500000=y
BR2_ROOTFS_OVERLAY="board/rockchip/rv1126_rv1109/fs-overlay-snapshot"
BR2_PACKAGE_RV1126_RV1109=y
BR2_PACKAGE_CAMERA_ENGINE_RKAIQ_IQFILE="os04c10_DW-RV04C_2G2P650IR-F21.xml"
BR2_PACKAGE_CAMERA_ENGINE_RKAIQ_IQFILE_USE_BIN=y
BR2_PACKAGE_CAMERA_ENGINE_RKAIQ_FAKE_CAMERA_IQFILE="os04c10_DW-RV04C_2G2P650IR-F21.xml"
BR2_PACKAGE_RKMEDIA_V4L2_CAPTURE=y
BR2_PACKAGE_RKMEDIA_USE_AIQ=y
BR2_PACKAGE_DRM_DISPLAY_OUTPUT=y
BR2_PACKAGE_RKMEDIA_MPP=y
# BR2_PACKAGE_RKMEDIA_MPP_DECODER is not set
BR2_PACKAGE_RKMEDIA_RKRGA=y
# BR2_PACKAGE_MINIGUI_SOFTWARE_SCALE is not set
BR2_PACKAGE_THUNDERBOOT=y
BR2_THUNDERBOOT_INSTALL_MODULES="dw_mmc-rockchip.ko"
BR2_THUNDERBOOT_SIMPLIFY_USB=y
BR2_PACKAGE_THUNDERBOOT_USE_EUDEV=y
BR2_THUNDERBOOT_USB_ADBD=y
BR2_PACKAGE_RKIPC=y
BR2_PACKAGE_RKIPC_RV1126_SNAPSHOT=y
BR2_PACKAGE_LIBGLIB2=y
# BR2_PACKAGE_IFUPDOWN_SCRIPTS is not set
```

## buildroot/configs/rockchip_rv1126_tb_recovery_defconfig
```kconfig
#include "tinyrootfs.config"
#include "arm_a7.config"
#include "gcc8.config"
#include "camera.config"
BR2_CCACHE=y
BR2_TARGET_GENERIC_HOSTNAME="RV1126_RV1109"
BR2_TARGET_GENERIC_ISSUE="Welcome to Battery EVB"
BR2_TARGET_GENERIC_GETTY_PORT="ttyFIQ0"
BR2_TARGET_GENERIC_GETTY_BAUDRATE_1500000=y
BR2_ROOTFS_OVERLAY="board/rockchip/rv1126_rv1109/fs-overlay-tb-recovery/"
BR2_PACKAGE_RECOVERY=y
BR2_PACKAGE_RECOVERY_NO_UI=y
BR2_PACKAGE_RECOVERY_USE_UPDATEENGINE=y
BR2_PACKAGE_RECOVERY_RECOVERYBIN=y
BR2_PACKAGE_RECOVERY_UPDATEENGINEBIN=y
BR2_PACKAGE_THUNDERBOOT=y
BR2_THUNDERBOOT_INSTALL_MODULES="dw_mmc-rockchip.ko"
BR2_PACKAGE_THUNDERBOOT_USE_EUDEV=y
```

## buildroot/fs/ubi/Config.in
```kconfig
config BR2_TARGET_ROOTFS_UBI
	bool "ubi image containing an ubifs/squashfs root filesystem"
	help
	  Build an ubi image from the ubifs/squashfs one (with ubinize).

if BR2_TARGET_ROOTFS_UBI

choice
	prompt "UBI root filesystem"
	help
	  Select UBI root filesystem.

config BR2_TARGET_ROOTFS_UBI_UBIFS
	bool "ubifs"
	select BR2_TARGET_ROOTFS_UBIFS
	help
	  Use ubifs.

config BR2_TARGET_ROOTFS_UBI_SQUASHFS
	bool "squashfs"
	select BR2_TARGET_ROOTFS_SQUASHFS
	help
	  Use squashfs.

endchoice

config BR2_TARGET_ROOTFS_UBI_MINIOSIZE
	hex "minimum I/O unit size"
	default BR2_TARGET_ROOTFS_UBIFS_MINIOSIZE if BR2_TARGET_ROOTFS_UBI_UBIFS
	default 0x800
	help
	  Minimum I/O unit size. The value provided here is passed
	  to the -m/--min-io-size option of ubinize.

config BR2_TARGET_ROOTFS_UBI_PEBSIZE
	hex "physical eraseblock size"
	default 0x20000
	help
	  Tells ubinize the physical eraseblock (PEB) size of the
	  flash chip the ubi image is created for. The value provided
	  here is passed to the -p/--peb-size option of ubinize.

config BR2_TARGET_ROOTFS_UBI_SUBSIZE
	int "sub-page size"
	default 512
	help
	  Tells ubinize that the flash supports sub-pages and the
	  sub-page size. Use 0 if sub-pages are not supported on flash
	  chip.
	  The value provided here is passed to the -s/--sub-page-size
	  option of ubinize.

config BR2_TARGET_ROOTFS_UBI_USE_CUSTOM_CONFIG
	bool "Use custom config file"
	help
	  Select this option to use a custom ubinize configuration file,
	  rather than the default configuration used by Buildroot (which
	  defines a single dynamic volume marked as auto-resize).
	  Passing a custom ubinize configuration file allows you to
	  create several volumes, specify volume types, etc.

	  As a convenience, buildroot replaces the string
	  "BR2_ROOTFS_UBI_PATH" with the path to the built ubi file.
	  So the volume defined for the root filesystem can specify the
	  image path as:  image=BR2_ROOTFS_UBI_PATH

	  Buildroot also replaces the string "BINARIES_DIR" with the
	  value of $(BINARIES_DIR), so that it is possible to reference
	  other build artefacts (e.g. to include the kernel in a UBI
	  volume).

config BR2_TARGET_ROOTFS_UBI_CUSTOM_CONFIG_FILE
	string "Configuration file path"
	depends on BR2_TARGET_ROOTFS_UBI_USE_CUSTOM_CONFIG
	help
	  Path to the ubinize configuration file.

config BR2_TARGET_ROOTFS_UBI_OPTS
	string "Additional ubinize options"
	help
	  Any additional ubinize options you may want to include.

endif # BR2_TARGET_ROOTFS_UBI
```

## buildroot/package/abootimg/Config.in
```kconfig
config BR2_PACKAGE_ABOOTIMG
	bool "abootimg"
	depends on BR2_USE_MMU # util-linux/libblkid
	select BR2_PACKAGE_UTIL_LINUX
	select BR2_PACKAGE_UTIL_LINUX_LIBBLKID
	help
	  abootimg - manipulate Android Boot Images.

	  https://github.com/ggrandou/abootimg
```

## buildroot/package/aliyun-oss-c-sdk/Config.in
```kconfig
config BR2_PACKAGE_ALIYUN_OSS_C_SDK
	bool "aliyun-oss-c-sdk"
	help
	    https://github.com/aliyun/aliyun-oss-c-sdk
```

## buildroot/package/alsa-plugins/Config.in
```kconfig
comment "alsa-plugins needs a toolchain w/ threads, dynamic library"
	depends on BR2_USE_MMU # fork
	depends on !BR2_TOOLCHAIN_HAS_THREADS || BR2_STATIC_LIBS

menuconfig BR2_PACKAGE_ALSA_PLUGINS
	bool "alsa-plugins"
	depends on BR2_USE_MMU # fork
	depends on BR2_TOOLCHAIN_HAS_THREADS # alsa-lib
	depends on !BR2_STATIC_LIBS # uses dlfcn.h
	select BR2_PACKAGE_ALSA_LIB
	select BR2_PACKAGE_GETTEXT if BR2_NEEDS_GETTEXT_IF_LOCALE
	help
	  This package contains the command line utilities for the ALSA
	  project.

	  http://www.alsa-project.org/
```

## buildroot/package/aml/Config.in
```kconfig
config BR2_PACKAGE_AML
	bool "aml"
	depends on BR2_TOOLCHAIN_HAS_THREADS
	help
	  Another Main Loop.

	  https://github.com/any1/aml/
```

## buildroot/package/chromium-wayland/Config.in
```kconfig
config BR2_PACKAGE_CHROMIUM_WAYLAND
	bool "chromium-ozone-wayland"
	depends on (BR2_arm && BR2_GCC_TARGET_FLOAT_ABI = "hard") || BR2_aarch64
	depends on BR2_TOOLCHAIN_GCC_AT_LEAST_9
	depends on BR2_PACKAGE_CAIRO
	depends on BR2_PACKAGE_JPEG_TURBO
	depends on BR2_PACKAGE_JPEG_TURBO_JPEG6
	depends on BR2_PACKAGE_PANGO
	depends on BR2_PACKAGE_ROCKCHIP_MALI
	depends on BR2_PACKAGE_WAYLAND
	select BR2_PACKAGE_ALSA_LIB
	select BR2_PACKAGE_ALSA_LIB_VERSIONED
	select BR2_PACKAGE_BASH
	select BR2_PACKAGE_DBUS
	select BR2_PACKAGE_EXPAT
	select BR2_PACKAGE_FLAC
	select BR2_PACKAGE_FREETYPE
	select BR2_PACKAGE_LIBDRM
	select BR2_PACKAGE_LIBERATION
	select BR2_PACKAGE_LIBGLIB2
	select BR2_PACKAGE_LIBNSS
	select BR2_PACKAGE_LIBXKBCOMMON
	select BR2_PACKAGE_LIBXSLT
	select BR2_PACKAGE_LIBVPX
	select BR2_PACKAGE_OPUS
	select BR2_PACKAGE_WEBP
	select BR2_PACKAGE_WEBP_DEMUX
	select BR2_PACKAGE_WEBP_MUX
	select BR2_PACKAGE_AT_SPI2_ATK
	help
	  Chromium browser for wayland

	  Prebuilt from yocto's chromium-ozone-wayland:
	  https://github.com/JeffyCN/meta-rockchip/blob/master/dynamic-layers/recipes-browser/chromium/chromium-%25.bbappend
```
