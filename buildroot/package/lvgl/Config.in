## buildroot/package/lvgl/Config.in
```kconfig
# LittleVGL
source "package/lvgl/lvgl/Config.in"

if BR2_PACKAGE_LVGL
source "package/lvgl/lv_drivers/Config.in"
source "package/lvgl/lvgl_demo/Config.in"
endif
```

## buildroot/package/lvgl/lv_drivers/Config.in
```kconfig
config BR2_PACKAGE_LV_DRIVERS
	bool "lv-drivers"
	default n
	help
	  lv drivers The concrete implementation of hardware

	config BR2_PACKAGE_LV_DRIVERS_USE_RGA
	depends on BR2_PACKAGE_LV_DRIVERS
		bool "rga"                                                                                               
	default n
	help
		Enbale rga

choice
	prompt "LV drivers select"
	depends on BR2_PACKAGE_LV_DRIVERS

	config BR2_PACKAGE_LV_DRIVERS_USE_SDL_GPU
		bool "sdl"
		help
		  Enbale sdl renderer

	config BR2_PACKAGE_LV_DRIVERS_USE_DRM
		bool "drm"
		help
		  Enbale drm renderer

endchoice
```

## buildroot/package/lvgl/lvgl/Config.in
```kconfig
config BR2_PACKAGE_LVGL
	bool "Little VGL"
	default n
	help
	  Little VGL

config BR2_PACKAGE_LVGL_USE_SDL
	bool "Little VGL use SDL"
	default n
	depends on BR2_PACKAGE_LV_DRIVERS_USE_SDL_GPU
	depends on BR2_PACKAGE_SDL2
	depends on BR2_PACKAGE_LVGL
	help
	  Little VGL use SDL for graphic acceleration
```

## buildroot/package/lvgl/lvgl_demo/Config.in
```kconfig
config BR2_PACKAGE_LVGL_DEMO
	bool "LVGL demo"
	default n
	help
	  lvgl demo

choice
	prompt "LVGL demo select"
	depends on BR2_PACKAGE_LVGL_DEMO
	config BR2_PACKAGE_LVGL_DEMO_WIDGETS
		bool "lvgl demo widgets"
		help
		  Enbale lvgl demo widgets

	config BR2_PACKAGE_LVGL_DEMO_KEYPAD_AND_ENCODER
		bool "lvgl demo keypad and encoder"
		help
		  Enbale lvgl demo keypad and encoder

	config BR2_PACKAGE_LVGL_DEMO_BENCHMARK
		bool "lvgl demo benchmark"
		help
		  Enbale lvgl demo benchmark

	config BR2_PACKAGE_LVGL_DEMO_STRESS
		bool "lvgl demo stress"
		help
		  Enbale lvgl demo stress

	config BR2_PACKAGE_LVGL_DEMO_MUSIC
		bool "lvgl demo music"
		help
		  Enbale lvgl demo music

	config BR2_PACKAGE_LVGL_DEMO_CUSTOM
		bool "lvgl demo custom"
		help
		  Enbale lvgl demo custom

endchoice
```

## buildroot/package/mbw/Config.in
```kconfig
config BR2_PACKAGE_MBW
	bool "mbw"
	help
	  Memory Bandwidth Performance Test

	  https://github.com/raas/mbw
```

## buildroot/package/mynt-eye-d-sdk/Config.in
```kconfig
# MYNT-EYE-D-SDK

menu "MYNT-EYE-D-SDK"
	source "package/mynt-eye-d-sdk/mynt-eye-d-sdk/Config.in"
	source "package/mynt-eye-d-sdk/mynt-eye-d-sdk-samples/Config.in"
endmenu
```

## buildroot/package/mynt-eye-d-sdk/mynt-eye-d-sdk-samples/Config.in
```kconfig
config BR2_PACKAGE_MYNT_EYE_D_SDK_SAMPLES
	bool "MYNT EYE D SDK samples"
	depends on BR2_PACKAGE_MYNT_EYE_D_SDK
	default y
	help
	  MYNT EYE D SDK (MYNT® EYE Depth Camera) samples.

	  https://github.com/slightech/MYNT-EYE-D-SD
```

## buildroot/package/mynt-eye-d-sdk/mynt-eye-d-sdk/Config.in
```kconfig
config BR2_PACKAGE_MYNT_EYE_D_SDK
	bool "MYNT EYE D SDK"
	depends on BR2_aarch64 || (BR2_ARM_EABIHF && BR2_arm)
	select BR2_PACKAGE_OPENCV if BR2_PACKAGE_MYNT_EYE_D_SDK_SAMPLES
	select BR2_PACKAGE_OPENCV3 if !BR2_PACKAGE_MYNT_EYE_D_SDK_SAMPLES
	select BR2_PACKAGE_LIBUSB_COMPAT
	select BR2_PACKAGE_JPEG
	help
	  MYNT EYE D SDK (MYNT® EYE Depth Camera).

	  https://github.com/slightech/MYNT-EYE-D-SD
```

## buildroot/package/neatvnc/Config.in
```kconfig
config BR2_PACKAGE_NEATVNC
	bool "neatvnc"
	depends on BR2_TOOLCHAIN_HAS_THREADS
	select BR2_PACKAGE_AML
	select BR2_PACKAGE_PIXMAN
	select BR2_PACKAGE_ZLIB
	help
	  A liberally licensed VNC server library with a clean interface
	  Resources.

	  https://github.com/any1/neatvnc
```

## buildroot/package/nginx-http-flv-live/Config.in
```kconfig
config BR2_PACKAGE_NGINX_HTTP_FLV_LIVE
	bool "nginx-http-flv-live"
	depends on BR2_PACKAGE_NGINX_HTTP
	help
	  nginx http flv live module

	  https://github.com/winshining/nginx-http-flv-module
```

## buildroot/package/nginx-rtmp/Config.in
```kconfig
config BR2_PACKAGE_NGINX_RTMP
	bool "nginx-rtmp"
	depends on BR2_PACKAGE_NGINX_HTTP
	help
	  nginx rtmp module

	  https://github.com/arut/nginx-rtmp-module
```

## buildroot/package/noto/Config.in
```kconfig
# Noto Fonts

menu "Noto Fonts"
	source "package/noto/noto-sans-jp/Config.in"
	source "package/noto/noto-sans-kr/Config.in"
	source "package/noto/noto-sans-sc/Config.in"
	source "package/noto/noto-sans-tc/Config.in"
	source "package/noto/noto-serif-jp/Config.in"
	source "package/noto/noto-serif-kr/Config.in"
	source "package/noto/noto-serif-sc/Config.in"
	source "package/noto/noto-serif-tc/Config.in"
endmenu
```

## buildroot/package/noto/noto-sans-jp/Config.in
```kconfig
config BR2_PACKAGE_NOTO_SANS_JP
	bool "Noto Sans JP"
	help
	  Google Noto Sans CJK region-specific subset OTF font for Japanese.

	  https://www.google.com/get/noto/help/cjk/
```

## buildroot/package/noto/noto-sans-kr/Config.in
```kconfig
config BR2_PACKAGE_NOTO_SANS_KR
	bool "Noto Sans KR"
	help
	  Google Noto Sans CJK region-specific subset OTF font for Korean.

	  https://www.google.com/get/noto/help/cjk/
```

## buildroot/package/noto/noto-sans-sc/Config.in
```kconfig
config BR2_PACKAGE_NOTO_SANS_SC
	bool "Noto Sans SC"
	help
	  Google Noto Sans CJK region-specific subset OTF font for
	  Simplified Chinese.

	  https://www.google.com/get/noto/help/cjk/
```

## buildroot/package/noto/noto-sans-tc/Config.in
```kconfig
config BR2_PACKAGE_NOTO_SANS_TC
	bool "Noto Sans TC"
	help
	  Google Noto Sans CJK region-specific subset OTF font for
	  Traditional Chinese.

	  https://www.google.com/get/noto/help/cjk/
```

## buildroot/package/noto/noto-serif-jp/Config.in
```kconfig
config BR2_PACKAGE_NOTO_SERIF_JP
	bool "Noto Serif JP"
	help
	  Google Noto Serif CJK region-specific subset OTF font for Japanese.

	  https://www.google.com/get/noto/help/cjk/
```

## buildroot/package/noto/noto-serif-kr/Config.in
```kconfig
config BR2_PACKAGE_NOTO_SERIF_KR
	bool "Noto Serif KR"
	help
	  Google Noto Serif CJK region-specific subset OTF font for Korean.

	  https://www.google.com/get/noto/help/cjk/
```

## buildroot/package/noto/noto-serif-sc/Config.in
```kconfig
config BR2_PACKAGE_NOTO_SERIF_SC
	bool "Noto Serif SC"
	help
	  Google Noto Serif CJK region-specific subset OTF font for
	  Simplified Chinese.

	  https://www.google.com/get/noto/help/cjk/
```

## buildroot/package/noto/noto-serif-tc/Config.in
```kconfig
config BR2_PACKAGE_NOTO_SERIF_TC
	bool "Noto Serif TC"
	help
	  Google Noto Serif CJK region-specific subset OTF font for
	  Traditional Chinese.

	  https://www.google.com/get/noto/help/cjk/
```

## buildroot/package/ntfs-3g/Config.in.host
```kconfig
config BR2_PACKAGE_HOST_NTFS_3G
	bool "host ntfs-3g"
	help
	  The NTFS-3G driver is an open source, freely available
	  read/write NTFS driver for Linux, FreeBSD, Mac OS X, NetBSD,
	  and Haiku. It provides safe and fast handling of the Windows
	  XP, Windows Server 2003, Windows 2000 and Windows Vista file
	  systems. Most POSIX file system operations are supported, with
	  the exception of full file ownership and access right support.

	  http://www.ntfs-3g.org/
```

## buildroot/package/oem/Config.in
```kconfig
config BR2_PACKAGE_OEM
	bool "OEM splitted rootfs"
	depends on !BR2_PER_PACKAGE_DIRECTORIES
	help
	  Install specified packages to $(TARGET_DIR)/oem instead.

if BR2_PACKAGE_OEM

config BR2_PACKAGE_OEM_PACKAGES
	string "OEM packages"
	help
	  Packages which would be installed to the OEM splitted rootfs.

endif
```

## buildroot/package/opengl/libgbm/Config.in
```kconfig
config BR2_PACKAGE_HAS_LIBGBM
	bool

config BR2_PACKAGE_PROVIDES_LIBGBM
	string
	depends on BR2_PACKAGE_HAS_LIBGBM
```

## buildroot/package/pcl/Config.in
```kconfig
config BR2_PACKAGE_PCL
	bool "PCL"
	select BR2_PACKAGE_BOOST
	select BR2_PACKAGE_BOOST_DATE_TIME
	select BR2_PACKAGE_BOOST_FILESYSTEM
	select BR2_PACKAGE_BOOST_IOSTREAMS
	select BR2_PACKAGE_BOOST_SYSTEM
	select BR2_PACKAGE_EIGEN
	select BR2_PACKAGE_FLANN
	help
	  Point Cloud Library (PCL).

	  https://github.com/PointCloudLibrary/pcl
```

## buildroot/package/pcsx/Config.in
```kconfig
config BR2_PACKAGE_PCSX
        bool "pcsx"
	depends on BR2_PACKAGE_SDL
	depends on BR2_PACKAGE_LIBPNG
	depends on BR2_INSTALL_LIBSTDCPP
        help
          pcsx emulator core.

	  https://notaz.gp2x.de/pcsx_rearmed.php

comment "PCSX needs a toolchain w/ C++"
	depends on !BR2_INSTALL_LIBSTDCPP
```
