## buildroot/package/retroarch/libretro-snes9x/Config.in
```kconfig
config BR2_PACKAGE_LIBRETRO_SNES9X
        bool "libretro-snes9x"
	depends on BR2_PACKAGE_RETROARCH
	depends on BR2_INSTALL_LIBSTDCPP
        help
          libretro snes9x core.

	  http://www.libretro.com

comment "LIBRETRO_SNES9X needs a toolchain w/ C++"
	depends on !BR2_INSTALL_LIBSTDCPP
```

## buildroot/package/retroarch/libretro-snes9x2002/Config.in
```kconfig
config BR2_PACKAGE_LIBRETRO_SNES9X2002
        bool "libretro-snes9x2002"
	depends on BR2_PACKAGE_RETROARCH
	depends on BR2_INSTALL_LIBSTDCPP
        help
          libretro snes9x2002 core.

	  http://www.libretro.com

comment "LIBRETRO_SNES9X2002 needs a toolchain w/ C++"
	depends on !BR2_INSTALL_LIBSTDCPP
```

## buildroot/package/retroarch/libretro-snes9x2005/Config.in
```kconfig
config BR2_PACKAGE_LIBRETRO_SNES9X2005
        bool "libretro-snes9x2005"
	depends on BR2_PACKAGE_RETROARCH
	depends on BR2_INSTALL_LIBSTDCPP
        help
          libretro snes9x2005 core.

	  http://www.libretro.com

comment "LIBRETRO_SNES9X2005 needs a toolchain w/ C++"
	depends on !BR2_INSTALL_LIBSTDCPP
```

## buildroot/package/retroarch/libretro-stella/Config.in
```kconfig
config BR2_PACKAGE_LIBRETRO_STELLA
        bool "libretro-stella"
	depends on BR2_PACKAGE_RETROARCH
	depends on BR2_INSTALL_LIBSTDCPP
        help
          libretro stella core.

	  http://www.libretro.com

comment "LIBRETRO_STELLA needs a toolchain w/ C++"
	depends on !BR2_INSTALL_LIBSTDCPP
```

## buildroot/package/retroarch/libretro-tgbdual/Config.in
```kconfig
config BR2_PACKAGE_LIBRETRO_TGBDUAL
        bool "libretro-tgbdual"
	depends on BR2_PACKAGE_RETROARCH
	depends on BR2_INSTALL_LIBSTDCPP
        help
          libretro tgbdual core.

	  http://www.libretro.com

comment "LIBRETRO_TGBDUAL needs a toolchain w/ C++"
	depends on !BR2_INSTALL_LIBSTDCPP
```

## buildroot/package/retroarch/libretro-uae/Config.in
```kconfig
config BR2_PACKAGE_LIBRETRO_UAE
        bool "libretro-uae"
	depends on BR2_PACKAGE_RETROARCH
	depends on BR2_INSTALL_LIBSTDCPP
        help
          libretro uae core.

	  http://www.libretro.com

comment "LIBRETRO_UAE needs a toolchain w/ C++"
	depends on !BR2_INSTALL_LIBSTDCPP
```

## buildroot/package/retroarch/libretro-vbam/Config.in
```kconfig
config BR2_PACKAGE_LIBRETRO_VBAM
        bool "libretro-vbam"
	depends on BR2_PACKAGE_RETROARCH
	depends on BR2_INSTALL_LIBSTDCPP
        help
          libretro vbam core.

	  http://www.libretro.com

comment "LIBRETRO_VBAM needs a toolchain w/ C++"
	depends on !BR2_INSTALL_LIBSTDCPP
```

## buildroot/package/retroarch/libretro-vbanext/Config.in
```kconfig
config BR2_PACKAGE_LIBRETRO_VBANEXT
        bool "libretro-vbanext"
	depends on BR2_PACKAGE_RETROARCH
	depends on BR2_INSTALL_LIBSTDCPP
        help
          libretro vbanext core.

	  http://www.libretro.com

comment "LIBRETRO_VBANEXT needs a toolchain w/ C++"
	depends on !BR2_INSTALL_LIBSTDCPP
```

## buildroot/package/retroarch/libretro-virtualjaguar/Config.in
```kconfig
config BR2_PACKAGE_LIBRETRO_VIRTUALJAGUAR
        bool "libretro-virtualjaguar"
	depends on BR2_PACKAGE_RETROARCH
	depends on BR2_INSTALL_LIBSTDCPP
        help
          libretro virtualjaguar core.

	  http://www.libretro.com

comment "LIBRETRO_VIRTUALJAGUAR needs a toolchain w/ C++"
	depends on !BR2_INSTALL_LIBSTDCPP
```

## buildroot/package/retroarch/retroarch/Config.in
```kconfig
config BR2_PACKAGE_RETROARCH
	bool "retroarch"
	help
	  Cross-platform, sophisticated frontend for the libretro API.

	  http://www.libretro.com

comment "a frontend for emulators, game engines and media players"

if BR2_PACKAGE_RETROARCH

config BR2_PACKAGE_RETROARCH_RGUI
	bool "retroarch rgui"
	default y
	help
	  Support rgui menu.

config BR2_PACKAGE_RETROARCH_NETWORKING
	bool "retroarch networking"
	default y
	help
	  Support networking.

config BR2_PACKAGE_RETROARCH_HID
	bool "retroarch hid"
	default y
	select BR2_PACKAGE_LIBUSB
	help
	  Support hid inputs.

config BR2_PACKAGE_RETROARCH_ASSETS
        bool "retroarch assets"
        default y
        help
          Support assets GUI_icon.

endif
```

## buildroot/package/rockchip/CallFunIpc/Config.in
```kconfig
config BR2_PACKAGE_CALLFUNIPC
	bool "CallFunIpc"
	select BR2_PACKAGE_LIBGDBUS
	help
	  rockchip CallFunIpc

config BR2_PACKAGE_CALLFUNIPC_DEMO
	bool "CallFunIpc demo"
	depends on BR2_PACKAGE_CALLFUNIPC
```

## buildroot/package/rockchip/Config.in
```kconfig
menuconfig BR2_PACKAGE_ROCKCHIP
	bool "Rockchip Platform"

if BR2_PACKAGE_ROCKCHIP

config BR2_PACKAGE_ROCKCHIP_HAS_ISP1
	bool
	help
	  Has Rockchip ISP1

config BR2_PACKAGE_ROCKCHIP_HAS_ISP2
	bool
	help
	  Has Rockchip ISP2

config BR2_PACKAGE_ROCKCHIP_HAS_ISP3
	bool
	help
	  Has Rockchip ISP3

choice
	default BR2_PACKAGE_RK3588
	prompt "Rockchip SoC"

config BR2_PACKAGE_PX30
	bool "px30 chip"
	select BR2_PACKAGE_ROCKCHIP_HAS_ISP1
	help
	  Use rockchip's px30 chip

config BR2_PACKAGE_RK3036
	bool "rk3036 chip"
	help
	  Use rockchip's rk3036 chip

config BR2_PACKAGE_RK312X
	bool "rk312x chip"
	select BR2_PACKAGE_ROCKCHIP_HAS_ISP1
	help
	  Use rockchip's rk312x chip

config BR2_PACKAGE_RK3288
	bool "rk3288 chip"
	select BR2_PACKAGE_ROCKCHIP_HAS_ISP1
	help
	  Use rockchip's rk3288 chip

config BR2_PACKAGE_RK3308
	bool "rk3308 chip"
	help
	  Use rockchip's rk3308 chip

config BR2_PACKAGE_RK3326
	bool "rk3326 chip"
	select BR2_PACKAGE_ROCKCHIP_HAS_ISP1
	help
	  Use rockchip's rk3326 chip

config BR2_PACKAGE_RK3358
	bool "rk3358 chip"
	select BR2_PACKAGE_ROCKCHIP_HAS_ISP1
	help
	  Use rockchip's rk3358 chip

config BR2_PACKAGE_RK3399
	bool "rk3399 chip"
	select BR2_PACKAGE_ROCKCHIP_HAS_ISP1
	help
	  Use Rockchip's rk3399 SoC

config BR2_PACKAGE_RK3399PRO
	bool "rk3399pro chip"
	select BR2_PACKAGE_ROCKCHIP_HAS_ISP1
	help
	  Use Rockchip's rk3399pro SoC

config BR2_PACKAGE_RK3528
	bool "rk3528 chip"
	help
	  Use Rockchip's rk3528 SoC

config BR2_PACKAGE_RK3562
	bool "rk3562 chip"
	select BR2_PACKAGE_ROCKCHIP_HAS_ISP2
	help
	  Use Rockchip's rk3562 SoC

config BR2_PACKAGE_RK3566_RK3568
	bool "rk3566 or rk3568 chip"
	select BR2_PACKAGE_ROCKCHIP_HAS_ISP2
	help
	  Use Rockchip's rk3566 or rk3568 SoC

config BR2_PACKAGE_RK3588
	bool "rk3588"
	select BR2_PACKAGE_ROCKCHIP_HAS_ISP3
	help
	  Use Rockchip's rk3588 SoC

endchoice

# Camera Engine packages
config BR2_PACKAGE_CAMERA_ENGINE
	bool "Rockchip Camera Engine For ISP"
	depends on BR2_PACKAGE_ROCKCHIP_HAS_ISP1 || BR2_PACKAGE_ROCKCHIP_HAS_ISP2 || BR2_PACKAGE_ROCKCHIP_HAS_ISP3
	select BR2_PACKAGE_CAMERA_ENGINE_RKISP if BR2_PACKAGE_ROCKCHIP_HAS_ISP1
	select BR2_PACKAGE_CAMERA_ENGINE_RKAIQ if BR2_PACKAGE_ROCKCHIP_HAS_ISP2
	select BR2_PACKAGE_CAMERA_ENGINE_RKAIQ if BR2_PACKAGE_ROCKCHIP_HAS_ISP3
	help
	  Depend on Chip Type, there are different camera_engine packages.
	  Enable this config to choose camera_engine package by chip automatically.

menu "Rockchip BSP packages"
	source "package/rockchip/camera-engine-rkaiq/Config.in"
	source "package/rockchip/camera-engine-rkisp/Config.in"
	source "package/rockchip/gstreamer1-rockchip/Config.in"
	source "package/rockchip/libv4l-rkmpp/Config.in"
	source "package/rockchip/npu_powerctrl/Config.in"
	source "package/rockchip/npu_powerctrl_combine/Config.in"
	source "package/rockchip/n4/Config.in"
	source "package/rockchip/recovery/Config.in"
	source "package/rockchip/rknpu/Config.in"
	source "package/rockchip/rknpu2/Config.in"
	source "package/rockchip/rknpu-fw/Config.in"
	source "package/rockchip/rknn_demo/Config.in"
	source "package/rockchip/rkscript/Config.in"
	source "package/rockchip/rktoolkit/Config.in"
	source "package/rockchip/rkupdate/Config.in"
	source "package/rockchip/rkwifibt/Config.in"
	source "package/rockchip/rkwifibt-app/Config.in"
	source "package/rockchip/rockchip-alsa-config/Config.in"
	source "package/rockchip/rockchip-rga/Config.in"
	source "package/rockchip/rockchip-mali/Config.in"
	source "package/rockchip/rockchip-mali-nvr/Config.in"
	source "package/rockchip/rockchip-mpp/Config.in"
	source "package/rockchip/rockchip-test/Config.in"
	source "package/rockchip/rockit/Config.in"
	source "package/rockchip/tee-user-app/Config.in"
	source "package/rockchip/slt_gpu_light/Config.in"
endmenu

menu "Rockchip Qt demos"
	source "package/rockchip/apps/Config.in"
endmenu

endif
```

## buildroot/package/rockchip/LinuxAB/Config.in
```kconfig
config BR2_PACKAGE_LINUXAB
	bool "Rockchip LINUXAB for linux"
	select BR2_PACKAGE_LIBCURL
	help
	  Rockchip LINUXAB for linux.

if BR2_PACKAGE_LINUXAB
choice
    default BR2_PACKAGE_LINUXAB_SUCCESSFUL_BOOT
    prompt "Linux A/B bringup features."
config BR2_PACKAGE_LINUXAB_SUCCESSFUL_BOOT
    bool "successful_boot"
config BR2_PACKAGE_LINUXAB_RETRY
    bool "retry time"
endchoice
endif
```

## buildroot/package/rockchip/QFacialGate/Config.in
```kconfig
config BR2_PACKAGE_QFACIALGATE
	bool "QFacialGate"
	select BR2_PACKAGE_RKFACIAL
	select BR2_PACKAGE_QT5
	help
	  Rockchip QFacialGate application based on QT

if BR2_PACKAGE_QFACIALGATE
config BR2_PACKAGE_QFACIALGATE_TEST
	bool "build QFacialGate test"
	help
	  Build QFacialGate test
endif
```

## buildroot/package/rockchip/acs/Config.in
```kconfig
config BR2_PACKAGE_ACS
	bool "Amazon Common Software"
	help
	Amazon acs linux reference for smartspeaker
```

## buildroot/package/rockchip/address_sanitizer/Config.in
```kconfig
config BR2_PACKAGE_ADDRESS_SANITIZER
    bool "Address Sanitizer (ASan)"
    help
        AddressSanitizer (aka ASan) is a memory error detector for C/C++.
```

## buildroot/package/rockchip/aiserver/Config.in
```kconfig
menuconfig BR2_PACKAGE_AISERVER
    bool "rockchip aiserver"
    select BR2_PACKAGE_PROTOBUF
    select BR2_PACKAGE_ROCKIT
    select BR2_PACKAGE_DBUS
    select BR2_PACKAGE_DBUS_CPP
    select BR2_PACKAGE_LIBRKDB
    help
      rockchip aiserver

if BR2_PACKAGE_AISERVER

config BR2_PACKAGE_AISERVER_SANITIZER_DYNAMIC
    bool "enable aiserver sanitizer tools with dynamic linker"
    select BR2_PACKAGE_ADDRESS_SANITIZER
    help
      enable aiserver debug on sanitizer with dynamic linker.

config BR2_PACKAGE_AISERVER_SANITIZER_STATIC
    bool "enable aiserver sanitizer tools with static linker"
    select BR2_PACKAGE_ADDRESS_SANITIZER
    help
      enable aiserver debug on sanitizer with static linker.

config BR2_PACKAGE_AISERVER_CONIFG
    string "aiserver config"
    default "none"

config BR2_PACKAGE_AISERVER_RKVO
    bool "enable aiserver with rkvo"
    default n

config BR2_PACKAGE_AISERVER_MINILOGGER
        bool "enable miniloger print"
        select BR2_PACKAGE_MINILOGGER
        default y
        help
          rockchip aiserver options

config BR2_PACKAGE_AISERVER_SHM_SERVER
        bool "enable shm server"
        select BR2_PACKAGE_SHM_TOOLS
        default n
        help
          rockchip aiserver options

config BR2_PACKAGE_AISERVER_OSD_SERVER
        bool "enable osd server"
        select BR2_PACKAGE_FREETYPE
        default n
        help
          rockchip aiserver options

config BR2_PACKAGE_AISERVER_EXIV2_FEATURE
        bool "enable exiv2 feature"
        select BR2_PACKAGE_EXIV2
        default n
        help
          rockchip aiserver options

config BR2_PACKAGE_AISERVER_USE_ROCKX
        bool "rockx"
        select BR2_PACKAGE_RKNPU
        select BR2_PACKAGE_ROCKX
        help
          wrapped function of rockx

config BR2_PACKAGE_AISERVER_USE_STASTERIA
        bool "stasteria"
        select BR2_PACKAGE_RKNPU
        default n
        help
          rockchip aiserver options
endif
```

## buildroot/package/rockchip/alexa-smart-screen-sdk/Config.in
```kconfig
config BR2_PACKAGE_ALEXA_SMART_SCREEN_SDK
	bool "Alexa Smart Screen SDK"
	help
	Amazon Alexa Smart Screen SDK
```

## buildroot/package/rockchip/alexaClientSDK/Config.in
```kconfig
config BR2_PACKAGE_ALEXACLIENTSDK
	bool "alexa client sdk"
config BR2_PACKAGE_ALEXACLIENTSDK_INTERNAL
	bool "alexa client sdk internal"
```

## buildroot/package/rockchip/alsatool/Config.in
```kconfig
config BR2_PACKAGE_ALSATOOL
	bool "Rockchip Alsa tool for linux"
        select BR2_PACKAGE_ALSA_LIB
	help
	  Rockchip alsa tool for linux.
```
