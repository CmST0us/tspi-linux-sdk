## buildroot/package/retroarch/libretro-bluemsx/Config.in
```kconfig
config BR2_PACKAGE_LIBRETRO_BLUEMSX
        bool "libretro-bluemsx"
	depends on BR2_PACKAGE_RETROARCH
	depends on BR2_INSTALL_LIBSTDCPP
        help
          libretro bluemsx core.

	  http://www.libretro.com

comment "LIBRETRO_BLUEMSX needs a toolchain w/ C++"
	depends on !BR2_INSTALL_LIBSTDCPP
```

## buildroot/package/retroarch/libretro-bnes/Config.in
```kconfig
config BR2_PACKAGE_LIBRETRO_BNES
        bool "libretro-bnes"
	depends on BR2_PACKAGE_RETROARCH
	depends on BR2_INSTALL_LIBSTDCPP
        help
          libretro bnes core.

	  http://www.libretro.com

comment "LIBRETRO_BNES needs a toolchain w/ C++"
	depends on !BR2_INSTALL_LIBSTDCPP
```

## buildroot/package/retroarch/libretro-bsnes/Config.in
```kconfig
config BR2_PACKAGE_LIBRETRO_BSNES
        bool "libretro-bsnes"
	depends on BR2_PACKAGE_RETROARCH
	depends on BR2_INSTALL_LIBSTDCPP
        help
          libretro bsnes core.

	  http://www.libretro.com

if BR2_PACKAGE_LIBRETRO_BSNES

choice
	prompt "libretro-bsnes profile"
	default BR2_PACKAGE_LIBRETRO_BSNES_PERFORMANCE if BR2_ARM_CPU_ARMV4 || BR2_ARM_CPU_ARMV5
	default BR2_PACKAGE_LIBRETRO_BSNES_ACCURACY if !BR2_ARM_CPU_ARMV4 && !BR2_ARM_CPU_ARMV5
	help
	  The bsnes comes in three different profiles (accuracy, balanced
	  and performance) which contain minor differences in the PPU
	  (graphics) emulation.

config BR2_PACKAGE_LIBRETRO_BSNES_ACCURACY
	bool "accuracy"

config BR2_PACKAGE_LIBRETRO_BSNES_BALANCED
	bool "balanced"

config BR2_PACKAGE_LIBRETRO_BSNES_PERFORMANCE
	bool "performance"

endchoice

config BR2_PACKAGE_LIBRETRO_BSNES_PROFILE
	string "libretro-bsnes profile"
	default "accuracy" if BR2_PACKAGE_LIBRETRO_BSNES_ACCURACY
	default "balanced" if BR2_PACKAGE_LIBRETRO_BSNES_BALANCED
	default "performance" if BR2_PACKAGE_LIBRETRO_BSNES_PERFORMANCE
	help
	  The bsnes comes in three different profiles (accuracy, balanced
	  and performance) which contain minor differences in the PPU
	  (graphics) emulation.

endif

comment "LIBRETRO_BSNES needs a toolchain w/ C++"
	depends on !BR2_INSTALL_LIBSTDCPP
```

## buildroot/package/retroarch/libretro-fbalpha/Config.in
```kconfig
config BR2_PACKAGE_LIBRETRO_FBALPHA
        bool "libretro-fbalpha"
	depends on BR2_PACKAGE_RETROARCH
	depends on BR2_INSTALL_LIBSTDCPP
        help
          libretro fbalpha core.

	  http://www.libretro.com

comment "LIBRETRO_FBALPHA needs a toolchain w/ C++"
	depends on !BR2_INSTALL_LIBSTDCPP
```

## buildroot/package/retroarch/libretro-fbalpha2012/Config.in
```kconfig
config BR2_PACKAGE_LIBRETRO_FBALPHA2012
        bool "libretro-fbalpha2012"
	depends on BR2_PACKAGE_RETROARCH
	depends on BR2_INSTALL_LIBSTDCPP
        help
          libretro fbalpha2012 core.

	  http://www.libretro.com

comment "LIBRETRO_FBALPHA2012 needs a toolchain w/ C++"
	depends on !BR2_INSTALL_LIBSTDCPP

if BR2_PACKAGE_LIBRETRO_FBALPHA2012

config BR2_PACKAGE_LIBRETRO_FBALPHA2012_PGM_NEOGEO_ONLY
	bool "libretro-fbalpha2012 pgm and neogeo only"
	help
	  Only enable pgm and negeo.

endif
```

## buildroot/package/retroarch/libretro-fceumm/Config.in
```kconfig
config BR2_PACKAGE_LIBRETRO_FCEUMM
        bool "libretro-fceumm"
	depends on BR2_PACKAGE_RETROARCH
	depends on BR2_INSTALL_LIBSTDCPP
        help
          libretro fceumm core.

	  http://www.libretro.com

comment "LIBRETRO_FCEUMM needs a toolchain w/ C++"
	depends on !BR2_INSTALL_LIBSTDCPP
```

## buildroot/package/retroarch/libretro-fceunext/Config.in
```kconfig
config BR2_PACKAGE_LIBRETRO_FCEUNEXT
        bool "libretro-fceu-next"
	depends on BR2_PACKAGE_RETROARCH
	depends on BR2_INSTALL_LIBSTDCPP
        help
          libretro fceu-next core.

	  http://www.libretro.com

comment "LIBRETRO_FCEUNEXT needs a toolchain w/ C++"
	depends on !BR2_INSTALL_LIBSTDCPP
```

## buildroot/package/retroarch/libretro-gambatte/Config.in
```kconfig
config BR2_PACKAGE_LIBRETRO_GAMBATTE
        bool "libretro-gambatte"
	depends on BR2_PACKAGE_RETROARCH
	depends on BR2_INSTALL_LIBSTDCPP
        help
          libretro gambatte core.

	  http://www.libretro.com

comment "LIBRETRO_GAMBATTE needs a toolchain w/ C++"
	depends on !BR2_INSTALL_LIBSTDCPP
```

## buildroot/package/retroarch/libretro-gearboy/Config.in
```kconfig
config BR2_PACKAGE_LIBRETRO_GEARBOY
        bool "libretro-gearboy"
	depends on BR2_PACKAGE_RETROARCH
	depends on BR2_INSTALL_LIBSTDCPP
        help
          libretro gearboy core.

	  http://www.libretro.com

comment "LIBRETRO_GEARBOY needs a toolchain w/ C++"
	depends on !BR2_INSTALL_LIBSTDCPP
```

## buildroot/package/retroarch/libretro-gpsp/Config.in
```kconfig
config BR2_PACKAGE_LIBRETRO_GPSP
        bool "libretro-gpsp"
	depends on BR2_PACKAGE_RETROARCH
	depends on BR2_INSTALL_LIBSTDCPP
        help
          libretro gpsp core.

	  http://www.libretro.com

comment "LIBRETRO_GPSP needs a toolchain w/ C++"
	depends on !BR2_INSTALL_LIBSTDCPP
```

## buildroot/package/retroarch/libretro-hatari/Config.in
```kconfig
config BR2_PACKAGE_LIBRETRO_HATARI
        bool "libretro-hatari"
	depends on BR2_PACKAGE_RETROARCH
	depends on BR2_INSTALL_LIBSTDCPP
        help
          libretro hatari core.

	  http://www.libretro.com

comment "LIBRETRO_HATARI needs a toolchain w/ C++"
	depends on !BR2_INSTALL_LIBSTDCPP
```

## buildroot/package/retroarch/libretro-lutro/Config.in
```kconfig
config BR2_PACKAGE_LIBRETRO_LUTRO
        bool "libretro-lutro"
	depends on BR2_PACKAGE_RETROARCH
	depends on BR2_INSTALL_LIBSTDCPP
        help
          libretro lutro core.

	  http://www.libretro.com

comment "LIBRETRO_LUTRO needs a toolchain w/ C++"
	depends on !BR2_INSTALL_LIBSTDCPP
```

## buildroot/package/retroarch/libretro-mame2000/Config.in
```kconfig
config BR2_PACKAGE_LIBRETRO_MAME2000
        bool "libretro-mame2000"
	depends on BR2_PACKAGE_RETROARCH
	depends on BR2_INSTALL_LIBSTDCPP
        help
          libretro mame2000 core.

	  http://www.libretro.com

comment "LIBRETRO_MAME2000 needs a toolchain w/ C++"
	depends on !BR2_INSTALL_LIBSTDCPP
```

## buildroot/package/retroarch/libretro-mame2003plus/Config.in
```kconfig
config BR2_PACKAGE_LIBRETRO_MAME2003PLUS
        bool "libretro-mame2003plus"
	depends on BR2_PACKAGE_RETROARCH
	depends on BR2_INSTALL_LIBSTDCPP
        help
          libretro mame2003plus core.

	  http://www.libretro.com

comment "LIBRETRO_MAME2003PLUS needs a toolchain w/ C++"
	depends on !BR2_INSTALL_LIBSTDCPP
```

## buildroot/package/retroarch/libretro-mame2010/Config.in
```kconfig
config BR2_PACKAGE_LIBRETRO_MAME2010
        bool "libretro-mame2010"
	depends on BR2_PACKAGE_RETROARCH
	depends on BR2_INSTALL_LIBSTDCPP
        help
          libretro mame2010 core.

	  http://www.libretro.com

comment "LIBRETRO_MAME2010 needs a toolchain w/ C++"
	depends on !BR2_INSTALL_LIBSTDCPP
```

## buildroot/package/retroarch/libretro-mame2014/Config.in
```kconfig
config BR2_PACKAGE_LIBRETRO_MAME2014
        bool "libretro-mame2014"
	depends on BR2_PACKAGE_RETROARCH
	depends on BR2_INSTALL_LIBSTDCPP
        help
          libretro mame2014 core.

	  http://www.libretro.com

comment "LIBRETRO_MAME2014 needs a toolchain w/ C++"
	depends on !BR2_INSTALL_LIBSTDCPP
```

## buildroot/package/retroarch/libretro-meteor/Config.in
```kconfig
config BR2_PACKAGE_LIBRETRO_METEOR
        bool "libretro-meteor"
	depends on BR2_PACKAGE_RETROARCH
	depends on BR2_INSTALL_LIBSTDCPP
        help
          libretro meteor core.

	  http://www.libretro.com

comment "LIBRETRO_METEOR needs a toolchain w/ C++"
	depends on !BR2_INSTALL_LIBSTDCPP
```

## buildroot/package/retroarch/libretro-mgba/Config.in
```kconfig
config BR2_PACKAGE_LIBRETRO_MGBA
        bool "libretro-mgba"
	depends on BR2_PACKAGE_RETROARCH
	depends on BR2_INSTALL_LIBSTDCPP
        help
          libretro mgba core.

	  http://www.libretro.com

comment "LIBRETRO_MGBA needs a toolchain w/ C++"
	depends on !BR2_INSTALL_LIBSTDCPP
```

## buildroot/package/retroarch/libretro-mupen64plus/Config.in
```kconfig
config BR2_PACKAGE_LIBRETRO_MUPEN64PLUS
        bool "libretro-mupen64plus"
	depends on BR2_PACKAGE_RETROARCH
	depends on BR2_INSTALL_LIBSTDCPP
        help
          libretro mupen64plus core.

	  http://www.libretro.com

comment "LIBRETRO_MUPEN64PLUS needs a toolchain w/ C++"
	depends on !BR2_INSTALL_LIBSTDCPP
```

## buildroot/package/retroarch/libretro-nestopia/Config.in
```kconfig
config BR2_PACKAGE_LIBRETRO_NESTOPIA
        bool "libretro-nestopia"
	depends on BR2_PACKAGE_RETROARCH
	depends on BR2_INSTALL_LIBSTDCPP
        help
          libretro nestopia core.

	  http://www.libretro.com

comment "LIBRETRO_NESTOPIA needs a toolchain w/ C++"
	depends on !BR2_INSTALL_LIBSTDCPP
```

## buildroot/package/retroarch/libretro-paralleln64/Config.in
```kconfig
config BR2_PACKAGE_LIBRETRO_PARALLELN64
        bool "libretro-paralleln64"
	depends on BR2_PACKAGE_RETROARCH
	depends on BR2_INSTALL_LIBSTDCPP
        help
          libretro paralleln64 core.

	  http://www.libretro.com

comment "LIBRETRO_PARALLELN64 needs a toolchain w/ C++"
	depends on !BR2_INSTALL_LIBSTDCPP
```

## buildroot/package/retroarch/libretro-picodrive/Config.in
```kconfig
config BR2_PACKAGE_LIBRETRO_PICODRIVE
        bool "libretro-picodrive"
	depends on BR2_PACKAGE_RETROARCH
	depends on BR2_INSTALL_LIBSTDCPP
        help
          libretro picodrive core.

	  http://www.libretro.com

comment "LIBRETRO_PICODRIVE needs a toolchain w/ C++"
	depends on !BR2_INSTALL_LIBSTDCPP
```

## buildroot/package/retroarch/libretro-prosystem/Config.in
```kconfig
config BR2_PACKAGE_LIBRETRO_PROSYSTEM
        bool "libretro-prosystem"
	depends on BR2_PACKAGE_RETROARCH
	depends on BR2_INSTALL_LIBSTDCPP
        help
          libretro prosystem core.

	  http://www.libretro.com

comment "LIBRETRO_PROSYSTEM needs a toolchain w/ C++"
	depends on !BR2_INSTALL_LIBSTDCPP
```

## buildroot/package/retroarch/libretro-quicknes/Config.in
```kconfig
config BR2_PACKAGE_LIBRETRO_QUICKNES
        bool "libretro-quicknes"
	depends on BR2_PACKAGE_RETROARCH
	depends on BR2_INSTALL_LIBSTDCPP
        help
          libretro quicknes core.

	  http://www.libretro.com

comment "LIBRETRO_QUICKNES needs a toolchain w/ C++"
	depends on !BR2_INSTALL_LIBSTDCPP
```

## buildroot/package/retroarch/libretro-scummvm/Config.in
```kconfig
config BR2_PACKAGE_LIBRETRO_SCUMMVM
        bool "libretro-scummvm"
	depends on BR2_PACKAGE_RETROARCH
	depends on BR2_INSTALL_LIBSTDCPP
        help
          libretro scummvm core.

	  http://www.libretro.com

comment "LIBRETRO_SCUMMVM needs a toolchain w/ C++"
	depends on !BR2_INSTALL_LIBSTDCPP
```
