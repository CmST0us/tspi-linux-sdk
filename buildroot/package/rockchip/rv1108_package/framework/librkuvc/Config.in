## buildroot/package/rockchip/rv1108_package/framework/librkuvc/Config.in
```kconfig
if BR2_PACKAGE_RV1108

# BSP packages
config BR2_PACKAGE_LIBRKUVC
	bool "rv1108 package librkuvc"
	select BR2_PACKAGE_LIBION
	select BR2_PACKAGE_ROCKCHIP_MPP
	select BR2_PACKAGE_JHEAD
	select BR2_PACKAGE_ROCKCHIP_RGA

endif
```

## buildroot/package/rockchip/rv1108_package/framework/messenger/Config.in
```kconfig
if BR2_PACKAGE_RV1108

# BSP packages
config BR2_PACKAGE_MESSENGER
	bool "RV1108 package messenger"
	select BR2_PACKAGE_NANOMSG
	select BR2_PACKAGE_CJSON

endif
```

## buildroot/package/rockchip/rv1108_package/framework/preisp/Config.in
```kconfig
if BR2_PACKAGE_RV1108

# BSP packages
config BR2_PACKAGE_PREISP
	bool "rv1108 package preisp"

endif
```

## buildroot/package/rockchip/rv1108_package/framework/process_units/Config.in
```kconfig
if BR2_PACKAGE_RV1108

# BSP packages
config BR2_PACKAGE_PROCESS_UNITS
	bool "RV1108 package camera stream processing unit"
	select BR2_PACKAGE_RKFB
	select BR2_PACKAGE_ROCKCHIP_RGA
	default n
endif
```

## buildroot/package/rockchip/rv1108_package/framework/rkcamera/Config.in
```kconfig
if BR2_PACKAGE_RV1108

# BSP packages
config BR2_PACKAGE_RKCAMERA
	bool "RV1108 package rkcamera"
	select BR2_PACKAGE_ADK
	select BR2_PACKAGE_CAMERAHAL
	select BR2_PACKAGE_CJSON

if BR2_PACKAGE_RKCAMERA
    config BR2_PACKAGE_RKCAMERA_TEST
        bool "rv1108 rkcamera test"
        default n
endif

endif
```

## buildroot/package/rockchip/rv1108_package/framework/rkface/Config.in
```kconfig
if BR2_PACKAGE_RV1108

# BSP packages
config BR2_PACKAGE_RKFACE
	bool "rv1108 package Rockchip Face Algorithm"

if BR2_PACKAGE_RKFACE
menu "RK Face Configures"

config BR2_PACKAGE_RKFACE_AUTHORIZATION
    bool "Enable rkface Authorization "
    default n

config BR2_PACKAGE_RKFACE_DETECTION
    bool "Enable rk face detection"
    default y

config BR2_PACKAGE_RKFACE_RECOGNITION
    bool "Enable rk face recognition"
    default y

config BR2_PACKAGE_RKLIVE_DETECTION_2D
    bool "Enable rk live detection 2d"
    default n

endmenu
endif

endif
```

## buildroot/package/rockchip/rv1108_package/framework/rkfb/Config.in
```kconfig
if BR2_PACKAGE_RV1108

# BSP packages
config BR2_PACKAGE_RKFB
	bool "RV1108 package rkfb"
	help

if BR2_PACKAGE_RKFB
menu "framebuffer"

choice
        prompt "HDMI max resolution"
        default BR2_PACKAGE_RKFB_HDMI_MAX_720
        help
          Select HDMI max resolution

config BR2_PACKAGE_RKFB_HDMI_MAX_720
        bool "720P"
        help
          HDMI max resolution 720P

config BR2_PACKAGE_RKFB_HDMI_MAX_1080
        bool "1080P"
        help
          HDMI max resolution 1080P

endchoice

endmenu

endif

endif
```

## buildroot/package/rockchip/rv1108_package/framework/rknr/Config.in
```kconfig
if BR2_PACKAGE_RV1108

# BSP packages
config BR2_PACKAGE_RKNR
	bool "RV1108 package 3DNR algorithm"

endif
```

## buildroot/package/rockchip/rv1108_package/framework/rv1108_settings/Config.in
```kconfig
if BR2_PACKAGE_RV1108

# BSP packages
config BR2_PACKAGE_RV1108_SETTINGS
	bool "rv1108 package settings"

endif
```

## buildroot/package/rockchip/securityAuth/Config.in
```kconfig
menuconfig BR2_PACKAGE_SECURITYAUTH
    bool "securityAuth"

if BR2_PACKAGE_SECURITYAUTH
choice
	default BR2_PACKAGE_SECURITYAUTH_3128H
    prompt "securityAuth support for "

config BR2_PACKAGE_SECURITYAUTH_3128H
    bool "3128h"

endchoice

endif
```

## buildroot/package/rockchip/sensor-daemon/Config.in
```kconfig
config BR2_PACKAGE_SENSOR_DAEMON
	bool "sensor-daemon"
	select BR2_PACKAGE_NANOMSG
	select BR2_PACKAGE_CJSON
	select BR2_PACKAGE_INIPARSER
	help

if BR2_PACKAGE_SENSOR_DAEMON

config BR2_PACKAGE_NANOMSG_TOOLS
	bool "Build sensor-daemon tools"
	help
	  Build sensor-daemon tools

endif
```

## buildroot/package/rockchip/settings/Config.in
```kconfig
config BR2_PACKAGE_SETTINGS
	bool "settings"
	depends on BR2_PACKAGE_QT5
	help
	  Rockchip settings application based on QT
```

## buildroot/package/rockchip/sl_lock/Config.in
```kconfig
config BR2_PACKAGE_SL_LOCK
    bool "sl_lock"
    select BR2_PACKAGE_LIBDRM
    select BR2_PACKAGE_ROCKCHIP_RGA
    select BR2_PACKAGE_CAMERA_ENGINE
```

## buildroot/package/rockchip/slt_gpu_light/Config.in
```kconfig
config BR2_PACKAGE_SLT_GPU_LIGHT
	bool "Rockchip slt gpu light lib for linux"
	select BR2_PACKAGE_LIBDRM
	help
	  Rockchip slt gpu light lib for linux.
```

## buildroot/package/rockchip/smart_display_service/Config.in
```kconfig
config BR2_PACKAGE_SMART_DISPLAY_SERVICE
	bool "smart_display_service"

    select BR2_PACKAGE_PROTOBUF
    select BR2_PACKAGE_LIBEVENT
    select BR2_PACKAGE_OPENSSL
```

## buildroot/package/rockchip/softapServer/Config.in
```kconfig
config BR2_PACKAGE_SOFTAPSERVER
    bool "socket server based on softap"
    select BR2_PACKAGE_SOFTAP
```

## buildroot/package/rockchip/startup_app_ipc/Config.in
```kconfig
config BR2_PACKAGE_STARTUP_APP_IPC
	bool "rockchip startup app for ipc"
	select BR2_PACKAGE_RKMEDIA
	select BR2_PACKAGE_RKMEDIA_MINI
	select BR2_PACKAGE_LIBIPCPROTOCOL
	help
	  rockchip startup app for ipc

if BR2_PACKAGE_STARTUP_APP_IPC
config BR2_PACKAGE_STARTUP_APP_IPC_SANITIZER_DYNAMIC
	bool "enable startup app sanitizer tools with dynamic linker"
	select BR2_PACKAGE_ADDRESS_SANITIZER
	help
	  Enable startup app for ipc debug on sanitizer with dynamic linker.

config BR2_PACKAGE_STARTUP_APP_IPC_SANITIZER_STATIC
	bool "enable startup app sanitizer tools with static linker"
	select BR2_PACKAGE_ADDRESS_SANITIZER
	help
	  Enable startup app for ipc debug on sanitizer with static linker.

endif
```

## buildroot/package/rockchip/storage_manager/Config.in
```kconfig
menuconfig BR2_PACKAGE_STORAGE_MANAGER
	bool "rockchip storage_manager"
	select BR2_PACKAGE_LIBGDBUS
	select BR2_PACKAGE_LIBRKDB
	help
	  rockchip storage_manager

if BR2_PACKAGE_STORAGE_MANAGER
config BR2_PACKAGE_STORAGE_MANAGER_SANITIZER_DYNAMIC
	bool "enable storage manager sanitizer tools with dynamic linker"
	select BR2_PACKAGE_ADDRESS_SANITIZER
	help
	  Enable storage manager debug on sanitizer with dynamic linker.

config BR2_PACKAGE_STORAGE_MANAGER_SANITIZER_STATIC
	bool "enable storage manager sanitizer tools with static linker"
	select BR2_PACKAGE_ADDRESS_SANITIZER
	help
	  Enable storage manager debug on sanitizer with static linker.

config BR2_PACKAGE_STORAGE_MANAGER_MINILOGGER
	bool "enable storage manager miniloger print"
	select BR2_PACKAGE_MINILOGGER
	default y
	help
	  Enable storage manager miniloger print.

config BR2_PACKAGE_STORAGE_MANAGER_FILE_LOAD_DELAY
	int "file load delay, us"
	default 0

config BR2_PACKAGE_STORAGE_MANAGER_WAIT_MEDIASTOP_WHEN_FORMAT
	bool "enable storage manager wait mediastop cmd when format"
	default y
	help
	  Enable storage manager wait mediastop cmd when format.

config BR2_PACKAGE_STORAGE_MANAGER_AUTO_ADJUST_MEDIA_PATH
	bool "enable auto adjust media path"
	default y
	help
	  Enable use data as media path when default media path not exist.
endif
```

## buildroot/package/rockchip/tee-user-app/Config.in
```kconfig
config BR2_PACKAGE_TEE_USER_APP
	bool "Rockchip TEE user App or linux"
	help
	  Rockchip TEE user App or linux.

if BR2_PACKAGE_TEE_USER_APP

config BR2_PACKAGE_TEE_USER_APP_COMPILE_CMD
	string "compile command"
	default "6432"
	help
	  Rockchip rk_tee_user compile cammad.

config BR2_PACKAGE_TEE_USER_APP_TEE_VERSION
	string "TEE version"
	default "v2"
	help
	  Rockchip TEE version.

config BR2_PACKAGE_TEE_USER_APP_EXTRA_TOOLCHAIN
	string "Extra toolchain if neccessary"
	default "None"
	help
	  Extra toolchain if neccessary

endif
```

## buildroot/package/rockchip/tensorflow/Config.in
```kconfig
config BR2_PACKAGE_TENSORFLOW
	bool "TensorFlow is for numerical computation using data flow graphs"
	help
		TensorFlow is an open source software library for numerical computation
		using data flow graphs. The graph nodes represent mathematical operations,
		while the graph edges represent the multidimensional data arrays (tensors)
		that flow between them. This flexible architecture enables you to deploy
		computation to one or more CPUs or GPUs in a desktop, server, or mobile
		device without rewriting code. TensorFlow also includes TensorBoard,
		a data visualization toolkit.
```

## buildroot/package/rockchip/thunderboot/Config.in
```kconfig
menuconfig BR2_PACKAGE_THUNDERBOOT
	bool "rockchip thunderboot"
	help
	  Rockchip tb(thunder boot) configuration.

if BR2_PACKAGE_THUNDERBOOT
config BR2_PACKAGE_THUNDERBOOT_BATIPC_LAUNCH
	bool "lunch for battery ipc"
	help
	  The default usage on battery ipc is special, that will power off
	  automatically if the cloud connection was not establish.

#config BR2_PACKAGE_THUNDERBOOT_CAMERA_FPS
#	int "camera fps setting"
#	depends on BR2_PACKAGE_THUNDERBOOT_BATIPC_LAUNCH
#	default 25
#	help
#	  Camera fps setting, default is 25fps.

config BR2_THUNDERBOOT_INSTALL_MODULES
	string "dirver modules"
	help
	  Kernel driver modules to be installed.

config BR2_THUNDERBOOT_ETH
	bool "ethernet configuration"
	help
	  Ethernet connection

config BR2_THUNDERBOOT_EMMC
	bool "emmc configuration"
	help
	  EMMC enable

config BR2_THUNDERBOOT_SOUND
	bool "sound configuration"
	help
	  Sound enable

config BR2_THUNDERBOOT_SIMPLIFY_USB
	bool "simplify usb configuration"
	help
	  Kernel driver modules to be installed.

config BR2_PACKAGE_THUNDERBOOT_USE_EUDEV
	bool "enable udev for usb-otg/sdcard/block-byname, etc..."
	help
	  enable udev for usb-otg/sdcard/block-byname, etc...

if BR2_THUNDERBOOT_SIMPLIFY_USB

config BR2_THUNDERBOOT_USB_ADBD
	bool "rockchip thunderboot USB ADBD"
	select BR2_PACKAGE_ANDROID_TOOLS
	help
	  Use simplify ADB configuration.

config BR2_THUNDERBOOT_USB_MTP
	bool "rockchip thunderboot USB MTP"
	select BR2_PACKAGE_MTP
	select BR2_PACKAGE_THUNDERBOOT_USE_EUDEV
	help
	  Use simplify MTP configuration.

config BR2_THUNDERBOOT_USB_RNDIS
	bool "rockchip thunderboot USB RNDIS"
	help
	  Use simplify RNDIS configuration.
	  Default net device is usb0.
	  Default net address is 190.168.1.100
endif
endif
```

## buildroot/package/rockchip/ueventd/Config.in
```kconfig
config BR2_PACKAGE_UEVENTD
	bool "Rockchip ueventd for linux"
	help
	  Rockchip ueventd for linux, port from Android
```

## buildroot/package/rockchip/uvc_app/Config.in
```kconfig
config BR2_PACKAGE_UVC_APP
    bool "uvc app"
    select BR2_PACKAGE_LIBDRM
    select BR2_PACKAGE_ROCKCHIP_MPP
    select BR2_PACKAGE_LIBV4L
    select BR2_PACKAGE_JSON_C

if BR2_PACKAGE_UVC_APP
config BR2_PACKAGE_UVC_APP_MINILOGGER
	bool "enable uvc_app miniloger print"
	select BR2_PACKAGE_MINILOGGER
	default n
	help
	  Enable uvc_app miniloger print.
endif
```
