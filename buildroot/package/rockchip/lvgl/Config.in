## buildroot/package/rockchip/lxqt-build-tools/Config.in
```kconfig
config BR2_PACKAGE_LXQT_BUILD_TOOLS
	bool "lxqt-build-tools"
	help
	several tools needed to build LXQt
```

## buildroot/package/rockchip/mdev_mount/Config.in
```kconfig
config BR2_PACKAGE_MDEV_MOUNT
	bool "mdev_mount for auto mount SD/UDisk"
	depends on BR2_ROOTFS_DEVICE_CREATION_DYNAMIC_MDEV

comment "mdev_mount needs mdev"
	depends on !BR2_ROOTFS_DEVICE_CREATION_DYNAMIC_MDEV
```

## buildroot/package/rockchip/mediaserver/Config.in
```kconfig
menuconfig BR2_PACKAGE_MEDIASERVER
	bool "rockchip mediaserver"
	select BR2_PACKAGE_JSON_FOR_MODERN_CPP
	select BR2_PACKAGE_RKMEDIA
	help
	  rockchip mediaserver

if BR2_PACKAGE_MEDIASERVER

config BR2_PACKAGE_MEDIASERVER_SANITIZER_DYNAMIC
	bool "enable mediaserver sanitizer tools with dynamic linker"
	select BR2_PACKAGE_ADDRESS_SANITIZER
	help
	  Enable mediaserver debug on sanitizer with dynamic linker.

config BR2_PACKAGE_MEDIASERVER_SANITIZER_STATIC
	bool "enable mediaserver sanitizer tools with static linker"
	select BR2_PACKAGE_ADDRESS_SANITIZER
	help
	  Enable mediaserver debug on sanitizer with static linker.

config BR2_PACKAGE_MEDIASERVE_BIN
	bool "Enable mediaserver bin"
	default y
	help
	  rockchip mediaserver options

config BR2_PACKAGE_MEDIASERVE_LIB_EXAMPLE
	bool "Enable mediaserver lib example"
	default y if !BR2_PACKAGE_MEDIASERVE_BIN
	help
	  rockchip mediaserver options

config BR2_PACKAGE_MEDIASERVE_CONFIG
	string "mediaserver config"
	default "none"

config BR2_PACKAGE_MEDIASERVE_DBUS
	bool "Enable dbus server"
	select BR2_PACKAGE_DBUS
	select BR2_PACKAGE_DBUS_CPP
	select BR2_PACKAGE_LIBRKDB
	default y
	help
	  rockchip mediaserver options

config BR2_PACKAGE_MEDIASERVE_SCHEDULES_MANAGER
	bool "Enable schedules manager"
	depends on BR2_PACKAGE_MEDIASERVE_DBUS
	default y if BR2_PACKAGE_MEDIASERVE_DBUS
	help
	  rockchip mediaserver options

config BR2_PACKAGE_MEDIASERVE_LINKAPI
	bool "Enable link api features"
	select BR2_PACKAGE_CJSON
	default n
	help
	  rockchip mediaserver options

choice
prompt "Link api type"
	default BR2_PACKAGE_MEDIASERVE_LINKAPI_LINKKIT
	help
	  Select a link api type.

config BR2_PACKAGE_MEDIASERVE_LINKAPI_LINKKIT
	bool "Enable linkkit api for aliyun"
	depends on BR2_PACKAGE_MEDIASERVE_LINKAPI

config BR2_PACKAGE_MEDIASERVE_LINKAPI_TUYA
	bool "Enable tuya api for tuya"
	depends on BR2_PACKAGE_MEDIASERVE_LINKAPI
endchoice

config BR2_PACKAGE_MEDIASERVE_LINKAPI_VENDOR
	bool "Enable link certificate to be read from vendor storage"
	depends on BR2_PACKAGE_MEDIASERVE_LINKAPI
	select BR2_PACKAGE_VENDOR_STORAGE_LIBRARY
	default n
	help
	  rockchip mediaserver options

config BR2_PACKAGE_MEDIASERVE_MINILOGGER
	bool "Enable miniloger print"
	select BR2_PACKAGE_MINILOGGER
	default y
	help
	  rockchip mediaserver options

config BR2_PACKAGE_MEDIASERVE_SHM_SERVER
	bool "Enable shm server"
	select BR2_PACKAGE_SHM_TOOLS
	default n
	help
	  rockchip mediaserver options

config BR2_PACKAGE_MEDIASERVE_OSD_SERVER
	bool "Enable osd server"
	select BR2_PACKAGE_FREETYPE
	default n
	help
	  rockchip mediaserver options

config BR2_PACKAGE_MEDIASERVE_EXIV2_FEATURE
	bool "Enable exiv2 feature"
	select BR2_PACKAGE_EXIV2
	default n
	help
	  rockchip mediaserver options

config BR2_PACKAGE_MEDIASERVE_TB
	bool "Enable thunder boot"

config BR2_PACKAGE_MEDIASERVE_USE_ROCKFACE
	bool "Enable rockface"
	select BR2_PACKAGE_RKMEDIA_ROCKFACE
	default y if !BR2_PACKAGE_MEDIASERVE_TB
	help
	  rockchip mediaserver options

if BR2_PACKAGE_MEDIASERVE_USE_ROCKFACE
config BR2_PACKAGE_MEDIASERVE_USE_ROCKFACE_RECOGNIZE
	bool "Enable rockface recognize"
	select BR2_PACKAGE_RKMEDIA_ROCKFACE_RECOGNIZE
	default y if !BR2_PACKAGE_MEDIASERVE_TB
	help
	  rockchip mediaserver recognize options
endif

config BR2_PACKAGE_MEDIASERVE_USE_ROCKX
	bool "Enable rockx"
	select BR2_PACKAGE_ROCKX
	default y if !BR2_PACKAGE_MEDIASERVE_TB
	help
	  rockchip mediaserver options

config BR2_PACKAGE_MEDIASERVE_ZBAR
	bool "Enable zbar to scan QR code"
	default y if BR2_PACKAGE_MEDIASERVE_LINKAPI
	help
	  rockchip mediaserver options

config BR2_PACKAGE_MEDIASERVE_ENABLE_CY43438
	bool "Enable cyw43438 api"
	default n
	help
	  rockchip mediaserver options

endif
```

## buildroot/package/rockchip/minigui/Config.in
```kconfig
config BR2_PACKAGE_MINIGUI
	bool "Minigui core lib"
	select BR2_PACKAGE_JPEG
	help
          http://www.minigui.org

config BR2_PACKAGE_MINIGUI_SOFTWARE_SCALE
	bool "Minigui use software scale"
	depends on BR2_PACKAGE_LIBDRM
	select BR2_PACKAGE_PIXMAN
	default y

config BR2_PACKAGE_MINIGUI_ENABLE_RGA
	bool "Minigui use rga"
	depends on BR2_PACKAGE_MINIGUI
	select BR2_PACKAGE_ROCKCHIP_RGA

config BR2_PACKAGE_MINIGUI_ENABLE_FREETYPE
	bool "Minigui use freetype"
	depends on BR2_PACKAGE_MINIGUI
	select BR2_PACKAGE_FREETYPE
	help
		Enable freetype for vector font

config BR2_PACKAGE_MINIGUI_ENABLE_PNG
	bool "Minigui use png"
	depends on BR2_PACKAGE_MINIGUI
	depends on BR2_PACKAGE_LIBPNG_12
	help
		Enable png
```

## buildroot/package/rockchip/minigui_demo/Config.in
```kconfig
config BR2_PACKAGE_MINIGUI_DEMO
	bool "MiniGUI simple demo for bringup"
	select BR2_PACKAGE_MINIGUI
	select BR2_PACKAGE_LIBPNG
	select BR2_PACKAGE_LIBPNG_12
	select BR2_PACKAGE_MINIGUI_ENABLE_RGA
	select BR2_PACKAGE_MINIGUI_ENABLE_FREETYPE
	select BR2_PACKAGE_MINIGUI_ENABLE_PNG
	help
	  MiniGUI simple demo for bringup
```

## buildroot/package/rockchip/minilogger/Config.in
```kconfig
config BR2_PACKAGE_MINILOGGER
	bool "minilogger"
	select BR2_PACKAGE_LIBGLIB2
	select BR2_PACKAGE_LIBUNWIND
	help
	  A small logger with backtrace in signal handler
```

## buildroot/package/rockchip/mtp/Config.in
```kconfig
config BR2_PACKAGE_MTP
	bool "Media Transfer Protocal(MTP)"
	depends on BR2_PACKAGE_EUDEV
	select BR2_PACKAGE_GLOG
	select BR2_PACKAGE_DBUS
	select BR2_PACKAGE_DBUS_CPP
	select BR2_PACKAGE_BOOST
	select BR2_PACKAGE_BOOST_THREAD
	select BR2_PACKAGE_BOOST_SYSTEM
	select BR2_PACKAGE_BOOST_FILESYSTEM
	select BR2_PACKAGE_BOOST_TEST
	help
		A port of Android's mtp server implementation to Linux.
```

## buildroot/package/rockchip/mult_uvc_demo/Config.in
```kconfig
config BR2_PACKAGE_MULT_UVC_DEMO
    bool "mult_uvc_demo"
    select BR2_PACKAGE_LIBDRM
    select BR2_PACKAGE_ROCKCHIP_RGA
    select BR2_PACKAGE_ROCKCHIP_MPP
    select BR2_PACKAGE_LIBV4L
    select BR2_PACKAGE_CAMERA_ENGINE
```

## buildroot/package/rockchip/multicamera/Config.in
```kconfig
config BR2_PACKAGE_MULTICAMERA
	bool "multicamera"
	depends on BR2_PACKAGE_QT5
	help
	  Rockchip camera application based on QT
```

## buildroot/package/rockchip/music/Config.in
```kconfig
config BR2_PACKAGE_MUSIC
	bool "music"
	depends on BR2_PACKAGE_QT5
	help
	  Rockchip music application based on QT
```

## buildroot/package/rockchip/n4/Config.in
```kconfig
config BR2_PACKAGE_N4
    bool "rk n4 camera"
    default n
    select BR2_PACKAGE_LIBSERIALPORT
    select BR2_PACKAGE_LIBV4L
    select BR2_PACKAGE_LIBV4L_UTILS
    select BR2_PACKAGE_RKMEDIA
    select BR2_PACKAGE_RKMEDIA_V4L2_CAPTURE
    select BR2_PACKAGE_RKMEDIA_RKRGA
    select BR2_PACKAGE_DRM_DISPLAY_OUTPUT
    help
      rk n4 cif camera on 1808 which is controlled by 3399 via virtual tty
```

## buildroot/package/rockchip/netserver/Config.in
```kconfig
config BR2_PACKAGE_NETSERVER
	bool "rockchip netserver"
	select BR2_PACKAGE_LIBGDBUS
	select BR2_PACKAGE_LIBRKDB
	help
	  rockchip netserver

if BR2_PACKAGE_NETSERVER
config BR2_PACKAGE_NETSERVER_SANITIZER_DYNAMIC
	bool "enable netserver sanitizer tools with dynamic linker"
	select BR2_PACKAGE_ADDRESS_SANITIZER
	help
	  Enable netserver debug on sanitizer with dynamic linker.

config BR2_PACKAGE_NETSERVER_SANITIZER_STATIC
	bool "enable netserver sanitizer tools with static linker"
	select BR2_PACKAGE_ADDRESS_SANITIZER
	help
	  Enable netserver debug on sanitizer with static linker.

config BR2_PACKAGE_NETSERVER_MINILOGGER
	bool "enable netserver miniloger print"
	select BR2_PACKAGE_MINILOGGER
	default y
	help
	  Enable netserver miniloger print.
endif
```

## buildroot/package/rockchip/npu_powerctrl/Config.in
```kconfig
config BR2_PACKAGE_NPU_POWERCTRL
	bool "Rockchip NPU power control for linux"
	help
	  Rockchip NPU power control for linux.
```

## buildroot/package/rockchip/npu_powerctrl_combine/Config.in
```kconfig
config BR2_PACKAGE_NPU_POWERCTRL_COMBINE
	bool "Rockchip NPU power control combine for linux"
	help
	  Rockchip NPU power control combine for linux.
```

## buildroot/package/rockchip/onvif_server/Config.in
```kconfig
config BR2_PACKAGE_ONVIF_SERVER
	bool "rockchip onvif_server"
	select BR2_PACKAGE_LIBGDBUS
	select BR2_PACKAGE_LIBIPCPROTOCOL
	help
	  rockchip onvif_server
```

## buildroot/package/rockchip/pcba/Config.in
```kconfig
menuconfig BR2_PACKAGE_PCBA
        bool "rockchip pcba test"

if BR2_PACKAGE_PCBA
choice
        prompt "pcba test whether support screen"
        default BR2_PACKAGE_PCBA_NO_SCREEN

config BR2_PACKAGE_PCBA_SCREEN
        bool "pcba with screen"
        select BR2_PACKAGE_LIBDRM
        select BR2_PACKAGE_LIBPNG
        select BR2_PACKAGE_LIBPTHREAD_STUBS
        select BR2_PACKAGE_LIBZIP

config BR2_PACKAGE_PCBA_NO_SCREEN
        bool "pcba with no screen"

endchoice
endif
```

## buildroot/package/rockchip/pkg-config/Config.in
```kconfig
config BR2_PACKAGE_PKG_CONFIG
	bool "pkg-config"
	help
	pkg-config is a helper tool used when compiling applications and libraries
```

## buildroot/package/rockchip/pm-suspend-api/Config.in
```kconfig
config BR2_PACKAGE_PM_SUSPEND_API
	select BR2_PACKAGE_PM_UTILS
	select BR2_PACKAGE_DBUS
	bool "pm suspend api & demo"
```

## buildroot/package/rockchip/polkit-qt-1/Config.in
```kconfig
config BR2_PACKAGE_POLKIT_QT_1
	bool "KDE polkit-qt-1"
	help
	Polkit-qt is a library that lets developers use the PolicyKit API through a nice Qt-styled API
```

## buildroot/package/rockchip/pose_body/Config.in
```kconfig
config BR2_PACKAGE_POSE_BODY
    bool "pose body"
    select BR2_PACKAGE_ROCKX
    select BR2_PACKAGE_LIBDRM
    select BR2_PACKAGE_ROCKCHIP_RGA
    select BR2_PACKAGE_TSLIB
    select BR2_PACKAGE_LIBPNG
    select BR2_PACKAGE_LIBPNG_12
    select BR2_PACKAGE_JPEG
    select BR2_PACKAGE_MINIGUI
    select BR2_PACKAGE_FREETYPE
    select BR2_PACKAGE_CAMERA_ENGINE
    select BR2_PACKAGE_ROCKCHIP_MPP
```

## buildroot/package/rockchip/powermanager/Config.in
```kconfig
config BR2_PACKAGE_POWERMANAGER
	bool "Rockchip Power Manager for linux"
	help
	  Rockchip power manager for linux.
```

## buildroot/package/rockchip/qcamera/Config.in
```kconfig
config BR2_PACKAGE_QCAMERA
	bool "qcamera"
	depends on BR2_PACKAGE_QT5
	help
	  Rockchip camera application based on QT
```

## buildroot/package/rockchip/qfm/Config.in
```kconfig
config BR2_PACKAGE_QFM
	bool "qfm"
	depends on BR2_PACKAGE_QT5
	help
	  Rockchip File Manager application based on QT
```
