## buildroot/package/rockchip/qlauncher/Config.in
```kconfig
config BR2_PACKAGE_QLAUNCHER
	bool "qlauncher"
	depends on BR2_PACKAGE_QT5
	select BR2_PACKAGE_HICOLOR_ICON_THEME
	help
	  Rockchip qlauncher application based on Qt
```

## buildroot/package/rockchip/qplayer/Config.in
```kconfig
config BR2_PACKAGE_QPLAYER
	bool "qplayer"
	depends on BR2_PACKAGE_QT5
	help
	  Rockchip meida player application based on QT
```

## buildroot/package/rockchip/qsetting/Config.in
```kconfig
config BR2_PACKAGE_QSETTING
	bool "qsetting"
	depends on BR2_PACKAGE_QT5
	select BR2_PACKAGE_DEVICEIO_RELEASE
	help
	  Rockchip setting application based on QT
```

## buildroot/package/rockchip/qtxdg/Config.in
```kconfig
config BR2_PACKAGE_QTXDG
	bool "LXQT qtxdg"
	help
	qtxdg is a Qt 5 implementation of freedesktop.org XDG specifications.
```

## buildroot/package/rockchip/recovery/Config.in
```kconfig
config BR2_PACKAGE_RECOVERY
	bool "Rockchip recovery for linux"
        select BR2_PACKAGE_LIBDRM
        select BR2_PACKAGE_LIBPNG
        select BR2_PACKAGE_LIBPTHREAD_STUBS
        select BR2_PACKAGE_LIBZ
        select BR2_PACKAGE_DOSFSTOOLS
        select BR2_PACKAGE_DOSFSTOOLS_FSCK_FAT
        select BR2_PACKAGE_DOSFSTOOLS_MKFS_FAT
        select BR2_PACKAGE_E2FSPROGS
        select BR2_PACKAGE_E2FSPROGS_RESIZE2FS
        select BR2_PACKAGE_LIBCURL
        select BR2_PACKAGE_OPENSSL
	help
	  Rockchip recovery for linux.

if BR2_PACKAGE_RECOVERY

config BR2_PACKAGE_RECOVERY_NO_UI
	bool "No UI for recovery"
	help
	  No UI for recovery

config BR2_PACKAGE_RECOVERY_BOOTCONTROL
    bool "Linux AB bool control"

choice
    default BR2_PACKAGE_RECOVERY_SUCCESSFUL_BOOT
    prompt "Linux A/B bringup features."
config BR2_PACKAGE_RECOVERY_SUCCESSFUL_BOOT
    bool "successful_boot"
config BR2_PACKAGE_RECOVERY_RETRY
    bool "retry time"
endchoice

choice
    default BR2_PACKAGE_RECOVERY_USE_RKUPDATE
    prompt "choice the update bin of recovery."
config BR2_PACKAGE_RECOVERY_USE_RKUPDATE
    bool "rkupdate"
    select BR2_PACKAGE_RECOVERY_RECOVERYBIN
config BR2_PACKAGE_RECOVERY_USE_UPDATEENGINE
    bool "updateEngine"
endchoice

config BR2_PACKAGE_RECOVERY_RECOVERYBIN
    bool "recovery bin"

config BR2_PACKAGE_RECOVERY_UPDATEENGINEBIN
    bool "updateEngine bin"

endif
```

## buildroot/package/rockchip/recoverySystem/Config.in
```kconfig
config BR2_PACKAGE_RECOVERYSYSTEM
	bool "Rockchip recoverySystem for linux"
	help
	  Rockchip recoverySystem for linux.
```

## buildroot/package/rockchip/rk_hw_vad/Config.in
```kconfig
config BR2_PACKAGE_RK_HW_VAD
	bool "rockchip hardware vad"
	help
	  rockchip hardware vad.
```

## buildroot/package/rockchip/rk_oem/Config.in
```kconfig
config BR2_PACKAGE_RK_OEM
	bool "Rockchip OEM Partition"
	help
	  If we want to run some special applications which we do not
	  to store in root filesystem. Then we store these in the OEM
	  partition, and mount it on the root directory of "/oem".

if BR2_PACKAGE_RK_OEM

config BR2_PACKAGE_RK_OEM_RESOURCE_DIR
	string "Rockchip OEM Partition Directory"
	default ""
	help
	  Directory to store the OEM applications and resource.

	  The default is ""

config BR2_PACKAGE_RK_OEM_INSTALL_TARGET_DIR
	string "Rockchip OEM Files Install Target Directory"
	default "$(BASE_DIR)/oem"
	help
	  Directory to install the files of OEM target.

	  The default is "$(BASE_DIR)/oem"

config BR2_PACKAGE_RK_OEM_ENABLE_DEBUG
	bool "Enable OEM Target build with debug symbol"
	default n
	help
	  Enable this to build target with debug symbol.

config BR2_PACKAGE_RK_OEM_IMAGE_FILESYSTEM_TYPE
	string "Rockchip OEM Image filesystem type"
	default "ext4"
	help
	  Make oem.img with filesystem type. Support ext2 ext4 squashfs and ubi.

	  The default is "ext4"

config BR2_PACKAGE_RK_OEM_IMAGE_PARTITION_SIZE
	hex "Rockchip OEM Image Partition Size"
	default 0x0
	help
	  Configure oem partition size. Must be configured if oem filesystem type is ubi.

endif
```

## buildroot/package/rockchip/rk_webui/Config.in
```kconfig
config BR2_PACKAGE_RK_WEBUI
    bool "Rockchip web ui"
    select BR2_PACKAGE_BOA
```

## buildroot/package/rockchip/rkadk/Config.in
```kconfig
config BR2_PACKAGE_RKADK
    bool "rkadk"
    select BR2_PACKAGE_RKMEDIA
    select BR2_PACKAGE_INIPARSER
    select BR2_PACKAGE_CJSON
    select BR2_PACKAGE_RKFSMK
    help
      rkadk

if BR2_PACKAGE_RKADK
config BR2_PACKAGE_RKADK_ROCKIT
    bool "rockit"
    default n
    select BR2_PACKAGE_ROCKIT
    select BR2_PACKAGE_ROCKIT_TGI
    select BR2_PACKAGE_ROCKIT_MPI
    help
      enable rockit
endif #BR2_PACKAGE_RKADK
```

## buildroot/package/rockchip/rkaiq_tool_server/Config.in
```kconfig
config BR2_PACKAGE_RKAIQ_TOOL_SERVER
	bool "Rockchip Rkaiq Tool Server"
	help
	  Rockchip rkaiq tool server.
```

## buildroot/package/rockchip/rkbar/Config.in
```kconfig
config BR2_PACKAGE_RKBAR
	bool "QR code scan library optimized by rockchip"
	default n
	help
		rkbar library is used to scan QR code
```

## buildroot/package/rockchip/rkfacial/Config.in
```kconfig
config BR2_PACKAGE_RKFACIAL
    bool "rk facial"
    select BR2_PACKAGE_ROCKFACE
    select BR2_PACKAGE_LIBDRM
    select BR2_PACKAGE_ROCKCHIP_RGA
    select BR2_PACKAGE_SQLITE
    select BR2_PACKAGE_ALSA_LIB
    select BR2_PACKAGE_ROCKCHIP_MPP
    select BR2_PACKAGE_CAMERA_ENGINE
    select BR2_PACKAGE_JPEG
    select BR2_PACKAGE_JPEG_TURBO

config BR2_PACKAGE_RKFACIAL_USE_WEB_SERVER
    bool "use web server"
    default n
    depends on BR2_PACKAGE_RKFACIAL
    select BR2_PACKAGE_LIBIPCPROTOCOL
    select BR2_PACKAGE_LIBGDBUS

config BR2_PACKAGE_RKFACIAL_ENABLE_IR_TEST_DATA
    bool "enable ir test data"
    default n
    depends on BR2_PACKAGE_RKFACIAL

config BR2_PACKAGE_RKFACIAL_ENABLE_FACE_MASK
    bool "enable face mask"
    default n
    depends on BR2_PACKAGE_RKFACIAL
```

## buildroot/package/rockchip/rkfsmk/Config.in
```kconfig
config BR2_PACKAGE_RKFSMK
	bool "rockchip librkfsmk"
	default n
	help
	  rockchip librkfsmk
```

## buildroot/package/rockchip/rkiio/Config.in
```kconfig
menuconfig BR2_PACKAGE_RKIIO
	bool "rkiio"
	default n
	help
	    Rockchip IIO framework
```

## buildroot/package/rockchip/rkipc/Config.in
```kconfig
config BR2_PACKAGE_RKIPC
	bool "rockchip rkipc"
	select BR2_PACKAGE_CAMERA_ENGINE_RKAIQ
	help
	  rockchip rkipc

choice
prompt "Platform type"
	default BR2_PACKAGE_RKIPC_RK3588
	help
	  Select a platform type.

config BR2_PACKAGE_RKIPC_LOW_MEMORY
	bool "Compile for low memory ipc"
	select BR2_PACKAGE_ROCKIT
	depends on BR2_PACKAGE_RKIPC

config BR2_PACKAGE_RKIPC_RK3588
	bool "Compile for rk3588 ipc"
	select BR2_PACKAGE_ROCKIT
	select BR2_PACKAGE_WPA_SUPPLICANT
	depends on BR2_PACKAGE_RKIPC

config BR2_PACKAGE_RKIPC_RK3588_MULTI_IPC
	bool "Compile for rk3588 multi ipc"
	select BR2_PACKAGE_ROCKIT
	select BR2_PACKAGE_WPA_SUPPLICANT
	depends on BR2_PACKAGE_RKIPC

config BR2_PACKAGE_RKIPC_RV1126
	bool "Compile for rv1126 ipc"
	select BR2_PACKAGE_RKMEDIA
	select BR2_PACKAGE_WPA_SUPPLICANT
	depends on BR2_PACKAGE_RKIPC

config BR2_PACKAGE_RKIPC_RV1126_BATTERY_IPC
	bool "Compile for rv1126 battery ipc"
	select BR2_PACKAGE_VENDOR_STORAGE
	select BR2_PACKAGE_ROCKIT
	depends on BR2_PACKAGE_RKIPC

config BR2_PACKAGE_RKIPC_RV1126_SNAPSHOT
	bool "Compile for rv1126 snapshot"
	select BR2_PACKAGE_RKMEDIA
	depends on BR2_PACKAGE_RKIPC
endchoice
```

## buildroot/package/rockchip/rkjpeg/Config.in
```kconfig
config BR2_PACKAGE_RKJPEG
	bool "rkjpeg for Linux"
	depends on BR2_PACKAGE_LIBDRM
```

## buildroot/package/rockchip/rkmedia/Config.in
```kconfig
menuconfig BR2_PACKAGE_RKMEDIA
	bool "rkmedia"

if BR2_PACKAGE_RKMEDIA

config BR2_PACKAGE_RKMEDIA_V4L2_CAPTURE
    bool "camera capture"
    help
      wrapped function of v4l2 capture

if BR2_PACKAGE_RKMEDIA_V4L2_CAPTURE
config BR2_PACKAGE_RKMEDIA_USE_AIQ
    bool "camera capture with rkaiq api"
    select BR2_PACKAGE_CAMERA_ENGINE
    help
      camera capture with rkaiq api
endif #BR2_PACKAGE_RKMEDIA_V4L2_CAPTURE

config BR2_PACKAGE_DRM_DISPLAY_OUTPUT
    bool "drm output"
    select BR2_PACKAGE_LIBDRM
    help
      wrapped function of drm output

config BR2_PACKAGE_RKMEDIA_MPP
    bool "rk mpp wrapper"
    select BR2_PACKAGE_ROCKCHIP_MPP
    select BR2_PACKAGE_ROCKCHIP_MPP_ALLOCATOR_DRM
    help
      wrapped function of rk mpp

if BR2_PACKAGE_RKMEDIA_MPP
config BR2_PACKAGE_RKMEDIA_MPP_ENCODER
    bool "rk mpp encoder"
    default y
    help
      wrapped function of rk mpp encoder

config BR2_PACKAGE_RKMEDIA_MPP_DECODER
    bool "rk mpp decoder"
    default y
    help
      wrapped function of rk mpp decoder
endif # BR2_PACKAGE_RKMEDIA_MPP

config BR2_PACKAGE_RKMEDIA_ALSA
    bool "audio capture and playback"
    select BR2_PACKAGE_ALSA_LIB
    help
      wrapped function of alsa

if BR2_PACKAGE_RKMEDIA_ALSA
config BR2_PACKAGE_RKMEDIA_ALSA_PLAYBACK
    bool "alsa playback"
    help
      wrapped function of alsa playback

config BR2_PACKAGE_RKMEDIA_ALSA_CAPTURE
    bool "alsa capture"
    help
      wrapped function of alsa capture

config BR2_PACKAGE_RKMEDIA_AUDIO_ALGORITHM
    bool "audio algorithm"
    depends on BR2_PACKAGE_RKMEDIA_ALSA_PLAYBACK || BR2_PACKAGE_RKMEDIA_ALSA_CAPTURE
    select BR2_PACKAGE_COMMON_ALGORITHM
    select BR2_PACKAGE_COMMON_ALGORITHM_ANR
    select BR2_PACKAGE_COMMON_ALGORITHM_AEC_ANR_AGC
    default n
    help
      audio algorithm(3A and ANR) switch

config BR2_PACKAGE_RKMEDIA_AUDIO_ALGORITHM_PLUS
    bool "use audio algorithm plus"
    depends on BR2_PACKAGE_RKMEDIA_AUDIO_ALGORITHM
    default n
    help
      audio process algorithm plus version

endif # BR2_PACKAGE_RKMEDIA_ALSA

config BR2_PACKAGE_RKMEDIA_AUDIO_CODEC
    bool "audio encoder and decoder"
    select BR2_PACKAGE_RKAUDIO
    help
      wrapped function of rkaudio codec

if BR2_PACKAGE_RKMEDIA_AUDIO_CODEC
config BR2_PACKAGE_RKMEDIA_AUDIO_ENCODER
    bool "audio encoder"
    help
      wrapped function of rkaudio encoder

config BR2_PACKAGE_RKMEDIA_AUDIO_DECODER
    bool "audio decoder"
    help
      wrapped function of rkaudio decoder
endif #BR2_PACKAGE_RKMEDIA_AUDIO_CODEC

config BR2_PACKAGE_RKMEDIA_RKRGA
    bool "rkrga"
    select BR2_PACKAGE_ROCKCHIP_RGA
    help
      wrapped function of librga

config BR2_PACKAGE_RKMEDIA_RKNN
    bool "rknn"
    select BR2_PACKAGE_RKNPU
    select BR2_PACKAGE_RKNPU_USE_RKNN_API
    help
      wrapped function of rknn

config BR2_PACKAGE_RKMEDIA_ROCKFACE
    bool "rockface"
    select BR2_PACKAGE_RKNPU
    select BR2_PACKAGE_ROCKFACE
    help
      wrapped function of rockface

if BR2_PACKAGE_RKMEDIA_ROCKFACE

config BR2_PACKAGE_RKMEDIA_ROCKFACE_RECOGNIZE
    bool "enable face recognize"
    depends on BR2_PACKAGE_SQLITE
    select BR2_PACKAGE_ROCKFACE_FACE_DETECTION_V3_LARGE
    select BR2_PACKAGE_ROCKFACE_FACE_RECOGNITION
    select BR2_PACKAGE_ROCKFACE_FACE_LANDMARK
    select BR2_PACKAGE_ROCKFACE_FACE_ATTRIBUTE
    select BR2_PACKAGE_ROCKFACE_OBJECT_DETECTION
    default y
    help
        enable rockface recognize

endif # BR2_PACKAGE_RKMEDIA_ROCKFACE

config BR2_PACKAGE_RKMEDIA_ROCKX
    bool "rockx"
    select BR2_PACKAGE_RKNPU
    select BR2_PACKAGE_ROCKX
    help
      wrapped function of rockx

config BR2_PACKAGE_RKMEDIA_MOVE_DETECTION
    bool "rk movedetection wrapper"
    select BR2_PACKAGE_COMMON_ALGORITHM
    select BR2_PACKAGE_COMMON_ALGORITHM_MOVE_DETECT
    help
      wrapped function of rk movedetection algorithm

config BR2_PACKAGE_RKMEDIA_OCCLUSION_DETECTION
    bool "rk occlusion detection wrapper"
    select BR2_PACKAGE_COMMON_ALGORITHM
    select BR2_PACKAGE_COMMON_ALGORITHM_OCCLUSION_DETECT
    help
      wrapped function of rk occlusion detection algorithm


config BR2_PACKAGE_RKMEDIA_EXAMPLES
    bool "enable rkmedia examples"
    help
      provide examples to show the usage of rkmedia

if BR2_PACKAGE_RKMEDIA_EXAMPLES
config BR2_PACKAGE_RKMEDIA_UVC_EXAMPLE
    bool "enable rkmedia uvc demo"
    select BR2_PACKAGE_UVC_APP
    help
      Example of joint use of rkmedia and uvc_app interface
endif #BR2_PACKAGE_RKMEDIA_EXAMPLES

config BR2_PACKAGE_RKMEDIA_DEBUG_UTILS
    bool "utils for debug rkmedia"
	default n
    help
      compile with sanitizer or selsct minilogger

if BR2_PACKAGE_RKMEDIA_DEBUG_UTILS
config BR2_PACKAGE_RKMEDIA_SANITIZER_DYNAMIC
    bool "enable rkmedia sanitizer tools with dynamic linker"
    select BR2_PACKAGE_ADDRESS_SANITIZER
    help
      Enable rkmedia debug on sanitizer with dynamic linker.

config BR2_PACKAGE_RKMEDIA_SANITIZER_STATIC
    bool "enable rkmedia sanitizer tools with static linker"
    select BR2_PACKAGE_ADDRESS_SANITIZER
    help
      Enable rkmedia debug on sanitizer with static linker.

config BR2_PACKAGE_RKMEDIA_MINILOGGER
    bool "Output log by minilogger"
    select BR2_PACKAGE_MINILOGGER
    help
      Output log by minilogger interface

config BR2_PACKAGE_RKMEDIA_MB_TS_DEBUG
    bool "MediaBuffer TimeStamp Debug"
    default n
    help
      Time-consuming statistics of each stage of MediaBuffer

endif #BR2_PACKAGE_RKMEDIA_DEBUG_UTILS

config BR2_PACKAGE_RKMEDIA_LIVE555
    bool "live555"
    select BR2_PACKAGE_LIVE555
    help
      live555 is an rtsp server and client

if BR2_PACKAGE_RKMEDIA_LIVE555
config BR2_PACKAGE_RKMEDIA_RTSP_SERVER
    bool "rtsp server"
    help
      live555 rtsp server

if BR2_PACKAGE_RKMEDIA_RTSP_SERVER
config BR2_PACKAGE_RKMEDIA_RTSP_SERVER_H264
    bool "rtsp server h264 session"
    help
      live555 rtsp server h264 session

config BR2_PACKAGE_RKMEDIA_RTSP_SERVER_H265
    bool "rtsp server h265 session"
    help
      live555 rtsp server h265 session

endif # BR2_PACKAGE_RKMEDIA_RTSP_SERVER
endif # BR2_PACKAGE_RKMEDIA_LIVE555

config BR2_PACKAGE_RKMEDIA_MINI
    bool "rkmedia mini version"
    depends on BR2_PACKAGE_RKMEDIA_V4L2_CAPTURE
    depends on BR2_PACKAGE_RKMEDIA_USE_AIQ
    depends on BR2_PACKAGE_DRM_DISPLAY_OUTPUT
    depends on BR2_PACKAGE_RKMEDIA_RKRGA
    default n
    help
      mini version only support vi/vo/rga

config BR2_PACKAGE_RKMEDIA_SOCKET
    bool "socket"
    default n
    help
      use socket for multi process control

endif # BR2_PACKAGE_RKMEDIA
```

## buildroot/package/rockchip/rknn_demo/Config.in
```kconfig
config BR2_PACKAGE_RKNN_DEMO
	bool "rknn_demo"
	depends on BR2_TOOLCHAIN_HAS_THREADS # libv4l
	depends on BR2_USE_MMU # libv4l
	depends on !BR2_STATIC_LIBS # libv4l
	depends on BR2_INSTALL_LIBSTDCPP # libv4l
	depends on BR2_TOOLCHAIN_HEADERS_AT_LEAST_3_0 # libv4l
	select BR2_PACKAGE_JPEG
	select BR2_PACKAGE_LIBV4L
	select BR2_PACKAGE_LIBPNG
	select BR2_PACKAGE_LIBPNG_12
	select BR2_PACKAGE_JPEG
	select BR2_PACKAGE_MINIGUI
	select BR2_PACKAGE_LIBDRM
	select BR2_PACKAGE_UVC_APP

	help
	  Utility for grabbing JPEGs form V4L2 devices. This tool is
	  similar to v4l2grab available from libv4l contrib directory,
	  but provides additional features such as JPEG output.

	  http://www.twam.info/software/v4l2grab-grabbing-jpegs-from-v4l2-devices

if BR2_PACKAGE_RKNN_DEMO

choice
	prompt "rknn demo type"
	default BR2_PACKAGE_RKNN_DEMO_ENABLE_SSD
	help
	  Select a demo function type of rknn.

config BR2_PACKAGE_RKNN_DEMO_ENABLE_SSD
	bool "ssd"
	depends on BR2_PACKAGE_RKNN_DEMO

config BR2_PACKAGE_RKNN_DEMO_ENABLE_JOINT
	bool "joint"
	depends on BR2_PACKAGE_RKNN_DEMO

config BR2_PACKAGE_RKNN_DEMO_ENABLE_FRG
	bool "face recognize"
	depends on BR2_PACKAGE_RKNN_DEMO

comment "v4l2grab needs a toolchain w/ threads, dynamic library, C++ and headers >= 3.0"
	depends on BR2_USE_MMU
	depends on !BR2_TOOLCHAIN_HAS_THREADS || BR2_STATIC_LIBS \
		|| !BR2_INSTALL_LIBSTDCPP || !BR2_TOOLCHAIN_HEADERS_AT_LEAST_3_0

endchoice

endif
```

## buildroot/package/rockchip/rknpu-fw/Config.in
```kconfig
config BR2_PACKAGE_RKNPU_FW
	bool "rknpu firmware"
        depends on BR2_PACKAGE_NPU_POWERCTRL || BR2_PACKAGE_NPU_POWERCTRL_COMBINE
	help
	  "Copy rknpu firmware and upgrade"
```
