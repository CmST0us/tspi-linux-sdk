## buildroot/package/rockchip/rktoolkit/Config.in
```kconfig
config BR2_PACKAGE_RKTOOLKIT
	bool "rockchip toolkit"
	help
	  rockchip toolkit for linux

config BR2_PACKAGE_IO
	bool "io tool for linux"
	select BR2_PACKAGE_RKTOOLKIT
	help
	  io tool for linux. used to read/write register, memory

config BR2_PACKAGE_UPDATE
	bool "Rockchip OTA update for linux"
	select BR2_PACKAGE_RKTOOLKIT
	help
	  Rockchip OTA update for linux. it is just command without UI.

config BR2_PACKAGE_VENDOR_STORAGE
	bool "vendor storage tool for linux"
	select BR2_PACKAGE_RKTOOLKIT
	help
	  vendor storage tool for linux. used to read/write vendor storage.

config BR2_PACKAGE_VENDOR_STORAGE_LIBRARY
	bool "Build vendor storage library for linux application"
	select BR2_PACKAGE_RKTOOLKIT
	help
	  Build vendor storage library for linux application. Used to read/write vendor storage.
```

## buildroot/package/rockchip/rkupdate/Config.in
```kconfig
config BR2_PACKAGE_RKUPDATE
	bool "Rockchip rkupdate for linux"
	select BR2_PACKAGE_LIBPTHREAD_STUBS
	select BR2_PACKAGE_UTIL_LINUX_LIBUUID
	help
	  Rockchip rkupdate for linux.

if BR2_PACKAGE_RKUPDATE
config BR2_PACKAGE_RKUPDATE_SINGNATURE_FW
	bool "update signature firmware"
	help
		update signature firmware.

config BR2_PACKAGE_RKUPDATE_SIMULATE_ABNORMAL_POWER_OFF
	bool "simulate abnormal power off during updating fw"
	help
		simulate abnormal power off during updating fw.
endif
```

## buildroot/package/rockchip/rkwifibt-app/Config.in
```kconfig
config BR2_PACKAGE_RKWIFIBT_APP
	bool "rkwifibt wireless applicantion"
	select BR2_PACKAGE_ALSA_LIB
	select BR2_PACKAGE_BLUEZ_ALSA
	select BR2_PACKAGE_BLUEZ5_UTILS
```

## buildroot/package/rockchip/rockchip-alsa-config/Config.in
```kconfig
config BR2_PACKAGE_ROCKCHIP_ALSA_CONFIG
	bool "rockchip-alsa-config"
        depends on BR2_PACKAGE_ALSA_LIB
	help
	  Rockchip sound cards' alsa configs.
```

## buildroot/package/rockchip/rockchip-mali-nvr/Config.in
```kconfig
config BR2_PACKAGE_ROCKCHIP_MALI_NVR
	bool "rockchip-mali-nvr"
	depends on !BR2_PACKAGE_ROCKCHIP_MALI
	depends on BR2_INSTALL_LIBSTDCPP
	depends on BR2_TOOLCHAIN_USES_GLIBC
	depends on BR2_TOOLCHAIN_HAS_THREADS
	depends on BR2_aarch64 || (BR2_ARM_EABIHF && BR2_arm)
	select BR2_PACKAGE_LIBDRM
	help
	  Install the binary user-space components for the ARM Mali GPU.
	  This package requires a kernel with the ARM Mali GPU Kernel
	  Drivers enabled.

if BR2_PACKAGE_ROCKCHIP_MALI_NVR

config BR2_PACKAGE_ROCKCHIP_MALI_NVR_OPTIMIZE
	string "mali library optimize level"
	default "optimize_3"

config BR2_PACKAGE_ROCKCHIP_MALI_NVR_ARCH_DIR
	string "mali library arch dir"
	default "aarch64-linux-gnu" if BR2_aarch64
	default "arm-linux-gnueabihf"

config BR2_PACKAGE_ROCKCHIP_MALI_NVR_NAME
	string "mali library name"
	default "libmali-valhall-g610-g6p0-without-cl-dummy-gbm.so" if BR2_PACKAGE_RK3588
	default "libmali-bifrost-g52-g2p0-dummy-gbm.so" if BR2_PACKAGE_RK356X

comment "mali-nvr API features"

config BR2_PACKAGE_ROCKCHIP_MALI_NVR_HAS_EGL
	bool "OpenGL EGL"
	default y
	select BR2_PACKAGE_HAS_LIBEGL

config BR2_PACKAGE_ROCKCHIP_MALI_NVR_HAS_GBM
	bool "gbm"
	default y
	select BR2_PACKAGE_HAS_LIBGBM

config BR2_PACKAGE_ROCKCHIP_MALI_NVR_HAS_GLES
	bool "OpenGL ES"
	default y
	select BR2_PACKAGE_HAS_LIBGLES

config BR2_PACKAGE_ROCKCHIP_MALI_NVR_HAS_OPENCL
	bool "OpenCL"
	select BR2_PACKAGE_HAS_LIBOPENCL

config BR2_PACKAGE_PROVIDES_LIBEGL
	default "rockchip-mali-nvr" if BR2_PACKAGE_ROCKCHIP_MALI_NVR_HAS_EGL

config BR2_PACKAGE_PROVIDES_LIBGBM
	default "rockchip-mali-nvr" if BR2_PACKAGE_ROCKCHIP_MALI_NVR_HAS_GBM

config BR2_PACKAGE_PROVIDES_LIBGLES
	default "rockchip-mali-nvr" if BR2_PACKAGE_ROCKCHIP_MALI_NVR_HAS_GLES

config BR2_PACKAGE_PROVIDES_LIBOPENCL
	default "rockchip-mali-nvr" if BR2_PACKAGE_ROCKCHIP_MALI_NVR_HAS_OPENCL

endif
```

## buildroot/package/rockchip/rockchip-mali/Config.in
```kconfig
config BR2_PACKAGE_ROCKCHIP_MALI
	bool "rockchip-mali"
	depends on BR2_INSTALL_LIBSTDCPP
	depends on BR2_TOOLCHAIN_USES_GLIBC
	depends on BR2_TOOLCHAIN_HAS_THREADS
	depends on BR2_aarch64 || (BR2_ARM_EABIHF && BR2_arm)
	select BR2_PACKAGE_LIBDRM
	help
	  Install the binary user-space components for the ARM Mali GPU.
	  This package requires a kernel with the ARM Mali GPU Kernel
	  Drivers enabled.

if BR2_PACKAGE_ROCKCHIP_MALI

comment "mali optimize level"

choice
	prompt "optimize level"
	default BR2_PACKAGE_ROCKCHIP_MALI_OPTIMIZE_3
	help
	  Set the optimization level for rockchip-mali

config BR2_PACKAGE_ROCKCHIP_MALI_OPTIMIZE_3
	bool "optimization level 3"
	help
	  Built with -O3.

config BR2_PACKAGE_ROCKCHIP_MALI_OPTIMIZE_s
	bool "optimization level s"
	help
	  Built with -Os.

endchoice

comment "mali special configs"

config BR2_PACKAGE_ROCKCHIP_MALI_CUSTOM_PLATFORM
	string "custom platform"
	default ""

comment "mali API features"

config BR2_PACKAGE_ROCKCHIP_MALI_HAS_DUMMY
	bool "dummy winsys"
	help
	  For dummy platform.

config BR2_PACKAGE_ROCKCHIP_MALI_HAS_WAYLAND
	bool "wayland winsys"
	default y
	depends on BR2_PACKAGE_WAYLAND
	select BR2_PACKAGE_WAYLAND_WITHOUT_EGL
	help
	  For wayland platform.

config BR2_PACKAGE_ROCKCHIP_MALI_HAS_X11
	bool "X11 winsys"
	default y
	depends on BR2_PACKAGE_XORG7
	select BR2_PACKAGE_LIBXCB
	select BR2_PACKAGE_XLIB_LIBX11
	help
	  For X11 platform.

config BR2_PACKAGE_ROCKCHIP_MALI_HAS_GBM
	bool "GBM"
	default y if !BR2_PACKAGE_ROCKCHIP_MALI_HAS_DUMMY
	select BR2_PACKAGE_HAS_LIBGBM
	select BR2_PACKAGE_LIBGBM_HAS_FEATURE_FORMAT_MODIFIER_PLANE_COUNT
	select BR2_PACKAGE_LIBGBM_HAS_FEATURE_DMA_BUF
	help
	  For GBM platform.

config BR2_PACKAGE_ROCKCHIP_MALI_HAS_EGL
	bool "OpenGL EGL"
	default y
	select BR2_PACKAGE_HAS_LIBEGL

config BR2_PACKAGE_ROCKCHIP_MALI_HAS_EGL_WAYLAND
	bool "OpenGL EGL Wayland"
	default y
	depends on BR2_PACKAGE_ROCKCHIP_MALI_HAS_EGL
	depends on BR2_PACKAGE_ROCKCHIP_MALI_HAS_WAYLAND
	select BR2_PACKAGE_HAS_LIBEGL_WAYLAND

config BR2_PACKAGE_ROCKCHIP_MALI_HAS_GLES
	bool "OpenGL ES"
	default y
	select BR2_PACKAGE_HAS_LIBGLES

config BR2_PACKAGE_ROCKCHIP_MALI_HAS_OPENCL
	bool "OpenCL"
	default y
	select BR2_PACKAGE_HAS_LIBOPENCL

config BR2_PACKAGE_ROCKCHIP_MALI_HAS_VULKAN
	bool "Vulkan"
	select BR2_PACKAGE_VULKAN_LOADER

config BR2_PACKAGE_PROVIDES_LIBEGL
	default "rockchip-mali" if BR2_PACKAGE_ROCKCHIP_MALI_HAS_EGL

config BR2_PACKAGE_PROVIDES_LIBGBM
	default "rockchip-mali" if BR2_PACKAGE_ROCKCHIP_MALI_HAS_GBM

config BR2_PACKAGE_PROVIDES_LIBGLES
	default "rockchip-mali" if BR2_PACKAGE_ROCKCHIP_MALI_HAS_GLES

config BR2_PACKAGE_PROVIDES_LIBOPENCL
	default "rockchip-mali" if BR2_PACKAGE_ROCKCHIP_MALI_HAS_OPENCL

endif
```

## buildroot/package/rockchip/rockchip-mpp/Config.in
```kconfig
menuconfig BR2_PACKAGE_ROCKCHIP_MPP
	bool "rockchip-mpp"
	select BR2_PACKAGE_LIBDRM
	help
	  Rockchip MPP(Multimedia Processing Platform).

if BR2_PACKAGE_ROCKCHIP_MPP

config BR2_PACKAGE_ROCKCHIP_MPP_ALLOCATOR_DRM
	bool "drm allocator"
	help
	  Use drm allocator.

config BR2_PACKAGE_ROCKCHIP_MPP_TESTS
	bool "test programs"
	default n
	help
	  Install the test programs.

endif
```

## buildroot/package/rockchip/rockchip-rga/Config.in
```kconfig
config BR2_PACKAGE_ROCKCHIP_RGA
	bool "rockchip-rga"
	select BR2_PACKAGE_LIBDRM
	help
	  Rockchip RGA 2D accelerator userspace library.

if BR2_PACKAGE_ROCKCHIP_RGA
config BR2_PREFER_ROCKCHIP_RGA
	bool "prefer using rockchip-rga"
	# HACK: Use ISP3 to detect RGA3
	default y if !BR2_PACKAGE_ROCKCHIP_HAS_ISP3
	help
	  Prefer using rockchip-rga when available.
endif
```

## buildroot/package/rockchip/rockchip_modules/Config.in
```kconfig
config BR2_PACKAGE_ROCKCHIP_MODULES
    bool "rockchip modules"

if BR2_PACKAGE_ROCKCHIP_MODULES

config BR2_PACKAGE_ROCKCHIP_MODULES_EXT4
    bool "ext4 filesystem support"
config BR2_PACKAGE_ROCKCHIP_MODULES_FAT
    bool "fat filesystem support"
config BR2_PACKAGE_ROCKCHIP_MODULES_NTFS
    bool "ntfs filesystem support"
config BR2_PACKAGE_ROCKCHIP_MODULES_GSLX680_D708
    bool "gslx680_d708 touchpad support"
endif
```

## buildroot/package/rockchip/rockchip_test/Config.in
```kconfig
config BR2_PACKAGE_ROCKCHIP_TEST
	bool  "stress test tools"
	select BR2_PACKAGE_STRESSAPPTEST
	select BR2_PACKAGE_DHRYSTONE
	select BR2_PACKAGE_MEMTESTER
	select BR2_PACKAGE_BASH
	select BR2_PACKAGE_IPERF
	select BR2_PACKAGE_SOX
	help
		function test for Rockchip stress test
```

## buildroot/package/rockchip/rockface/Config.in
```kconfig
menuconfig BR2_PACKAGE_ROCKFACE
    bool "rockface"
    select BR2_PACKAGE_RKNPU

if BR2_PACKAGE_ROCKFACE

config BR2_PACKAGE_ROCKFACE_FACE_DETECTION
    bool "Face detection support"
    default n
    help
        Face detection support

config BR2_PACKAGE_ROCKFACE_FACE_DETECTION_V2
    bool "Face detection v2 support"
    default n
    help
        Face detection v2 support

config BR2_PACKAGE_ROCKFACE_FACE_DETECTION_V3
    bool "Face detection v3 support"
    default n
    help
        Face detection v3 support

config BR2_PACKAGE_ROCKFACE_FACE_DETECTION_V3_FAST
    bool "Face detection v3 fast support"
    default n
    help
        Face detection v3 fast support

config BR2_PACKAGE_ROCKFACE_FACE_DETECTION_V3_LARGE
    bool "Face detection v3 large support"
    default y
    help
        Face detection v3 large support

config BR2_PACKAGE_ROCKFACE_FACE_RECOGNITION
    bool "Face recognition support"
    default y
    help
        Face recognition support

config BR2_PACKAGE_ROCKFACE_FACE_LANDMARK
    bool "Face landmark support"
    default y
    help
        Face landmark support

config BR2_PACKAGE_ROCKFACE_FACE_ATTRIBUTE
    bool "Face attribute support"
    default y
    help
        Face attribute support

config BR2_PACKAGE_ROCKFACE_LIVING_DETECTION
    bool "Living detection support"
    default n
    help
        Living detection support

config BR2_PACKAGE_ROCKFACE_OBJECT_DETECTION
    bool "Object detection support"
    default y
    help
        Object detection support

config BR2_PACKAGE_ROCKFACE_MASK_CLASSIFY
    bool "Mask classify support"
    default n
    help
        Mask classify support

config BR2_PACKAGE_ROCKFACE_MASK_LANDMARKS
    bool "Mask landmarks support"
    default n
    help
        Mask landmarks support

config BR2_PACKAGE_ROCKFACE_MASK_RECOGNITION
    bool "Mask recognition support"
    default n
    help
        Mask recognition support

config BR2_PACKAGE_ROCKFACE_MASKS_DETECTION
    bool "Masks detetion support"
    default n
    help
        Masks detection support

endif # BR2_PACKAGE_ROCKFACE
```

## buildroot/package/rockchip/rockit/Config.in
```kconfig
config BR2_PACKAGE_ROCKIT
	bool "rockit"
	depends on BR2_PACKAGE_ROCKCHIP_MPP
	depends on BR2_PACKAGE_ALSA_PLUGINS
	default n
	help
		rockit
```

## buildroot/package/rockchip/rockx/Config.in
```kconfig
config BR2_PACKAGE_ROCKX
	bool "rockx"
	select BR2_PACKAGE_RKNPU
	help
	  rockchip rknn library

if BR2_PACKAGE_ROCKX

config BR2_PACKAGE_ROCKX_CARPLATE_RELATIVE
    bool "Rockx carplate support"
    default n
    help
        Rockx carplate support

config BR2_PACKAGE_ROCKX_FACE_DETECTION
    bool "Rockx face detection support"
    default y
    help
        Rockx face detection support

config BR2_PACKAGE_ROCKX_FACE_RECOGNITION
    bool "Rockx face recognition support"
    default n
    help
        Rockx face recognition support

config BR2_PACKAGE_ROCKX_FACE_LANDMARK
    bool "Rockx face landmark support"
    default y
    help
        Rockx face landmark support

config BR2_PACKAGE_ROCKX_FACE_ATTRIBUTE
    bool "Rockx ace attribute support"
    default n
    help
        Rockx face attribute support

config BR2_PACKAGE_ROCKX_HEAD_DETECTION
    bool "Rockx head detection support"
    default n
    help
        Rockx head detection support


config BR2_PACKAGE_ROCKX_OBJECT_DETECTION
    bool "Rockx object detection support"
    default n
    help
        Rockx object detection support

config BR2_PACKAGE_ROCKX_POSE_BODY
    bool "Rockx pose body support"
    default y
    help
        Rockx pose body support

config BR2_PACKAGE_ROCKX_POSE_FINGER
    bool "Rockx pose finger support"
    default y
    help
        Rockx pose finger support

config BR2_PACKAGE_ROCKX_POSE_HAND
    bool "Rockx pose hand support"
    default n
    help
        Rockx pose hand support

config BR2_PACKAGE_ROCKX_TB
    bool "Enable thunder boot"

config BR2_PACKAGE_ROCKX_PERSON_DETECTION
    bool "Rockx person detection support"
    default n
    help
        Rockx person detection support

endif # BR2_PACKAGE_ROCKX
```

## buildroot/package/rockchip/rootfs_ubi_use_custom_filesystem/Config.in
```kconfig
config BR2_PACKAGE_ROOTFS_UBI_USE_CUSTOM_FILESYSTEM
	bool "Customize filesystem over ubi"
	select BR2_TARGET_ROOTFS_UBI_USE_CUSTOM_CONFIG

config BR2_PACKAGE_ROOTFS_UBI_CUSTOM_FILESYSTEM
	string "Tell build system which filesystem image should be used as ubinize input file (ubifs or squashfs)"
	default "ubifs"
```

## buildroot/package/rockchip/ros/Config.in
```kconfig
menuconfig BR2_PACKAGE_ROS_SUPPORT_SET
	bool "ros BSP package"
    depends on BR2_PACKAGE_PYTHON
    depends on BR2_PACKAGE_BOOST

if BR2_PACKAGE_ROS_SUPPORT_SET
choice
	default BR2_PACKAGE_ROS_INDIGO
	prompt "ros package support"

config BR2_PACKAGE_ROS_KINETIC
	bool "kinetic"
	help
		used ros with version kinetic

config BR2_PACKAGE_ROS_INDIGO
	bool "indigo"
	help
		used ros with version indigo

endchoice
source "package/rockchip/ros/geometry2/Config.in"
source "package/rockchip/ros/vision-opencv/Config.in"

source "package/rockchip/ros/dynamic-reconfigure/Config.in"
source "package/rockchip/ros/actionlib/Config.in"
source "package/rockchip/ros/ros-comm/Config.in"
source "package/rockchip/ros/python-ros/Config.in"
source "package/rockchip/ros/common-msgs/Config.in"
source "package/rockchip/ros/roscpp-core/Config.in"
source "package/rockchip/ros/ros/Config.in"
source "package/rockchip/ros/ros-comm-msgs/Config.in"
source "package/rockchip/ros/geometry/Config.in"
source "package/rockchip/ros/catkin/Config.in.host"
source "package/rockchip/ros/catkin/Config.in"
source "package/rockchip/ros/pluginlib/Config.in"
source "package/rockchip/ros/message-runtime/Config.in"
source "package/rockchip/ros/console-bridge/Config.in"
source "package/rockchip/ros/gencpp/Config.in"
source "package/rockchip/ros/genlisp/Config.in"
source "package/rockchip/ros/genmsg/Config.in"
source "package/rockchip/ros/genpy/Config.in"
source "package/rockchip/ros/angles/Config.in"
source "package/rockchip/ros/class-loader/Config.in"
source "package/rockchip/ros/cmake_modules/Config.in"
source "package/rockchip/ros/rospack/Config.in"
source "package/rockchip/ros/orocos_kinematics_dynamics/Config.in"
source "package/rockchip/ros/image-common/Config.in"
source "package/rockchip/ros/bond-core/Config.in"
source "package/rockchip/ros/nodelet-core/Config.in"

if BR2_PACKAGE_ROS_KINETIC
source "package/rockchip/ros/std-msgs/Config_kinetic.in"
source "package/rockchip/ros/message-generation/Config_kinetic.in"
source "package/rockchip/ros/geneus/Config.in"
source "package/rockchip/ros/gennodejs/Config.in"
source "package/rockchip/ros/libuvc/Config.in"
source "package/rockchip/ros/libuvc-ros/Config.in"

endif

if BR2_PACKAGE_ROS_INDIGO
source "package/rockchip/ros/std-msgs/Config_indigo.in"
source "package/rockchip/ros/message-generation/Config_indigo.in"
source "package/rockchip/ros/hector-slam/Config.in"
source "package/rockchip/ros/laser-geometry/Config.in"

endif

endif
```
