## buildroot/package/rockchip/ros/actionlib/Config.in
```kconfig
config BR2_PACKAGE_ACTIONLIB
	bool "actionlib"
	depends on BR2_PACKAGE_HOST_CATKIN
    select BR2_PACKAGE_COMMON_MSGS_SET
	select BR2_PACKAGE_ACTIONLIB_MSGS
    select BR2_PACKAGE_ROS_COMM_SET
	select BR2_PACKAGE_ROSCPP
	select BR2_PACKAGE_BOOST_THREAD
	select BR2_PACKAGE_BOOST_CHRONO
	select BR2_PACKAGE_BOOST_FILESYSTEM
	select BR2_PACKAGE_BOOST_SIGNALS
	help
		The actionlib package provides a standardized interface for interfacing with preemptible tasks. Examples of this include moving the base to a target location, performing a laser scan and returning the resulting point cloud, detecting the handle of a door, etc.

config BR2_PACKAGE_ACTIONLIB_ENABLE_TEST
	bool "actionlib test for ros"
	depends on BR2_PACKAGE_ACTIONLIB
	select BR2_PACKAGE_ROSTEST
	help
		enalbe actionlib test
```

## buildroot/package/rockchip/ros/angles/Config.in
```kconfig
config BR2_PACKAGE_ANGLES
    bool "angles"
    depends on BR2_PACKAGE_HOST_CATKIN
    help
        This package provides a set of simple math utilities
        to work with angles
```

## buildroot/package/rockchip/ros/bond-core/Config.in
```kconfig
menuconfig BR2_PACKAGE_BOND_CORE_SET
	bool "ros bond-core"
	depends on BR2_PACKAGE_HOST_CATKIN

if BR2_PACKAGE_BOND_CORE_SET
source "package/rockchip/ros/bond-core/bond/Config.in"
source "package/rockchip/ros/bond-core/bondpy/Config.in"
source "package/rockchip/ros/bond-core/smclib/Config.in"
source "package/rockchip/ros/bond-core/bond-core/Config.in"
source "package/rockchip/ros/bond-core/bondcpp/Config.in"
source "package/rockchip/ros/bond-core/test-bond/Config.in"
endif
```

## buildroot/package/rockchip/ros/bond-core/bond/Config.in
```kconfig
config BR2_PACKAGE_BOND
	bool "bond"
	select BR2_PACKAGE_MESSAGE_GENERATION
	select BR2_PACKAGE_STD_MSGS
	help
		bond
```

## buildroot/package/rockchip/ros/bond-core/bondcpp/Config.in
```kconfig
config BR2_PACKAGE_BONDCPP
	bool "bondcpp"
	select BR2_PACKAGE_BOND
	select BR2_PACKAGE_CMAKE_MODULES
	select BR2_PACKAGE_ROSCPP
	select BR2_PACKAGE_SMCLIB
	depends on BR2_PACKAGE_UTIL_LINUX_LIBUUID
	help
		bondcpp
```
