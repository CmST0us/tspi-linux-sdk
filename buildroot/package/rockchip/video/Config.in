## buildroot/package/rockchip/video/Config.in
```kconfig
config BR2_PACKAGE_VIDEO
	bool "video"
	depends on BR2_PACKAGE_QT5
	help
	  Rockchip video application based on QT
```

## buildroot/package/rongpin/Config.in
```kconfig
source "package/rongpin/deviceTest/Config.in"
source "package/rongpin/mobileNet/Config.in"
```

## buildroot/package/rongpin/deviceTest/Config.in
```kconfig
config BR2_PACKAGE_DEVICETEST
    bool "deviceTest"
    help
        this is a app for rpdzkj function test
```

## buildroot/package/rongpin/mobileNet/Config.in
```kconfig
config BR2_PACKAGE_4G
	bool "Rongpin 4G-daemon for linux"
	help
	  Rongpin 4G-daemon for linux
```

## buildroot/package/shadow/Config.in
```kconfig
menuconfig BR2_PACKAGE_SHADOW
	bool "shadow"
	depends on BR2_TOOLCHAIN_HEADERS_AT_LEAST_4_14
	help
	  Utilities to deal with user accounts.

	  https://github.com/shadow-maint/shadow

if BR2_PACKAGE_SHADOW

config BR2_PACKAGE_SHADOW_SHADOWGRP
	bool "shadowgrp"
	default y
	help
	  Enable shadow group support.

if BR2_PACKAGE_LINUX_PAM

config BR2_PACKAGE_SHADOW_ACCOUNT_TOOLS_SETUID
	bool "account-tools-setuid"
	help
	  Install the user and group management tools setuid and authenticate the
	  callers.

endif # BR2_PACKAGE_LINUX_PAM

config BR2_PACKAGE_SHADOW_UTMPX
	bool "utmpx"
	help
	  Enable loggin in utmpx / wtmpx.

config BR2_PACKAGE_SHADOW_SUBORDINATE_IDS
	bool "subordinate-ids"
	default y
	help
	  Support subordinate ids.

config BR2_PACKAGE_SHADOW_SHA_CRYPT
	bool "sha-crypt"
	default y
	help
	  Allow the SHA256 and SHA512 password encryption algorithms.

config BR2_PACKAGE_SHADOW_BCRYPT
	bool "bcrypt"
	help
	  Allow the bcrypt password encryption algorithm.

config BR2_PACKAGE_SHADOW_YESCRYPT
	bool "yescrypt"
	help
	  Allow the yescrypt password encryption algorithm.

config BR2_PACKAGE_SHADOW_NSCD
	bool "nscd"
	default y
	help
	  Enable support for nscd.

config BR2_PACKAGE_SHADOW_SSSD
	bool "sssd"
	default y
	help
	  Define to support flushing of sssd caches.

config BR2_PACKAGE_SHADOW_GROUP_NAME_MAX_LENGTH
	int "group-name-max-length"
	default 16
	help
	  Set max group name length. (0 equals infinity)

config BR2_PACKAGE_SHADOW_SU
	bool "su"
	default y
	help
	  Build and install su program.

endif # BR2_PACKAGE_SHADOW

comment "shadow needs a toolchain w/ headers >= 4.14"
	depends on !BR2_TOOLCHAIN_HEADERS_AT_LEAST_4_14
```

## buildroot/package/source-han-sans/Config.in
```kconfig
# Source Han Sans Fonts

menu "Source Han Sans Fonts"
	source "package/source-han-sans/source-han-sans-cn/Config.in"
	source "package/source-han-sans/source-han-sans-hk/Config.in"
	source "package/source-han-sans/source-han-sans-jp/Config.in"
	source "package/source-han-sans/source-han-sans-kr/Config.in"
	source "package/source-han-sans/source-han-sans-tw/Config.in"
endmenu
```

## buildroot/package/source-han-sans/source-han-sans-cn/Config.in
```kconfig
config BR2_PACKAGE_SOURCE_HAN_SANS_CN
	bool "Source Han Sans CN"
	help
	  Adobe OpenType Pan-CJK font family for Simplified Chinese.

	  https://github.com/adobe-fonts/source-han-sans
```

## buildroot/package/source-han-sans/source-han-sans-hk/Config.in
```kconfig
config BR2_PACKAGE_SOURCE_HAN_SANS_HK
	bool "Source Han Sans HK"
	help
	  Adobe OpenType Pan-CJK font family for Traditional Chinese(Hong Kong).

	  https://github.com/adobe-fonts/source-han-sans
```

## buildroot/package/source-han-sans/source-han-sans-jp/Config.in
```kconfig
config BR2_PACKAGE_SOURCE_HAN_SANS_JP
	bool "Source Han Sans JP"
	help
	  Adobe OpenType Pan-CJK font family for Japanese.

	  https://github.com/adobe-fonts/source-han-sans
```

## buildroot/package/source-han-sans/source-han-sans-kr/Config.in
```kconfig
config BR2_PACKAGE_SOURCE_HAN_SANS_KR
	bool "Source Han Sans KR"
	help
	  Adobe OpenType Pan-CJK font family for Korean.

	  https://github.com/adobe-fonts/source-han-sans
```

## buildroot/package/source-han-sans/source-han-sans-tw/Config.in
```kconfig
config BR2_PACKAGE_SOURCE_HAN_SANS_TW
	bool "Source Han Sans TW"
	help
	  Adobe OpenType Pan-CJK font family for Traditional Chinese(Tai Wan).

	  https://github.com/adobe-fonts/source-han-sans
```

## buildroot/package/spirv-headers/Config.in
```kconfig
config BR2_PACKAGE_SPIRV_HEADERS
	bool "spirv-headers"
	help
	  Machine-readable files for the SPIR-V Registry.

	  https://github.com/KhronosGroup/SPIRV-Headers
```

## buildroot/package/spirv-tools/Config.in
```kconfig
config BR2_PACKAGE_SPIRV_TOOLS
	bool "spirv-tools"
	depends on BR2_PACKAGE_SPIRV_HEADERS
	help
	  An API and commands for processing SPIR-V modules.

	  https://github.com/KhronosGroup/SPIRV-Tools
```

## buildroot/package/stressapptest/Config.in
```kconfig
config BR2_PACKAGE_STRESSAPPTEST
	bool "stressapptest"
	help
	  Stressful Application Test - userspace memory and IO test.

	  https://github.com/stressapptest/stressapptest
```

## buildroot/package/unixbench/Config.in
```kconfig
config BR2_PACKAGE_UNIXBENCH
	bool "UnixBench"
	select BR2_PACKAGE_PERL
	select BR2_PACKAGE_MAKE
	help

	UnixBench is the original BYTE UNIX benchmark suite, updated and
	revised by many people over the years.

	https://github.com/kdlucas/byte-unixbench
```

## buildroot/package/usbmount/Config.in
```kconfig
config BR2_PACKAGE_USBMOUNT
	bool "usbmount"
	depends on BR2_USE_MMU # lockfile-progs -> liblockfile
	depends on BR2_PACKAGE_HAS_UDEV
	select BR2_PACKAGE_LOCKFILE_PROGS
	help
	  The usbmount package automatically mounts USB mass storage
	  devices when they are plugged in, and unmounts them when
	  they are removed.

	  https://wiki.debian.org/usbmount

comment "usbmount requires udev to be enabled"
	depends on BR2_USE_MMU
	depends on !BR2_PACKAGE_HAS_UDEV

if BR2_PACKAGE_USBMOUNT

config BR2_PACKAGE_USBMOUNT_SYNC_MOUNT
	bool "mount with sync option"
	default n
	help
	  The "sync" option may not be a good choice to use with flash
	  drives, as it forces a greater amount of writing operating on
	  the drive. This makes the writing speed considerably lower
	  and also leads to a faster wear out of the disk.

	  If you omit it, don't forget to use the command "sync" to
	  synchronize the data on your disk before removing the drive
	  or you may experience data loss.

endif
```

## buildroot/package/usbmuxd/Config.in
```kconfig
config BR2_PACKAGE_USBMUXD
	bool "usbmuxd"
	select BR2_PACKAGE_LIBUSB
	select BR2_PACKAGE_LIBIMOBILEDEVICE
	select BR2_PACKAGE_LIBIMOBILEDEVICE_GLUE
	help
	  A socket daemon to multiplex connections from and to iOS devices.

	  http://www.libimobiledevice.org/
```

## buildroot/package/vkmark/Config.in
```kconfig
config BR2_PACKAGE_VKMARK
	bool "vkmark"
	select BR2_PACKAGE_ASSIMP
	select BR2_PACKAGE_GLM
	select BR2_PACKAGE_VULKAN_LOADER
	help
	  An extensible Vulkan benchmarking suite.

	  https://github.com/vkmark/vkmark
```

## buildroot/package/vulkan-loader/Config.in
```kconfig
config BR2_PACKAGE_VULKAN_LOADER
	bool "vulkan-loader"
	select BR2_PACKAGE_VULKAN_HEADERS
	help
	  The Khronos official Vulkan ICD desktop loader.

	  https://github.com/KhronosGroup/Vulkan-Loader
```

## buildroot/package/vulkan-tools/Config.in
```kconfig
config BR2_PACKAGE_VULKAN_TOOLS
	bool "vulkan-tools"
	select BR2_PACKAGE_VULKAN_LOADER
	help
	  The Khronos official Vulkan Tools and Utilities.

	  https://github.com/KhronosGroup/Vulkan-Tools
```

## buildroot/package/wayland-utils/Config.in
```kconfig
config BR2_PACKAGE_WAYLAND_UTILS
	bool "wayland-utils"
	default y if BR2_PACKAGE_WAYLAND
	depends on BR2_PACKAGE_WAYLAND # wayland-client, wayland-server
	select BR2_PACKAGE_WAYLAND_PROTOCOLS
	help
	  Wayland utils (wayland-info).

	  https://gitlab.freedesktop.org/ofourdan/wayland-utils
```

## buildroot/package/xcursor-themes/Config.in
```kconfig
config BR2_PACKAGE_XCURSOR_THEMES
	bool "xcursor-themes"
	select BR2_PACKAGE_XLIB_LIBXCURSOR if BR2_PACKAGE_XORG7
	help
	  No description available
```
