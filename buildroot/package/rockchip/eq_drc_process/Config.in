## buildroot/package/rockchip/extra-cmake-modules/Config.in
```kconfig
config BR2_PACKAGE_EXTRA_CMAKE_MODULES
	bool "KDE Extra CMake Modules package, or ECM"
	help
	The Extra CMake Modules package, or ECM, adds to the modules provided by CMake
```

## buildroot/package/rockchip/face_detect/Config.in
```kconfig
config BR2_PACKAGE_FACE_DETECT
    bool "face detect"
    select BR2_PACKAGE_RKNPU
    select BR2_PACKAGE_LIBDRM
    select BR2_PACKAGE_ROCKCHIP_RGA
    select BR2_PACKAGE_CAMERA_ENGINE
```

## buildroot/package/rockchip/ficial_gate/Config.in
```kconfig
config BR2_PACKAGE_FICIAL_GATE
    bool "ficial gate"
    select BR2_PACKAGE_RKFACIAL
    select BR2_PACKAGE_LIBDRM
    select BR2_PACKAGE_ROCKCHIP_RGA
    select BR2_PACKAGE_TSLIB
    select BR2_PACKAGE_LIBPNG
    select BR2_PACKAGE_LIBPNG_12
    select BR2_PACKAGE_JPEG
    select BR2_PACKAGE_MINIGUI
    select BR2_PACKAGE_FREETYPE
```

## buildroot/package/rockchip/gallery/Config.in
```kconfig
config BR2_PACKAGE_GALLERY
	bool "gallery"
	depends on BR2_PACKAGE_QT5
	help
	  Rockchip gallery application based on QT
```

## buildroot/package/rockchip/gstreamer1-iep/Config.in
```kconfig
config BR2_PACKAGE_GSTREAMER1_IEP_DEINTERLACE
	bool "Gstreamer IEP deinterlace plugins"
	depends on BR2_PACKAGE_ROCKCHIP_MPP
	select BR2_PACKAGE_GST1_PLUGINS_BASE
	help
	  GStreamer iep offers the hardware deinterlace
          for Rockchip Platform.
```

## buildroot/package/rockchip/gstreamer1-rockchip/Config.in
```kconfig
config BR2_PACKAGE_GSTREAMER1_ROCKCHIP
	bool "gstreamer1-rockchip"
	depends on BR2_PACKAGE_ROCKCHIP_MPP
	depends on BR2_PACKAGE_GST1_PLUGINS_BASE
	help
	  Gstreamer Rockchip plugins
```

## buildroot/package/rockchip/iflytekSDK/Config.in
```kconfig
config BR2_PACKAGE_IFLYTEKSDK
    select BR2_PACKAGE_CJSON
    bool "Simple iflytek voice process and cloud SDK"
```

## buildroot/package/rockchip/ipc-daemon/Config.in
```kconfig
config BR2_PACKAGE_IPC_DAEMON
	bool "ipc-daemon app"
	help
	  daemon app for ip camera, monitor ipc processes and process system commands

if BR2_PACKAGE_IPC_DAEMON

config BR2_PACKAGE_IPC_DAEMON_MINILOGGER
	bool "enable ipc-daemon miniloger print"
	select BR2_PACKAGE_MINILOGGER
	default y
	help
	  Enable ipc-daemon miniloger print.

endif # BR2_PACKAGE_IPC_DAEMON
```

## buildroot/package/rockchip/ipc_share_memory/Config.in
```kconfig
config BR2_PACKAGE_IPC_SHARE_MEMORY
	bool "ipc using share memory"
	help
	  ipc using share memory.
```

## buildroot/package/rockchip/ipcweb-backend/Config.in
```kconfig
config BR2_PACKAGE_IPCWEB_BACKEND
	bool "ipcweb backend for Linux"
	select BR2_PACKAGE_LIBCGICC
	select BR2_PACKAGE_OPENSSL
	select BR2_PACKAGE_JSON_FOR_MODERN_CPP
	select BR2_PACKAGE_MINILOGGER
	help
		ipcweb backend for Linux

if BR2_PACKAGE_IPCWEB_BACKEND

config BR2_PACKAGE_IPCWEB_BACKEND_JWT
        bool "jwt in ipcweb backend"
        default y
        help
                enable jwt in ipcweb backend

choice
prompt "select main application"
	default BR2_PACKAGE_IPCWEB_BACKEND_USE_MEDIASERVER
	help
	  Select main application.

config BR2_PACKAGE_IPCWEB_BACKEND_USE_MEDIASERVER
	bool "use mediaserver"
	select BR2_PACKAGE_LIBRKDB
	select BR2_PACKAGE_LIBGDBUS
	select BR2_PACKAGE_LIBIPCPROTOCOL

config BR2_PACKAGE_IPCWEB_BACKEND_USE_RKIPC
	bool "use rkipc"
endchoice

endif # BR2_PACKAGE_IPCWEB_BACKEND
```

## buildroot/package/rockchip/isp2-ipc/Config.in
```kconfig
menuconfig BR2_PACKAGE_ISP2_IPC
	bool "Rockchip ISP Server"
	help
	  Rockchip ISP server

if BR2_PACKAGE_ISP2_IPC

config BR2_PACKAGE_ISP2_IPC_DBUS
    bool "enable ispserver to use dbus communication"
    select BR2_PACKAGE_LIBGDBUS
    help
      Use dbus communication

config BR2_PACKAGE_ISP2_IPC_DBSERVER
    bool "enable ispserver to use dbserver"
    depends on BR2_PACKAGE_ISP2_IPC_DBUS
    select BR2_PACKAGE_LIBRKDB
    help
      Use database to save configuration

config BR2_PACKAGE_ISP2_IPC_MINILOGGER
    bool "enable ispserver miniloger print"
    select BR2_PACKAGE_MINILOGGER
    help
      Enable ispserver miniloger print.

config BR2_PACKPAG_ISP2_IPC_FORCE_INSTALL_TO_ROOTFS
    bool "ispserver install to rootfs"
    default n
    help
      Ispserver install to rootfs.

config BR2_PACKPAG_ISP2_IPC_CALL_FUNC
    bool "enable ispserver call func"
    default n
    help
      Enable ispserver using Call FUNC

endif # BR2_PACKAGE_ISP2_IPC
```

## buildroot/package/rockchip/jpegdemo/Config.in
```kconfig
config BR2_PACKAGE_JPEG_DEMO
	bool "hw jpeg test for Linux"
	depends on BR2_PACKAGE_LIBDRM
```

## buildroot/package/rockchip/kernel_modules/Config.in
```kconfig
config BR2_PACKAGE_KERNEL_MODULES
	bool "Kernel modules that match with rockchip kernel"
	help
	  Build modules from rockchip kernel source.

if BR2_PACKAGE_KERNEL_MODULES
config BR2_PACKAGE_KERNEL_DEFCONFIG
	string "Defconfig name of rockchip kernel"
	default "rockchip_linux"
	help
	  The name of defconfig without '_defconfig'. The default
	  is rockchip_linux_defconfig
endif
```

## buildroot/package/rockchip/kwindowsystem/Config.in
```kconfig
config BR2_PACKAGE_KWINDOWSYSTEM
	bool "KDE KWindowSystem"
	help
	KWindowSystem provides information about the windowing system and allows interaction with the windowing system
```

## buildroot/package/rockchip/led_control_app/Config.in
```kconfig
config BR2_PACKAGE_LED_CONTROL_APP
	bool "Rockchip Led control app for linux"
	help
	  Rockchip Led control app for linux.
```

## buildroot/package/rockchip/libIPCProtocol/Config.in
```kconfig
menuconfig BR2_PACKAGE_LIBIPCPROTOCOL
	bool "rockchip libIPCProtocol"
	select BR2_PACKAGE_LIBGDBUS
	select BR2_PACKAGE_LIBRKDB
	select BR2_PACKAGE_DBUS_CPP
	help
	  rockchip libIPCProtocol

if BR2_PACKAGE_LIBIPCPROTOCOL

config BR2_PACKAGE_LIBIPCPROTOCOL_DEMO
	bool "rockchip libIPCProtocol demo"
	help
	  provide demo to show the usage of libIPCProtocol

config BR2_PACKAGE_LIBIPCPROTOCOL_FORCE_INSTALL_TO_ROOTFS
        bool "rockchip libIPCProtocol install to rootfs"
        default n
        help
          Rockchip libIPCProtocol install to rootfs.
endif
```

## buildroot/package/rockchip/libavb/Config.in
```kconfig
config BR2_PACKAGE_LIBAVB
	bool "Rockchip libavb for linux"
	help
	  Rockchip libavb for linux.
```

## buildroot/package/rockchip/libavb_ab/Config.in
```kconfig
config BR2_PACKAGE_LIBAVB_AB
	bool "Rockchip libavb_ab for linux"
	help
	  Rockchip libavb_ab for linux.
```

## buildroot/package/rockchip/libavb_user/Config.in
```kconfig
config BR2_PACKAGE_LIBAVB_USER
	bool "Rockchip libavb_user for linux"
	help
	  Rockchip libavb_user for linux.
```

## buildroot/package/rockchip/libgdbus/Config.in
```kconfig
menuconfig BR2_PACKAGE_LIBGDBUS
	bool "libgdbus"
	select BR2_PACKAGE_LIBGLIB2
	select BR2_PACKAGE_DBUS
	help
	  libgdbus library

if BR2_PACKAGE_LIBGDBUS

config BR2_PACKAGE_LIBGDBUS_FORCE_INSTALL_TO_ROOTFS
	bool "libgdbus install to rootfs"
	default n
	help
	  libgdbus library install to rootfs.

endif
```

## buildroot/package/rockchip/librkdb/Config.in
```kconfig
menuconfig BR2_PACKAGE_LIBRKDB
	bool "rockchip librkdb"
	select BR2_PACKAGE_LIBGLIB2
	select BR2_PACKAGE_SQLITE
	select BR2_PACKAGE_JSON_C
	help
	  rockchip database library

if BR2_PACKAGE_LIBRKDB

config BR2_PACKAGE_LIBRKDB_FORCE_INSTALL_TO_ROOTFS
	bool "rockchip librkdb install to rootfs"
	default n
	help
	  rockchip database library install to rootfs.

endif
```

## buildroot/package/rockchip/libv4l-rkmpp/Config.in
```kconfig
config BR2_PACKAGE_LIBV4L_RKMPP
	bool "A rockchip-mpp V4L2 wrapper plugin for chromium V4L2 VDA"
	depends on BR2_PACKAGE_LIBV4L
	depends on BR2_PACKAGE_ROCKCHIP_MPP
	help
	  A V4L2 plugin that wraps rockchip-mpp for the chromium's V4L2 VDA.
	  The original idea comes from v4l-gst.

	  https://github.com/JeffyCN/libv4l-rkmpp
```

## buildroot/package/rockchip/linux-serial-test/Config.in
```kconfig
config BR2_PACKAGE_LINUX_SERIAL_TEST
	bool "linux-serial-test"
	help
	  Linux Serial Test Application

	  https://github.com/cbrake/linux-serial-test
```
