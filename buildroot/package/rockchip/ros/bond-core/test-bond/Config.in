## buildroot/package/rockchip/ros/bond-core/test-bond/Config.in
```kconfig
config BR2_PACKAGE_TEST_BOND
	bool "test bond"
	select BR2_PACKAGE_CMAKE_MODULES
	select BR2_PACKAGE_BONDCPP
	select BR2_PACKAGE_MESSAGE-GENERATION
	select BR2_PACKAGE_ROSTEST
	help
		test bond
```

## buildroot/package/rockchip/ros/catkin/Config.in
```kconfig
config BR2_PACKAGE_CATKIN
    bool "catkin"
    depends on BR2_PACKAGE_HOST_CATKIN
    help
        catkin
```

## buildroot/package/rockchip/ros/catkin/Config.in.host
```kconfig
config BR2_PACKAGE_HOST_CATKIN
	bool "catkin host tool for ROS"
    depends on BR2_PACKAGE_PYTHON_ROS_SET
	select BR2_PACKAGE_HOST_PYTHON_CATKIN_PKG
	select BR2_PACKAGE_HOST_PYTHON_EM
	select BR2_PACKAGE_HOST_PYTHON_EMPY
	help
		A CMake-based build system that is used to build all packages in ROS
```

## buildroot/package/rockchip/ros/class-loader/Config.in
```kconfig
config BR2_PACKAGE_CLASS_LOADER
	bool "class-loader for ros"
	depends on BR2_PACKAGE_HOST_CATKIN
    depends on BR2_PACKAGE_POCO
	select BR2_PACKAGE_BOOST_SYSTEM
	select BR2_PACKAGE_BOOST_THREAD
	select BR2_PACKAGE_CONSOLE_BRIDGE
	select BR2_PACKAGE_CMAKE_MODULES
	help
		The class_loader package is a ROS-independent package
		for loading plugins during runtime and the foundation
		of the higher level ROS "pluginlib" library.
		class_loader utilizes the host operating system's
		runtime loader to open runtime libraries
		(e.g. .so/.dll files), introspect the library for
		exported plugin classes, and allows users to
		instantiate objects of said exported classes without
		the explicit declaration (i.e. header file) for those
		classes.
```

## buildroot/package/rockchip/ros/cmake_modules/Config.in
```kconfig
config BR2_PACKAGE_CMAKE_MODULES
	bool "cmake modules for ros"
	depends on BR2_PACKAGE_HOST_CATKIN
	help
		cmake modules for ros
```

## buildroot/package/rockchip/ros/common-msgs/Config.in
```kconfig
menuconfig BR2_PACKAGE_COMMON_MSGS_SET
    bool "ros common-msgs"
    depends on BR2_PACKAGE_HOST_CATKIN
    select BR2_PACKAGE_ROSCPP_CORE_SET
    select BR2_PACKAGE_CPP_COMMON
    select BR2_PACKAGE_ROSCPP_SERIALIZATION
    select BR2_PACKAGE_MESSAGE_GENERATION
    select BR2_PACKAGE_MESSAGE_RUNTIME
    select BR2_PACKAGE_STD_MSGS

if BR2_PACKAGE_COMMON_MSGS_SET
source "package/rockchip/ros/common-msgs/actionlib-msgs/Config.in"
source "package/rockchip/ros/common-msgs/geometry-msgs/Config.in"
source "package/rockchip/ros/common-msgs/sensor-msgs/Config.in"
source "package/rockchip/ros/common-msgs/common-msgs/Config.in"
source "package/rockchip/ros/common-msgs/diagnostic-msgs/Config.in"
source "package/rockchip/ros/common-msgs/nav-msgs/Config.in"
source "package/rockchip/ros/common-msgs/shape-msgs/Config.in"
source "package/rockchip/ros/common-msgs/stereo-msgs/Config.in"
source "package/rockchip/ros/common-msgs/trajectory-msgs/Config.in"
source "package/rockchip/ros/common-msgs/visualization-msgs/Config.in"

endif
```

## buildroot/package/rockchip/ros/common-msgs/actionlib-msgs/Config.in
```kconfig
config BR2_PACKAGE_ACTIONLIB_MSGS
	bool "actionlib-msgs for ros"
	help
		actionlib_msgs defines the common messages to interact with an action server and an action client. For full documentation of the actionlib API see the actionlib package.
```

## buildroot/package/rockchip/ros/common-msgs/common-msgs/Config.in
```kconfig
config BR2_PACKAGE_COMMON_MSGS
    bool "common-msgs"
    help
        common-msgs
```

## buildroot/package/rockchip/ros/common-msgs/diagnostic-msgs/Config.in
```kconfig
config BR2_PACKAGE_DIAGNOSTIC_MSGS
    bool "diagnostic-msgs"
    help
        This package holds the diagnostic message which provide
        the standardized interface for the diagnostic and
        runtime monitoring systems in ROS
```

## buildroot/package/rockchip/ros/common-msgs/geometry-msgs/Config.in
```kconfig
config BR2_PACKAGE_GEOMETRY_MSGS
    bool "geometry-msgs"
    select BR2_PACKAGE_MESSAGE_GENERATION
    select BR2_PACKAGE_STD_MSGS
    select BR2_PACKAGE_GTEST
    help
        geometry-msgs provides messages for common geometric primitives
        such as points, vectors, and poses
```

## buildroot/package/rockchip/ros/common-msgs/nav-msgs/Config.in
```kconfig
config BR2_PACKAGE_NAV_MSGS
    bool "nav-msgs"
    select BR2_PACKAGE_ACTIONLIB_MSGS
    select BR2_PACKAGE_GEOMETRY_MSGS
    help
        nav msgs defines the common messages used to interact
        with the navigation stack
```

## buildroot/package/rockchip/ros/common-msgs/sensor-msgs/Config.in
```kconfig
config BR2_PACKAGE_SENSOR_MSGS
    bool "sensor-msgs"
    select BR2_PACKAGE_GEOMETRY_MSGS
    help
        This package defines message for commonly used sensors,
        including cameras and scanning laser rangefinders
```

## buildroot/package/rockchip/ros/common-msgs/shape-msgs/Config.in
```kconfig
config BR2_PACKAGE_SHAPE_MSGS
    bool "shape-msgs"
    select BR2_PACKAGE_GEOMETRY_MSGS
    help
        This package contains messages for defining shapes, such
        as simple solid object primitives (cube, sphere, etc),
        planes, and meshes
```

## buildroot/package/rockchip/ros/common-msgs/stereo-msgs/Config.in
```kconfig
config BR2_PACKAGE_STEREO_MSGS
    bool "stereo-msgs"
    select BR2_PACKAGE_SENSOR_MSGS
    help
        stereo msgs contains messages specific to stereo processing
```

## buildroot/package/rockchip/ros/common-msgs/trajectory-msgs/Config.in
```kconfig
config BR2_PACKAGE_TRAJECTORY_MSGS
    bool "trajectory-msgs"
    select BR2_PACKAGE_GEOMETRY_MSGS
    help
        This package defines messages for defining rebot trajectoryies
```

## buildroot/package/rockchip/ros/common-msgs/visualization-msgs/Config.in
```kconfig
config BR2_PACKAGE_VISUALIZATION_MSGS
    bool "visualization-msgs"
    select BR2_PACKAGE_GEOMETRY_MSGS
    help
        visualization msgs is a set of messages used by higher
        level packages, such as rviz, that deal in visualization-
        specific data
```

## buildroot/package/rockchip/ros/console-bridge/Config.in
```kconfig
config BR2_PACKAGE_CONSOLE_BRIDGE
	bool "console_bridge for ros"
	depends on BR2_PACKAGE_HOST_CATKIN
    select BR2_PACKAGE_BOOST_SYSTEM
    select BR2_PACKAGE_BOOST_THREAD
	help
	  console_bridge is a ROS-independent, pure CMake (i.e. non-catkin and non-rosbuild package) that provides logging calls that mirror those found in rosconsole, but for applications that are not necessarily using ROS.
```

## buildroot/package/rockchip/ros/dynamic-reconfigure/Config.in
```kconfig
config BR2_PACKAGE_DYNAMIC_RECONFIGURE
    bool "dynamic reconfigure"
    depends on BR2_PACKAGE_HOST_CATKIN
    depends on BR2_PACKAGE_ROSPACK
    depends on BR2_PACKAGE_BOOST
    select BR2_PACKAGE_BOOST_CHRONO
    select BR2_PACKAGE_ROS_COMM_SET
    select BR2_PACKAGE_ROSCPP
    select BR2_PACKAGE_ROSLIB
    select BR2_PACKAGE_ROSTEST
    select BR2_PACKAGE_PYTHON_ROSPKG
    help
        This unary stack contains the dynamic_reconfigure package
        which provides a means to change node parameters at any
        time without having to restart the nodede
```

## buildroot/package/rockchip/ros/gencpp/Config.in
```kconfig
config BR2_PACKAGE_GENCPP
	bool "gencpp for ROS"
	depends on BR2_PACKAGE_HOST_CATKIN
	select BR2_PACKAGE_GENMSG
	help
		ROS C++ message definition and serialization generators
```

## buildroot/package/rockchip/ros/geneus/Config.in
```kconfig
config BR2_PACKAGE_GENEUS
	bool "geneus"
	select BR2_PACKAGE_GENMSG
	help
		EusLisp ROS message and service generators.
```

## buildroot/package/rockchip/ros/genlisp/Config.in
```kconfig
config BR2_PACKAGE_GENLISP
	bool "genlisp for ROS"
	depends on BR2_PACKAGE_HOST_CATKIN
	select BR2_PACKAGE_GENMSG
	help
		Lisp message generation for ROS
```

## buildroot/package/rockchip/ros/genmsg/Config.in
```kconfig
config BR2_PACKAGE_GENMSG
	bool "genmsg for ROS"
	depends on BR2_PACKAGE_HOST_CATKIN
	help
		Standalone Python library for generating ROS message and service data structures for various languages
```

## buildroot/package/rockchip/ros/gennodejs/Config.in
```kconfig
config BR2_PACKAGE_GENNODEJS
	bool "gennodejs"
	select BR2_PACKAGE_GENMSG
	help
		Javascript ROS message and service generators.
```

## buildroot/package/rockchip/ros/genpy/Config.in
```kconfig
config BR2_PACKAGE_GENPY
	bool "genpy for ROS"
	depends on BR2_PACKAGE_HOST_CATKIN
	select BR2_PACKAGE_GENMSG
	help
		The Python ROS message and service generator
```

## buildroot/package/rockchip/ros/geometry/Config.in
```kconfig
menuconfig BR2_PACKAGE_GEOMETRY_SET
    bool "geometry"
    depends on BR2_PACKAGE_HOST_CATKIN

if BR2_PACKAGE_GEOMETRY_SET
source "package/rockchip/ros/geometry/eigen-conversions/Config.in"
source "package/rockchip/ros/geometry/tf/Config.in"
source "package/rockchip/ros/geometry/geometry/Config.in"
source "package/rockchip/ros/geometry/kdl-conversions/Config.in"
source "package/rockchip/ros/geometry/tf-conversions/Config.in"
endif
```
