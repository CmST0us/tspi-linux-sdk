## buildroot/package/rockchip/ros/geometry/eigen-conversions/Config.in
```kconfig
config BR2_PACKAGE_EIGEN_CONVERSIONS
    bool "eigen conversions"
    depends on BR2_PACKAGE_OROCOS_KDL
    select BR2_PACKAGE_CMAKE_MODULES
    select BR2_PACKAGE_COMMON_MSGS_SET
    select BR2_PACKAGE_GEOMETRY_MSGS
    select BR2_PACKAGE_STD_MSGS

    help
        Conversion functions between Eigen and KDL, and Eigen and
        geometry_msgs
```

## buildroot/package/rockchip/ros/geometry/kdl-conversions/Config.in
```kconfig
config BR2_PACKAGE_KDL_CONVERSIONS
    bool "kdl-conversions"
    select BR2_PACKAGE_GEOMETRY_MSGS
    depends on BR2_PACKAGE_OROCOS_KDL
    help
        Conversion functions between KDL and geometry_msgs types
```

## buildroot/package/rockchip/ros/geometry/tf-conversions/Config.in
```kconfig
config BR2_PACKAGE_TF_CONVERSIONS
    bool "tf-conversions"
    depends on BR2_PACKAGE_OROCOS_KDL
    select BR2_PACKAGE_CMAKE_MODULES
    select BR2_PACKAGE_COMMON_MSGS_SET
    select BR2_PACKAGE_GEOMETRY_MSGS
    help
        This package contains a set of conversion functions to
        convert common tf datatypes (point, vector, pose, etc)
        into semantically identical datatypes used by other
        libraries
```

## buildroot/package/rockchip/ros/geometry/tf/Config.in
```kconfig
config BR2_PACKAGE_TF
    bool "tf"
    depends on BR2_PACKAGE_GEOMETRY2_SET
    select BR2_PACKAGE_TF2_ROS
    select BR2_PACKAGE_ANGLES
    select BR2_PACKAGE_COMMON_MSGS_SET
    select BR2_PACKAGE_GEOMETRY_MSGS
    select BR2_PACKAGE_SENSOR_MSGS
    select BR2_PACKAGE_ROS_COMM_SET
    select BR2_PACKAGE_MESSAGE_FILTERS
    select BR2_PACKAGE_ROSCONSOLE
    select BR2_PACKAGE_ROSCPP
    select BR2_PACKAGE_ROSCPP_CORE_SET
    select BR2_PACKAGE_ROSTIME
    select BR2_PACKAGE_STD_MSGS
    select BR2_PACKAGE_MESSAGE_GENERATION
    help
        tf is a package that lets the user keep track of
        multiple coordinate frames over time
```

## buildroot/package/rockchip/ros/geometry2/Config.in
```kconfig
menuconfig BR2_PACKAGE_GEOMETRY2_SET
    bool "geometry2"
    depends on BR2_PACKAGE_HOST_CATKIN
    depends on BR2_PACKAGE_ROSPACK

if BR2_PACKAGE_GEOMETRY2_SET
source "package/rockchip/ros/geometry2/tf2-sensor-msgs/Config.in"

source "package/rockchip/ros/geometry2/tf2-tools/Config.in"
source "package/rockchip/ros/geometry2/tf2-kdl/Config.in"
source "package/rockchip/ros/geometry2/tf2-geometry-msgs/Config.in"
source "package/rockchip/ros/geometry2/tf2-py/Config.in"
source "package/rockchip/ros/geometry2/tf2-ros/Config.in"
source "package/rockchip/ros/geometry2/tf2/Config.in"
source "package/rockchip/ros/geometry2/geometry2/Config.in"
source "package/rockchip/ros/geometry2/tf2-msgs/Config.in"
endif
```

## buildroot/package/rockchip/ros/geometry2/geometry2/Config.in
```kconfig
config BR2_PACKAGE_GEOMETRY2
    bool "geometry2"
    depends on BR2_PACKAGE_HOST_CATKIN
    help
        A metapackage to bring in the default packages second generation Transform Library in ros, tf2.
```

## buildroot/package/rockchip/ros/geometry2/tf2-geometry-msgs/Config.in
```kconfig
config BR2_PACKAGE_TF2_GEOMETRY_MSGS
    bool "tf2-geometry-msgs"
    depends on BR2_PACKAGE_EIGEN
    select BR2_PACKAGE_OROCOS_KDL
    select BR2_PACKAGE_TF2_ROS
    help
        tf2-geometry-msgs
```

## buildroot/package/rockchip/ros/geometry2/tf2-kdl/Config.in
```kconfig
config BR2_PACKAGE_TF2_KDL
    bool "tf2-kdl"
    depends on BR2_PACKAGE_EIGEN
    select BR2_PACKAGE_TF2_ROS
    help
        KDL binding for tf2
```

## buildroot/package/rockchip/ros/geometry2/tf2-msgs/Config.in
```kconfig
config BR2_PACKAGE_TF2_MSGS
    bool "tf2-msgs"
    select BR2_PACKAGE_MESSAGE_GENERATION
    select BR2_PACKAGE_COMMON_MSGS_SET
    select BR2_PACKAGE_GEOMETRY_MSGS
    select BR2_PACKAGE_ACTIONLIB_MSGS
    select BR2_PACKAGE_BOOST_THREAD
    help
        tf2-msgs
```

## buildroot/package/rockchip/ros/geometry2/tf2-py/Config.in
```kconfig
config BR2_PACKAGE_TF2_PY
    bool "tf2-py"
    select BR2_PACKAGE_ROS_COMM_SET
    select BR2_PACKAGE_ROSPY
    select BR2_PACKAGE_TF2
    help
        The tf2_py package
```

## buildroot/package/rockchip/ros/geometry2/tf2-ros/Config.in
```kconfig
config BR2_PACKAGE_TF2_ROS
    bool "tf2-ros"
    select BR2_PACKAGE_TF2
    select BR2_PACKAGE_TF2_MSGS
    select BR2_PACKAGE_TF2_PY
    select BR2_PACKAGE_ACTIONLIB
    select BR2_PACKAGE_COMMON_MSGS_SET
    select BR2_PACKAGE_ACTIONLIB_MSGS
    select BR2_PACKAGE_GEOMETRY_MSGS
    select BR2_PACKAGE_ROS_COMM_SET
    select BR2_PACKAGE_MESSAGE_FILTERS
    select BR2_PACKAGE_ROSCPP
    select BR2_PACKAGE_ROSGRAPH
    select BR2_PACKAGE_ROSPY

    help
        This package contains the ROS bindings for the tf2 library, for both Python and C++.
```

## buildroot/package/rockchip/ros/geometry2/tf2-sensor-msgs/Config.in
```kconfig
config BR2_PACKAGE_TF2_SENSOR_MSGS
    bool "tf2-sensor-msgs"
    depends on BR2_PACKAGE_EIGEN
    select BR2_PACKAGE_CMAKE_MODULES
    select BR2_PACKAGE_COMMON_MSGS_SET
    select BR2_PACKAGE_SENSOR_MSGS
    select BR2_PACKAGE_TF2_ROS
    select BR2_PACKAGE_BOOST_THREAD

    help
        Small lib to transform sensor msgs with tf
```

## buildroot/package/rockchip/ros/geometry2/tf2-tools/Config.in
```kconfig
config BR2_PACKAGE_TF2_TOOLS
    bool "tf2-tools"
    select BR2_PACKAGE_TF2_ROS
    help
        tf2-tools
```

## buildroot/package/rockchip/ros/geometry2/tf2/Config.in
```kconfig
config BR2_PACKAGE_TF2
    bool "tf2"
    depends on BR2_PACKAGE_HOST_CATKIN
    select BR2_PACKAGE_TF2_MSGS
    select BR2_PACKAGE_BOOST_SIGNALS
    select BR2_PACKAGE_BOOST_THREAD
    select BR2_PACKAGE_BOOST_SYSTEM
    select BR2_PACKAGE_ROSCPP_CORE_SET
    select BR2_PACKAGE_ROSTIME
    select BR2_PACKAGE_COMMON_MSGS_SET
    select BR2_PACKAGE_GEOMETRY_MSGS
    select BR2_PACKAGE_CONSOLE_BRIDGE
    select BR2_PACKAGE_GTEST
    help
        tf2 is the second generation of the transform library, which lets
        the user keep track of multiple coordinate frames over time.
```

## buildroot/package/rockchip/ros/hector-slam/Config.in
```kconfig
menuconfig BR2_PACKAGE_HECTOR_SLAM_SET
	bool "hector slam set"
	depends on BR2_PACKAGE_HOST_CATKIN

if BR2_PACKAGE_HECTOR_SLAM_SET
source "package/rockchip/ros/hector-slam/hector-slam/Config.in"
source "package/rockchip/ros/hector-slam/hector-map-tools/Config.in"
source "package/rockchip/ros/hector-slam/hector-compressed-map-transport/Config.in"
source "package/rockchip/ros/hector-slam/hector-nav-msgs/Config.in"
source "package/rockchip/ros/hector-slam/hector-geotiff/Config.in"
source "package/rockchip/ros/hector-slam/hector-geotiff-plugins/Config.in"
source "package/rockchip/ros/hector-slam/hector-imu-attitude-to-tf/Config.in"
source "package/rockchip/ros/hector-slam/hector-imu-tools/Config.in"
source "package/rockchip/ros/hector-slam/hector-mapping/Config.in"
source "package/rockchip/ros/hector-slam/hector-map-server/Config.in"
source "package/rockchip/ros/hector-slam/hector-marker-drawing/Config.in"
source "package/rockchip/ros/hector-slam/hector-slam-launch/Config.in"
source "package/rockchip/ros/hector-slam/hector-trajectory-server/Config.in"
endif
```

## buildroot/package/rockchip/ros/hector-slam/hector-compressed-map-transport/Config.in
```kconfig
config BR2_PACKAGE_HECTOR_COMPRESSED_MAP_TRANSPORT
	bool "hector compressed map transport"
	depends on BR2_PACKAGE_EIGEN
	depends on BR2_PACKAGE_OPENCV
	depends on BR2_PACKAGE_CV_BRIDGE
	depends on BR2_PACKAGE_IMAGE_TRANSPORT
	select BR2_PACKAGE_CMAKE_MODULES
	select BR2_PACKAGE_GEOMETRY_MSGS
	select BR2_PACKAGE_COMMON_MSGS_SET
	select BR2_PACKAGE_GEOMETRY_MSGS
	select BR2_PACKAGE_HECTOR_MAP_TOOLS
	select BR2_PACKAGE_NAV_MSGS
	select BR2_PACKAGE_SENSOR_MSGS

	help
		hector compressed map transport
```

## buildroot/package/rockchip/ros/hector-slam/hector-geotiff-plugins/Config.in
```kconfig
config BR2_PACKAGE_HECTOR_GEOTIFF_PLUGINS
	bool "hector geotiff plugins"
	select BR2_PACKAGE_HECTOR_NAV_MSGS
	depends on BR2_PACKAGE_HECTOR_GEOTIFF
	help
		hector geotiff plugins
```

## buildroot/package/rockchip/ros/hector-slam/hector-geotiff/Config.in
```kconfig
config BR2_PACKAGE_HECTOR_GEOTIFF
	bool "hector geotiff"
	select BR2_PACKAGE_COMMON_MSGS_SET
	select BR2_PACKAGE_NAV_MSGS
	select BR2_PACKAGE_CMAKE_MODULES
	select BR2_PACKAGE_HECTOR_MAP_TOOLS
	select BR2_PACKAGE_HECTOR_NAV_MSGS
	depends on BR2_PACKAGE_PLUGINLIB
	select BR2_PACKAGE_ROSCPP
	select BR2_PACKAGE_STD_MSGS
	depends on BR2_PACKAGE_QT
	select BR2_PACKAGE_QT_GUI_MODULE
	select BR2_PACKAGE_QT_STL
	help
		hector geotiff
```

## buildroot/package/rockchip/ros/hector-slam/hector-imu-attitude-to-tf/Config.in
```kconfig
config BR2_PACKAGE_HECTOR_IMU_ATTITUDE_TO_TF
	bool "hector imu attitude to tf"
	depends on BR2_PACKAGE_ROSPACK
	select BR2_PACKAGE_ROS_COMM_SET
	select BR2_PACKAGE_ROSCPP
	select BR2_PACKAGE_GEOMETRY_SET
	select BR2_PACKAGE_TF
	select BR2_PACKAGE_COMMON_MSGS_SET
	select BR2_PACKAGE_SENSOR_MSGS
	
	help
		hector imu attitude to tf
```

## buildroot/package/rockchip/ros/hector-slam/hector-imu-tools/Config.in
```kconfig
config BR2_PACKAGE_HECTOR_IMU_TOOLS
	bool "hector imu tools"
	depends on BR2_PACKAGE_ROSPACK
	select BR2_PACKAGE_ROS_COMM_SET
	select BR2_PACKAGE_ROSCPP
	select BR2_PACKAGE_GEOMETRY_SET
	select BR2_PACKAGE_TF
	select BR2_PACKAGE_COMMON_MSGS_SET
	select BR2_PACKAGE_SENSOR_MSGS
	select BR2_PACKAGE_GEOMETRY_MSGS
	
	help
		hector imu imu tools
```

## buildroot/package/rockchip/ros/hector-slam/hector-map-server/Config.in
```kconfig
config BR2_PACKAGE_HECTOR_MAP_SERVER
	bool "hector map server"
	select BR2_PACKAGE_ROS_COMM_SET
	select BR2_PACKAGE_ROSCPP
	select BR2_PACKAGE_HECTOR_MAP_TOOLS
	select BR2_PACKAGE_HECTOR_MARKER_DRAWING
	select BR2_PACKAGE_HECTOR_NAV_MSGS
	select BR2_PACKAGE_COMMON_MSGS_SET
	select BR2_PACKAGE_NAV_MSGS
	depends on BR2_PACKAGE_TF

	help
		hector map server
```

## buildroot/package/rockchip/ros/hector-slam/hector-map-tools/Config.in
```kconfig
config BR2_PACKAGE_HECTOR_MAP_TOOLS
	bool "hector map tools"
	select BR2_PACKAGE_COMMON_MSGS_SET
	select BR2_PACKAGE_NAV_MSGS
	help
		hector map tools
```

## buildroot/package/rockchip/ros/hector-slam/hector-mapping/Config.in
```kconfig
config BR2_PACKAGE_HECTOR_MAPPING
	bool "hector mapping"
	select BR2_PACKAGE_CMAKE_MODULES
	select BR2_PACKAGE_ROS_COMM_SET
	select BR2_PACKAGE_ROSCPP
	select BR2_PACKAGE_MESSAGE_FILTERS
	select BR2_PACKAGE_COMMON_MSGS_SET
	select BR2_PACKAGE_NAV_MSGS
	select BR2_PACKAGE_VISUALIZATION_MSGS
	depends on BR2_PACKAGE_ROSPACK
	select BR2_PAKCAGE_GEOMETRY_SET
	select BR2_PACKAGE_TF
	depends on BR2_PACKAGE_LASER_GEOMETRY
	depends on BR2_PACKAGE_TF_CONVERSIONS
	select BR2_PACKAGE_GENERATION
	help
		hector mapping
```

## buildroot/package/rockchip/ros/hector-slam/hector-marker-drawing/Config.in
```kconfig
config BR2_PACKAGE_HECTOR_MARKER_DRAWING
	bool "hector marker drawing"
	select BR2_PACKAGE_CMAKE_MODULES
	select BR2_PACKAGE_ROS_COMM_SET
	select BR2_PACKAGE_ROSCPP
	select BR2_PACKAGE_COMMON_MSGS
	select BR2_PACKAGE_VISUALIZATION_MSGS
	help
		hector marker drawing
```
