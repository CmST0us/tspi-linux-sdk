## buildroot/package/rockchip/ros/vision-opencv/Config.in
```kconfig
menuconfig BR2_PACKAGE_VISION_OPENCV_SET
    bool "vision opencv"
    depends on BR2_PACKAGE_HOST_CATKIN

if BR2_PACKAGE_VISION_OPENCV_SET

if BR2_PACKAGE_ROS_INDIGO
source "package/rockchip/ros/vision-opencv/cv-bridge/Config_indigo.in"
endif

if BR2_PACKAGE_ROS_KINETIC
source "package/rockchip/ros/vision-opencv/cv-bridge/Config_kinetic.in"
endif

endif
```

## buildroot/package/rockchip/rv1108_package/Config.in
```kconfig
if BR2_PACKAGE_RV1108

menu "RV1108 Package"

# BSP packages
menu "Application packages"
source "package/rockchip/rv1108_package/app/Config.in"
endmenu

menu "Framework packages"
source "package/rockchip/rv1108_package/framework/Config.in"
endmenu

menu "External packages"
source "package/rockchip/rv1108_package/external/Config.in"
endmenu

endmenu

endif
```

## buildroot/package/rockchip/rv1108_package/app/Config.in
```kconfig
if BR2_PACKAGE_RV1108

# BSP packages
source "package/rockchip/rv1108_package/app/at_server/Config.in"
source "package/rockchip/rv1108_package/app/device_manager/Config.in"
source "package/rockchip/rv1108_package/app/face_service/Config.in"
source "package/rockchip/rv1108_package/app/lock/Config.in"
source "package/rockchip/rv1108_package/app/pcba_test/Config.in"
source "package/rockchip/rv1108_package/app/updater/Config.in"
source "package/rockchip/rv1108_package/app/rv1108_uvc_app/Config.in"
source "package/rockchip/rv1108_package/app/system_manager/Config.in"
source "package/rockchip/rv1108_package/app/cvr/Config.in"

endif
```

## buildroot/package/rockchip/rv1108_package/app/at_server/Config.in
```kconfig
if BR2_PACKAGE_RV1108

# BSP packages
config BR2_PACKAGE_AT_SERVER
	bool "rv1108 package at server"
	select BR2_PACKAGE_MESSENGER
endif
```

## buildroot/package/rockchip/rv1108_package/app/cvr/Config.in
```kconfig
if BR2_PACKAGE_RV1108

# BSP packages
config BR2_PACKAGE_CVR
	bool "RV1108 package CVR application"
	select BR2_PACKAGE_RKCAMERA
	select BR2_PACKAGE_RKFB
	select BR2_PACKAGE_MESSENGER
	select BR2_PACKAGE_PROCESS_UNITS
	select BR2_PACKAGE_LIBPNG
	select BR2_PACKAGE_LIBPNG_12
	select BR2_PACKAGE_RV1108_MINIGUI
	select BR2_PACKAGE_TSLIB
	select BR2_PACKAGE_JPEG
	select BR2_PACKAGE_RKNR
	select BR2_PACKAGE_HAL

if BR2_PACKAGE_CVR
menu "cvr setting options"

	config BR2_PACKAGE_CVR_VIDEO_RECORD
		bool "support video record."
		default y
		select BR2_PACKAGE_ADK_RKMEDIA
		select BR2_PACKAGE_ADK_RKMEDIA_H264_ENCODE
		select BR2_PACKAGE_ADK_RKMEDIA_MP4_MUXER

	config BR2_PACKAGE_CVR_RTSP_STREAM
		bool "support rtsp stream."
		default n
		select BR2_PACKAGE_ADK_RKMEDIA
		select BR2_PACKAGE_ADK_RKMEDIA_H264_ENCODE
		select BR2_PACKAGE_ADK_RKMEDIA_RTSP_STREAM
endmenu
endif

endif
```

## buildroot/package/rockchip/rv1108_package/app/device_manager/Config.in
```kconfig
if BR2_PACKAGE_RV1108

# BSP packages
config BR2_PACKAGE_DEVICE_MANAGER
	bool "rv1108 package device manager"
	select BR2_PACKAGE_HAL

if BR2_PACKAGE_DEVICE_MANAGER
menu "device manager setting options"

config BR2_PACKAGE_DEVICE_MANAGER_IPC_NANOMSG
	bool "ipc nanomsg support"
	select BR2_PACKAGE_ADK
	select BR2_PACKAGE_MESSENGER

config BR2_PACKAGE_DEVICE_MANAGER_STORAGE_DEVICE
        bool "storage device support"
       default y

config BR2_PACKAGE_DEVICE_MANAGER_WLAN_DEVICE
       bool "wlan device support"
       default y

endmenu
endif

endif
```

## buildroot/package/rockchip/rv1108_package/app/face_service/Config.in
```kconfig
if BR2_PACKAGE_RV1108

# BSP packages
config BR2_PACKAGE_FACE_SERVICE
	bool "RV1108 package face_sevice"
	select BR2_PACKAGE_MESSENGER
	select BR2_PACKAGE_CAMERAHAL
	select BR2_PACKAGE_DATABASE
	select BR2_PACKAGE_SQLITE
	select BR2_PACKAGE_ADK
	select BR2_PACKAGE_HAL
	select BR2_PACKAGE_RKCAMERA
	select BR2_PACKAGE_PROCESS_UNITS
	select BR2_PACKAGE_RKFB
	select BR2_PACKAGE_ROCKCHIP_RGA
	select BR2_PACKAGE_RKFACE

if BR2_PACKAGE_FACE_SERVICE
menu "face_service setting options"

    config BR2_PACKAGE_FACE_SERVICE_MAX_FEATURE_OF_USER
        int "Extract multiple face features when registering."
        default 3

    config BR2_PACKAGE_FACE_SERVICE_FACE_CAPTURE
        bool "Enable Face Capture"
        default n
        select BR2_PACKAGE_ROCKCHIP_MPP
        select BR2_PACKAGE_RKMEDIA
        select BR2_PACKAGE_RKMEDIA_MPP
        select BR2_PACKAGE_RKMEDIA_MPP_ENCODER

    config BR2_PACKAGE_FACE_SERVICE_USE_UVC
        bool "use UVC"
        default n
        select BR2_PACKAGE_ROCKCHIP_MPP
        select BR2_PACKAGE_LIBRKUVC
        select BR2_PACKAGE_LIBRKUVC_CONFIG_UVC_RGA

    config BR2_PACKAGE_FACE_SERVICE_USE_MJPEG_CAMERA
        bool "use MJPEG camera"
        default n
        select BR2_PACKAGE_ROCKCHIP_MPP

endmenu
endif

endif
```

## buildroot/package/rockchip/rv1108_package/app/lock/Config.in
```kconfig
if BR2_PACKAGE_RV1108

# BSP packages
config BR2_PACKAGE_LOCK
	bool "rv1108 package lock"
	select BR2_PACKAGE_MESSENGER
	select BR2_PACKAGE_LIBPNG
	select BR2_PACKAGE_LIBPNG_12
	select BR2_PACKAGE_RV1108_MINIGUI
	select BR2_PACKAGE_TSLIB
	select BR2_PACKAGE_JPEG

if BR2_PACKAGE_LOCK
menu "lock app setting options"

choice
	prompt "Lock APP ui project"
	default BR2_PACKAGE_LOCK_UI_SAMPLE
	help
	  Select a product type to use.

config BR2_PACKAGE_LOCK_UI_PROJECT1
	bool "project1"
	help
	  Product Type: project1.

config BR2_PACKAGE_LOCK_UI_SAMPLE
	bool "sample"
	help
	  Product Type: sample.
endchoice

config BR2_PACKAGE_LOCK_PROJECT_TYPE
	string
	default "PROJECT1"    if BR2_PACKAGE_LOCK_UI_PROJECT1
	default "SAMPLE"      if BR2_PACKAGE_LOCK_UI_SAMPLE
	help
	  type: PROJECT1/SAMPLE

config BR2_PACKAGE_LOCK_ENABLE_SCREEN_CAPTURE
	bool "Enable screen capture"
	default n
	help
	  enable the function of screen capture

config BR2_PACKAGE_LOCK_ENABLE_DISP_HOLD
	bool "Enable disp hold"
	default y
	help
	  By application control when it can be displayed

endmenu
endif

endif
```

## buildroot/package/rockchip/rv1108_package/app/pcba_test/Config.in
```kconfig
if BR2_PACKAGE_RV1108

# BSP packages
config BR2_PACKAGE_PCBA_TEST
	bool "rv1108 package pcba_test"
	select BR2_PACKAGE_TINYALSA
	select BR2_PACKAGE_STRESSAPPTEST
	select BR2_PACKAGE_MEMTESTER
	select BR2_PACKAGE_UPDATER
	select BR2_PACKAGE_RV1108_SOFTAPDEMO
	select BR2_PACKAGE_RV1108_SOFTAPSERVER
	select BR2_PACKAGE_ROCKCHIP_RGA

if BR2_PACKAGE_PCBA_TEST
menu "rv1108 pcba_test options"

    config BR2_PACKAGE_PCBA_TEST_PCTOOL_APP
        bool "use pcba pc tool"
        default y

    config BR2_PACKAGE_PCBA_TEST_SELTTEST_APP
        bool "use pcba self test"
        default n
endmenu

endif

endif
```

## buildroot/package/rockchip/rv1108_package/app/rv1108_uvc_app/Config.in
```kconfig
if BR2_PACKAGE_RV1108

# BSP packages
config BR2_PACKAGE_RV1108_UVC_APP
	bool "RV1108 package uvc_app"
	select BR2_PACKAGE_ROCKCHIP_MPP
	select BR2_PACKAGE_LIBRKUVC
	select BR2_PACKAGE_JHEAD
	select BR2_PACKAGE_CAMERAHAL
	select BR2_PACKAGE_RKFB
	select BR2_PACKAGE_ROCKCHIP_RGA
	select BR2_PACKAGE_SQLITE

endif
```

## buildroot/package/rockchip/rv1108_package/app/system_manager/Config.in
```kconfig
if BR2_PACKAGE_RV1108

# BSP packages
config BR2_PACKAGE_SYSTEM_MANAGER
	bool "rv1108 package system manager"
endif
```

## buildroot/package/rockchip/rv1108_package/app/updater/Config.in
```kconfig
if BR2_PACKAGE_RV1108

# BSP packages
config BR2_PACKAGE_UPDATER
	bool "rv1108 package updater"

if BR2_PACKAGE_UPDATER
menu "rv1108 updater options"

    config BR2_PACKAGE_UPDATER_FOR_EMMC
        bool "updater support fot emmc"
        default y

	config BR2_PACKAGE_UPDATER_FOR_NOR
        bool "updater support fot nor"
        default n
endmenu
endif

endif
```

## buildroot/package/rockchip/rv1108_package/external/Config.in
```kconfig
if BR2_PACKAGE_RV1108

# BSP packages
source "package/rockchip/rv1108_package/external/rv1108_minigui/Config.in"
source "package/rockchip/rv1108_package/external/rv1108_libpng/Config.in"
source "package/rockchip/rv1108_package/external/rv1108_softapdemo/Config.in"
source "package/rockchip/rv1108_package/external/rv1108_softapserver/Config.in"

endif
```

## buildroot/package/rockchip/rv1108_package/external/rv1108_libpng/Config.in
```kconfig
if BR2_PACKAGE_RV1108

# BSP packages
#none
config BR2_PACKAGE_RV1108_LIBPNG
	bool "rv1108 package libpng"

endif
```

## buildroot/package/rockchip/rv1108_package/external/rv1108_minigui/Config.in
```kconfig
if BR2_PACKAGE_RV1108

# BSP packages
config BR2_PACKAGE_RV1108_MINIGUI
	bool "RV1108 package minigui"
	select BR2_PACKAGE_LIBION
	select BR2_PACKAGE_ROCKCHIP_RGA

if BR2_PACKAGE_RV1108_MINIGUI
menu "RV1108 package minigui options"

config BR2_PACKAGE_RV1108_MINIGUI_STATIC
	bool "Enable static lib"
	default y

config BR2_PACKAGE_RV1108_MINIGUI_ENABLE_FREETYPE
	bool "Enable freetype support"
	select BR2_PACKAGE_FREETYPE
	default n

endmenu
endif

endif
```

## buildroot/package/rockchip/rv1108_package/external/rv1108_softapdemo/Config.in
```kconfig
if BR2_PACKAGE_RV1108

# BSP packages
config BR2_PACKAGE_RV1108_SOFTAPDEMO
	bool "rv1108 package softapdemo"
	help

endif
```

## buildroot/package/rockchip/rv1108_package/external/rv1108_softapserver/Config.in
```kconfig
if BR2_PACKAGE_RV1108

# BSP packages
config BR2_PACKAGE_RV1108_SOFTAPSERVER
	bool "rv1108 package softapserver"
	help


if BR2_PACKAGE_RV1108_SOFTAPSERVER
config BR2_PACKAGE_RV1108_SOFTAPSERVER_REBOOT_AUTOCONNECT
        bool "reboot will auto connect"
        default n

endif

endif
```

## buildroot/package/rockchip/rv1108_package/framework/Config.in
```kconfig
if BR2_PACKAGE_RV1108

# BSP packages
source "package/rockchip/rv1108_package/framework/adk/Config.in"
source "package/rockchip/rv1108_package/framework/camerahal/Config.in"
source "package/rockchip/rv1108_package/framework/database/Config.in"
source "package/rockchip/rv1108_package/framework/hal/Config.in"
source "package/rockchip/rv1108_package/framework/libion/Config.in"
source "package/rockchip/rv1108_package/framework/librkuvc/Config.in"
source "package/rockchip/rv1108_package/framework/messenger/Config.in"
source "package/rockchip/rv1108_package/framework/process_units/Config.in"
source "package/rockchip/rv1108_package/framework/preisp/Config.in"
source "package/rockchip/rv1108_package/framework/rkcamera/Config.in"
source "package/rockchip/rv1108_package/framework/rkface/Config.in"
source "package/rockchip/rv1108_package/framework/rkfb/Config.in"
source "package/rockchip/rv1108_package/framework/rknr/Config.in"
source "package/rockchip/rv1108_package/framework/rv1108_settings/Config.in"

endif
```

## buildroot/package/rockchip/rv1108_package/framework/adk/Config.in
```kconfig
if BR2_PACKAGE_RV1108

# BSP packages
config BR2_PACKAGE_ADK
	bool "RV1108 package adk"
	select BR2_PACKAGE_LIBION

if BR2_PACKAGE_ADK
menu "adk setting options"

    config BR2_PACKAGE_ADK_MEDIA_WAV_PLAYBACK
        bool "support adk wav playback"
        default n
        select BR2_PACKAGE_ALSA_LIB

    config BR2_PACKAGE_ADK_RKMEDIA
        bool "adk media configure."
        default n
        select BR2_PACKAGE_RKMEDIA

    if BR2_PACKAGE_ADK_RKMEDIA
        config BR2_PACKAGE_ADK_RKMEDIA_OGG_PLAYBACK
            bool "support adk ogg playback"
            default n
            select BR2_PACKAGE_ALSA_LIB
            select BR2_PACKAGE_RKMEDIA_OGG
            select BR2_PACKAGE_RKMEDIA_OGGVORBIS_DEMUXER
            select BR2_PACKAGE_RKMEDIA_ALSA_PLAYBACK

        config BR2_PACKAGE_ADK_RKMEDIA_H264_ENCODE
            bool "h264 encoder options"
            default n
            select BR2_PACKAGE_ROCKCHIP_MPP
            select BR2_PACKAGE_RKMEDIA_MPP
            select BR2_PACKAGE_RKMEDIA_MPP_ENCODER

            if BR2_PACKAGE_ADK_RKMEDIA_H264_ENCODE
                config BR2_PACKAGE_ADK_RKMEDIA_MP4_MUXER
                    bool "support mp4 muxer"
                    default y

                config BR2_PACKAGE_ADK_RKMEDIA_RTSP_STREAM
                    bool "support rtsp stream"
                    default n
                    select BR2_PACKAGE_RKMEDIA_LIVE555
                    select BR2_PACKAGE_RKMEDIA_RTSP_SERVER
                    select BR2_PACKAGE_RKMEDIA_RTSP_SERVER_H264
            endif
    endif
endmenu
endif

endif
```

## buildroot/package/rockchip/rv1108_package/framework/camerahal/Config.in
```kconfig
if BR2_PACKAGE_RV1108

# BSP packages
config BR2_PACKAGE_CAMERAHAL
	bool "RV1108 package camerahal"
	select BR2_PACKAGE_LIBION

if BR2_PACKAGE_CAMERAHAL
menu "camerahal options"
config BR2_PACKAGE_CAMERAHAL_USE_IQ_BIN
	bool "use iq bin replace xml"
	default y
endmenu
endif

endif
```

## buildroot/package/rockchip/rv1108_package/framework/database/Config.in
```kconfig
if BR2_PACKAGE_RV1108

# BSP packages
config BR2_PACKAGE_DATABASE
	bool "rv1108 package database"
	depends on BR2_PACKAGE_SQLITE

endif
```

## buildroot/package/rockchip/rv1108_package/framework/hal/Config.in
```kconfig
if BR2_PACKAGE_RV1108

# BSP packages
config BR2_PACKAGE_HAL
	bool "rv1108 package hal"
	help
	    Hardware abstruct layer

endif
```

## buildroot/package/rockchip/rv1108_package/framework/libion/Config.in
```kconfig
if BR2_PACKAGE_RV1108

# BSP packages
#none
config BR2_PACKAGE_LIBION
	bool "RV1108 package libion"

endif
```
