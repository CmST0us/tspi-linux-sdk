## buildroot/package/rockchip/ros/ros-comm/rosservice/Config.in
```kconfig
config BR2_PACKAGE_ROSSERVICE
    bool "rosservice"
    help
        rosservice contains the rosservice command-line tool
        for listing and querying ROS Services
```

## buildroot/package/rockchip/ros/ros-comm/rostest/Config.in
```kconfig
config BR2_PACKAGE_ROSTEST
	bool "rostest"
    select BR2_PACKAGE_ROS_SET
	select BR2_PACKAGE_ROSUNIT
    select BR2_PACKAGE_BOOST_THREAD
    select BR2_PACKAGE_BOOST_SYSTEM

	help
		Integration test suite based on roslaunch that is compatible with xUnit frameworks.
```

## buildroot/package/rockchip/ros/ros-comm/rostopic/Config.in
```kconfig
config BR2_PACKAGE_ROSTOPIC
    bool "rostopic"
    select BR2_PACKAGE_ROSTEST
    help
        rostopic contains the rostopic command-line tool for
        displaying debug information about ROS Topics,
        including publishers, subscribers, publishing rate,
        and ROS Messages
```

## buildroot/package/rockchip/ros/ros-comm/roswtf/Config.in
```kconfig
config BR2_PACKAGE_ROSWTF
    bool "roswtf"
    select BR2_PACKAGE_ROSTEST
    help
        roswtf is a tool for diagnosing issues with a running
        ROS system. Think of it as a FAQ implemented in code.
```

## buildroot/package/rockchip/ros/ros-comm/topic-tools/Config.in
```kconfig
config BR2_PACKAGE_TOPIC_TOOLS
    bool "topic-tools"
    select BR2_PACKAGE_ROSCPP_CORE_SET
    select BR2_PACKAGE_CPP_COMMON
    select BR2_PACKAGE_MESSAGE_GENERATION
    select BR2_PACKAGE_ROSCONSOLE
    select BR2_PACKAGE_ROSCPP
    select BR2_PACKAGE_ROSTIME
    select BR2_PACKAGE_STD_MSGS
    select BR2_PACKAGE_XMLRPCPP
    select BR2_PACKAGE_ROSTEST
    help
        rostopic ontains the rostopic command-line tool for
        displaying debug information about ROS Topics,
        including publishers, subscribers, publishing rate,
        and ROS Messages
```

## buildroot/package/rockchip/ros/ros-comm/xmlrpcpp/Config.in
```kconfig
config BR2_PACKAGE_XMLRPCPP
	bool "xmlrpcpp"
    select BR2_PACKAGE_ROSCPP_CORE_SET
	select BR2_PACKAGE_CPP_COMMON
	select BR2_PACKAGE_ROSTIME

	help
		XmlRpc++ is a C++ implementation of the XML-RPC protocol. This version is heavily modified from the package available on SourceForge in order to support roscpp's threading model. As such, we are maintaining our own fork.
```

## buildroot/package/rockchip/ros/ros/Config.in
```kconfig
menuconfig BR2_PACKAGE_ROS_SET
    bool "ros"
    depends on BR2_PACKAGE_HOST_CATKIN
    depends on BR2_PACKAGE_PYTHON

if BR2_PACKAGE_ROS_SET
source "package/rockchip/ros/ros/mk/Config.in"
source "package/rockchip/ros/ros/ros/Config.in"
source "package/rockchip/ros/ros/rosbash/Config.in"
source "package/rockchip/ros/ros/rosboost-cfg/Config.in"
source "package/rockchip/ros/ros/rosbuild/Config.in"
source "package/rockchip/ros/ros/rosclean/Config.in"
source "package/rockchip/ros/ros/roscreate/Config.in"
source "package/rockchip/ros/ros/roslang/Config.in"
source "package/rockchip/ros/ros/roslib/Config.in"
source "package/rockchip/ros/ros/rosmake/Config.in"
source "package/rockchip/ros/ros/rosunit/Config.in"

endif
```

## buildroot/package/rockchip/ros/ros/mk/Config.in
```kconfig
config BR2_PACKAGE_MK
    bool "mk"
    help
        A collection of .mk include files for building ROS
        architectural elements
```

## buildroot/package/rockchip/ros/ros/rosbash/Config.in
```kconfig
config BR2_PACKAGE_ROSBASH
    bool "rosbash"
    depends on BR2_PACKAGE_BASH
    depends on BR2_PACKAGE_FINDUTILS
    help
        Assorted shell commands for using ros with bash
```

## buildroot/package/rockchip/ros/ros/rosboost-cfg/Config.in
```kconfig
config BR2_PACKAGE_ROSBOOST_CFG
    bool "rosboost-cfg"
    help
        Contains scripts used by the rosboost-cfg tool for
        determining cflags/lflags/etc. of boost on you system
```

## buildroot/package/rockchip/ros/ros/rosbuild/Config.in
```kconfig
config BR2_PACKAGE_ROSBUILD
    bool "rosbuild"
    help
        rosbuild contains scripts for managing the CMake-based
        build system for ROS
```

## buildroot/package/rockchip/ros/ros/rosclean/Config.in
```kconfig
config BR2_PACKAGE_ROSCLEAN
    bool "rosclean"
    help
        cleanup filesystem resources
```

## buildroot/package/rockchip/ros/ros/roscreate/Config.in
```kconfig
config BR2_PACKAGE_ROSCREATE
    bool "roscreate"
    help
        roscreate contains a tool that assists in the creation
        of ROS filesystem resources
```

## buildroot/package/rockchip/ros/ros/roslang/Config.in
```kconfig
config BR2_PACKAGE_ROSLANG
    bool "roslang"
    help
        roslang is a common package that all ROS client
        libraies depends on
```

## buildroot/package/rockchip/ros/ros/roslib/Config.in
```kconfig
config BR2_PACKAGE_ROSLIB
    bool "roslib"
    depends on BR2_PACKAGE_HOST_CATKIN
    depends on BR2_PACKAGE_ROSPACK
    help
        Base dependencies and support libraries for ROS
```

## buildroot/package/rockchip/ros/ros/rosmake/Config.in
```kconfig
config BR2_PACKAGE_ROSMAKE
    bool "rosmake"
    help
        rosmake is a ros dependency aware build tool which can
        be used to build all dependencies in the correct order
```

## buildroot/package/rockchip/ros/ros/rosunit/Config.in
```kconfig
config BR2_PACKAGE_ROSUNIT
	bool "rosunit for ros"
	depends on BR2_PACKAGE_HOST_CATKIN
	help
		Unit-testing package for ROS. This is a lower-level library for rostest and handles unit tests, whereas rostest handles integration tests.
```

## buildroot/package/rockchip/ros/roscpp-core/Config.in
```kconfig
menuconfig BR2_PACKAGE_ROSCPP_CORE_SET
    bool "roscpp-core"
    depends on BR2_PACKAGE_HOST_CATKIN

if BR2_PACKAGE_ROSCPP_CORE_SET
source "package/rockchip/ros/roscpp-core/cpp_common/Config.in"
source "package/rockchip/ros/roscpp-core/roscpp_core/Config.in"
source "package/rockchip/ros/roscpp-core/roscpp_serialization/Config.in"
source "package/rockchip/ros/roscpp-core/roscpp_traits/Config.in"
source "package/rockchip/ros/roscpp-core/rostime/Config.in"

endif
```

## buildroot/package/rockchip/ros/roscpp-core/cpp_common/Config.in
```kconfig
config BR2_PACKAGE_CPP_COMMON
	bool "cpp_common in roscpp_core for ROS"
	select BR2_PACKAGE_CONSOLE_BRIDGE
	help
	  cpp_common contains C++ code for doing things that are not necessarily ROS related, but are useful for multiple packages
```

## buildroot/package/rockchip/ros/roscpp-core/roscpp_core/Config.in
```kconfig
config BR2_PACKAGE_ROSCPP_CORE
	bool "roscpp_core for ROS"
	depends on BR2_PACKAGE_HOST_CATKIN
	select BR2_PACKAGE_CPP_COMMON
	select BR2_PACKAGE_ROSTIME
	select BR2_PACKAGE_ROSCPP_TRAITS
	select BR2_PACKAGE_ROSCPP_SERIALIZATION
	help
	  roscpp_core is an underlying library for support roscpp message data types. It is a lightweight/minimal library that can easily be used in non-ROS-based projects
```

## buildroot/package/rockchip/ros/roscpp-core/roscpp_serialization/Config.in
```kconfig
config BR2_PACKAGE_ROSCPP_SERIALIZATION
	bool "roscpp_serialization for ROS"
	select BR2_PACKAGE_CPP_COMMON
	select BR2_PACKAGE_ROSTIME
	select BR2_PACKAGE_ROSCPP_TRAITS
	help
	  roscpp_serialization contains the code for serialization as described in MessagesSerializationAndAdaptingTypes
```

## buildroot/package/rockchip/ros/roscpp-core/roscpp_traits/Config.in
```kconfig
config BR2_PACKAGE_ROSCPP_TRAITS
	bool "roscpp_traits for ROS"
    select BR2_PACKAGE_CPP_COMMON
    select BR2_PACKAGE_ROSTIME
	help
	 roscpp_traits contains the message traits code as described in MessagesTraits 
```

## buildroot/package/rockchip/ros/roscpp-core/rostime/Config.in
```kconfig
config BR2_PACKAGE_ROSTIME
	bool "rostime in roscpp_core for ROS"
	select BR2_PACKAGE_CPP_COMMON
	select BR2_PACKAGE_BOOST_DATE_TIME

	help
	  Time and Duration implementations for C++ libraries
```

## buildroot/package/rockchip/ros/rospack/Config.in
```kconfig
config BR2_PACKAGE_ROSPACK
    bool "rospack for ros"
    depends on BR2_PACKAGE_HOST_CATKIN
    depends on BR2_PACKAGE_TINYXML
    select BR2_PACKAGE_CMAKE_MODULES
    select BR2_PACKAGE_BOOST_FILESYSTEM
    select BR2_PACKAGE_BOOST_PROGRAM_OPTIONS
    help
        rospack is a command-line program which provides many of the
        services of the *NIX pkg-config tool. It is used to find
        packages among the "forest" of code in a typical ROS
        distribution, calculate dependencies, mangle Makefiles, and in
        general promote peace and harmony in a ROS distribution
```
