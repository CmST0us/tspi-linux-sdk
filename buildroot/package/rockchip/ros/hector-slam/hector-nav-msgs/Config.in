## buildroot/package/rockchip/ros/hector-slam/hector-nav-msgs/Config.in
```kconfig
config BR2_PACKAGE_HECTOR_NAV_MSGS
	bool "hector nav msgs"
	select BR2_PACKAGE_COMMON_MSGS_SET
	select BR2_PACKAGE_NAV_MSGS
	select BR2_PACKAGE_MESSAGE_GENERATION
	help
		hector nav msgs
```

## buildroot/package/rockchip/ros/hector-slam/hector-slam-launch/Config.in
```kconfig
config BR2_PACKAGE_HECTOR_SLAM_LAUNCH
	bool "hector slam launch"
	help
		hector slam launch
```

## buildroot/package/rockchip/ros/hector-slam/hector-trajectory-server/Config.in
```kconfig
config BR2_PACKAGE_HECTOR_TRAJECTORY_SERVER
	bool "hector trajectroy server"
	depends on BR2_PACKAGE_TF
	select BR2_PACKAGE_ROS_COMM_SET
	select BR2_PACKAGE_ROSCPP
	select BR2_PACKAGE_HECTOR_NAV_MSGS
	select BR2_PACKAGE_HECTOR_MAP_TOOLS

	help
		hector trajectroy server
```

## buildroot/package/rockchip/ros/image-common/Config.in
```kconfig
menuconfig BR2_PACKAGE_IMAGE_COMMON_SET
	bool "image_common"
	depends on BR2_PACKAGE_HOST_CATKIN
	depends on BR2_PACKAGE_BOOST

if BR2_PACKAGE_IMAGE_COMMON_SET
source "package/rockchip/ros/image-common/image-common/Config.in"
source "package/rockchip/ros/image-common/image-transport/Config.in"
source "package/rockchip/ros/image-common/camera-calibration-parsers/Config.in"
source "package/rockchip/ros/image-common/camera-info-manager/Config.in"
endif
```

## buildroot/package/rockchip/ros/image-common/camera-calibration-parsers/Config.in
```kconfig
config BR2_PACKAGE_CAMERA_CALIBRATION_PARSERS
	bool "camera_calibration_parsers"
	depends on BR2_PACKAGE_YAML_CPP
	select BR2_PACKAGE_BOOST_FILESYSTEM
	select BR2_PACKAGE_BOOST_PYTHON
	select BR2_PACKAGE_COMMON_MSGS_SET
	select BR2_PACKAGE_SENSOR_MSGS
	select BR2_PACKAGE_ROS_COMM_SET
	select BR2_PACKAGE_ROSCONSOLE
	select BR2_PACKAGE_ROSCPP
	select BR2_PACKAGE_ROSCPP_CORE_SET
	select BR2_PACKAGE_ROSCPP_SERIALIZATION

	help
		camera_calibration_parsers
```

## buildroot/package/rockchip/ros/image-common/camera-info-manager/Config.in
```kconfig
config BR2_PACKAGE_CAMERA_INFO_MANAGER
	bool "camera_info_manager"
	depends on BR2_PACKAGE_CAMERA_CALIBRATION_PARSERS
	depends on BR2_PACKAGE_IMAGE_TRANSPORT
	select BR2_PACKAGE_ROS_COMM_SET
	select BR2_PACKAGE_ROSCPP
	select BR2_PACKAGE_COMMON_MSGS_SET
	select BR2_PACKAGE_SENSOR_MSGS
	select BR2_PACKAGE_ROS_SET
	select BR2_PACKAGE_ROS_ROSLIB

	help
		camera_info_manager
```

## buildroot/package/rockchip/ros/image-common/image-transport/Config.in
```kconfig
config BR2_PACKAGE_IMAGE_TRANSPORT
	bool "image-transport"
	select BR2_PACKAGE_ROS_COMM_SET
	select BR2_PACKAGE_MESSAGE_FILTERS
	select BR2_PACKAGE_ROSCONSOLE
	select BR2_PACKAGE_ROSCPP
	depends on BR2_PACKAGE_PLUGINLIB
	select BR2_PACKAGE_COMMON_MSGS_SET
	select BR2_PACKAGE_SENSOR_MSGS
	select BR2_PACKAGE_CMAKE_MODULES
	help
		image-transport
```

## buildroot/package/rockchip/ros/laser-geometry/Config.in
```kconfig
config BR2_PACKAGE_LASER_GEOMETRY
    bool "laser geometry"
    depends on BR2_PACKAGE_HOST_CATKIN
    select BR2_PACKAGE_ANGLES
    select BR2_PACKAGE_ROS_COMM_SET
    select BR2_PACKAGE_ROSCPP
    select BR2_PACKAGE_COMMON_MSGS_SET
    select BR2_PACKAGE_SENSOR_MSGS
    depends on BR2_PACKAGE_ROSPACK
    select BR2_PACKAGE_GEOMETRY_SET
    select BR2_PACKAGE_TF
    select BR2_PACKAGE_TF2
    depends on BR2_PACKAGE_EIGEN
    depends on BR2_PACKAGE_BOOST
    select BR2_PACKAGE_BOOST_SYSTEM
    select BR2_PACKAGE_BOOST_THREAD

    help
        laser geometry
```

## buildroot/package/rockchip/ros/libuvc-ros/Config.in
```kconfig
menuconfig BR2_PACKAGE_LIBUVC_ROS_SET
	bool "libuvc-camera"
	depends on BR2_PACKAGE_HOST_CATKIN

if BR2_PACKAGE_LIBUVC_ROS_SET
source "package/rockchip/ros/libuvc-ros/libuvc-camera/Config.in"
source "package/rockchip/ros/libuvc-ros/libuvc-ros/Config.in"
endif
```

## buildroot/package/rockchip/ros/libuvc-ros/libuvc-camera/Config.in
```kconfig
config BR2_PACKAGE_LIBUVC_CAMERA
	bool "libuvc-camera"
	select BR2_PACKAGE_ROS_COMM_SET
	select BR2_PACKAGE_ROSCPP
	depends on BR2_PACKAGE_DYNAMIC_RECONFIGURE
	depends on BR2_PACKAGE_NODELET
	select BR2_PACKAGE_COMMON_MSGS_SET
	select BR2_PACKAGE_SENSOR_MSGS
	select BR2_PACKAGE_LIBUVC
	depends on BR2_PACKAGE_IMAGE_TRANSPORT
	depends on BR2_PACKAGE_CAMERA_INFO_MANAGER

	help
		libuvc-camera
```

## buildroot/package/rockchip/ros/libuvc/Config.in
```kconfig
config BR2_PACKAGE_LIBUVC
	bool "libuvc"
	depends on BR2_PACKAGE_BOOST
	depends on BR2_PACKAGE_HOST_CATKIN
	depends on BR2_PACKAGE_CV_BRIDGE
	depends on BR2_PACKAGE_JPEG
	select BR2_PACKAGE_LIBUSB
	help
		libuvc
```

## buildroot/package/rockchip/ros/message-runtime/Config.in
```kconfig
config BR2_PACKAGE_MESSAGE_RUNTIME
	bool "message runtime for ROS"
	depends on BR2_PACKAGE_HOST_CATKIN
    depends on BR2_PACKAGE_ROSCPP_CORE_SET
	select BR2_PACKAGE_GENCPP
	select BR2_PACKAGE_CPP_COMMON
	select BR2_PACKAGE_ROSCPP_SERIALIZATION
	help
		Package modeling the run-time dependencies for language bindings of messages.
```

## buildroot/package/rockchip/ros/nodelet-core/Config.in
```kconfig
menuconfig BR2_PACKAGE_NODELET_CORE_SET
	bool "ros nodelet-core"
	depends on BR2_PACKAGE_HOST_CATKIN

if BR2_PACKAGE_NODELET_CORE_SET
source "package/rockchip/ros/nodelet-core/nodelet/Config.in"
source "package/rockchip/ros/nodelet-core/nodelet-core/Config.in"
source "package/rockchip/ros/nodelet-core/test-nodelet/Config.in"
source "package/rockchip/ros/nodelet-core/nodelet-topic-tools/Config.in"
source "package/rockchip/ros/nodelet-core/test-nodelet-topic-tools/Config.in"
endif
```

## buildroot/package/rockchip/ros/nodelet-core/nodelet-topic-tools/Config.in
```kconfig
config BR2_PACKAGE_NODELET_TOPIC_TOOLS
	bool "nodelet topic tools"
	depends on BR2_PACKAGE_BOOST
	depends on BR2_PACKAGE_DYNAMIC_RECONFIGURE
	select BR2_PACKAGE_BOOST_THREAD
	help
		nodelet topic tools
```

## buildroot/package/rockchip/ros/nodelet-core/nodelet/Config.in
```kconfig
config BR2_PACKAGE_NODELET
	bool "nodelet"
	depends on BR2_PACKAGE_PLUGINLIB
	select BR2_PACKAGE_BOND_CORE_SET
	select BR2_PACKAGE_BONDCPP
	select BR2_PACKAGE_CMAKE_MODULES
	select BR2_PACKAGE_MESSAGE_GENERATION
	select BR2_PACKAGE_ROS_COMM_SET
	select BR2_PACKAGE_ROSCONSOLE
	select BR2_PACKAGE_STD_MSGS

	help
		nodelet
```

## buildroot/package/rockchip/ros/nodelet-core/test-nodelet-topic-tools/Config.in
```kconfig
config BR2_PACKAGE_TEST_NODELET_TOPIC_TOOLS
	bool "test nodelet topic tools"
	select BR2_PACKAGE_MESSAGE_FILTERS
	depends on BR2_PACKAGE_NODELET
	select BR2_PACKAGE_NODELET_TOPIC_TOOLS
	select BR2_PACKAGE_ROSCPP
	select BR2_PACKAGE_ROSTEST
	help
		test nodelet topic tools
```

## buildroot/package/rockchip/ros/nodelet-core/test-nodelet/Config.in
```kconfig
config BR2_PACKAGE_TEST_NODELET
	bool "test nodelet"
	depends on BR2_PACKAGE_NODELET
	select BR2_PACKAGE_ROSTEST
	depends on BR2_PACKAGE_BOOST
	select BR2_PACKAGE_BOOST_THREAD
	help
		test nodelet
```

## buildroot/package/rockchip/ros/orocos_kinematics_dynamics/orocos-kdl/Config.in
```kconfig
config BR2_PACKAGE_OROCOS_KDL
    bool "orocos-kdl"
    depends on BR2_PACKAGE_EIGEN
    help
        Kinematics and Dynamics Library: Orocos project to supply
        RealTime usable kinematics and dynamics code, it contains
        code for rigid body kinematics calculations and
        representations for kinematic structures and their
        inverse and forward kinematic solvers.
```

## buildroot/package/rockchip/ros/pluginlib/Config.in
```kconfig
config BR2_PACKAGE_PLUGINLIB
    bool "pluginlib"
    depends on BR2_PACKAGE_HOST_CATKIN
    depends on BR2_PACKAGE_CLASS_LOADER
    depends on BR2_PACKAGE_ROSPACK
    select BR2_PACKAGE_TINYXML2 if BR2_PACKAGE_ROS_KINETIC
    select BR2_PACKAGE_GTEST if BR2_PACKAGE_ROS_INDIGO
    select BR2_PACKAGE_ROS_COMM_SET
    select BR2_PACKAGE_ROSCONSOLE
    select BR2_PACKAGE_ROSLIB
    select BR2_PACKAGE_BOOST_SYSTEM
    select BR2_PACKAGE_BOOST_FILESYSTEM

    help
        The pluginlib package provides tools for writing and
        dynamically loading plugins using the ROS build
        infrastructure
```

## buildroot/package/rockchip/ros/python-ros/Config.in
```kconfig
menuconfig BR2_PACKAGE_PYTHON_ROS_SET
    bool "python for ros"
    depends on BR2_PACKAGE_PYTHON

if BR2_PACKAGE_PYTHON_ROS_SET
source "package/rockchip/ros/python-ros/python-catkin_pkg/Config.in.host"
source "package/rockchip/ros/python-ros/python-catkin_pkg/Config.in"
source "package/rockchip/ros/python-ros/python-rospkg/Config.in"
source "package/rockchip/ros/python-ros/python-em/Config.in.host"
source "package/rockchip/ros/python-ros/python-empy/Config.in.host"
source "package/rockchip/ros/python-ros/python-defusedxml/Config.in"

endif
```
