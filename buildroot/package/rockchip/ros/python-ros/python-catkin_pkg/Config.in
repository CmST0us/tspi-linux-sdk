## buildroot/package/rockchip/ros/python-ros/python-catkin_pkg/Config.in
```kconfig
config BR2_PACKAGE_PYTHON_CATKIN_PKG
	bool "catkin_pkg for ROS"
	help
		Standalone Python library for the catkin build system
```

## buildroot/package/rockchip/ros/python-ros/python-catkin_pkg/Config.in.host
```kconfig
config BR2_PACKAGE_HOST_PYTHON_CATKIN_PKG
	bool "host catkin_pkg for ROS"
	select BR2_PACKAGE_HOST_PYTHON_PYPARSING
	select BR2_PACKAGE_HOST_PYTHON_DATEUTIL
	help
		Standalone Python library for the catkin build system
```

## buildroot/package/rockchip/ros/python-ros/python-defusedxml/Config.in
```kconfig
config BR2_PACKAGE_PYTHON_DEFUSEDXML
	bool "python defusedxml"
	help
		defusedxml
```

## buildroot/package/rockchip/ros/python-ros/python-rospkg/Config.in
```kconfig
config BR2_PACKAGE_PYTHON_ROSPKG
	bool "python rospkg for ros"
	help
		ros-pkg is a community repository for developing libraries that are generally robot agnostic
```

## buildroot/package/rockchip/ros/ros-comm-msgs/Config.in
```kconfig
menuconfig BR2_PACKAGE_ROS_COMM_MSGS_SET
    bool "ros ros-comm-msgs"
    depends on BR2_PACKAGE_HOST_CATKIN

if BR2_PACKAGE_ROS_COMM_MSGS_SET
source "package/rockchip/ros/ros-comm-msgs/rosgraph_msgs/Config.in"
source "package/rockchip/ros/ros-comm-msgs/std-srvs/Config.in"

endif
```

## buildroot/package/rockchip/ros/ros-comm-msgs/rosgraph_msgs/Config.in
```kconfig
config BR2_PACKAGE_ROSGRAPH_MSGS
	bool "rosgraph_msgs for ros"
	select BR2_PACKAGE_MESSAGE_GENERATION
	select BR2_PACKAGE_STD_MSGS
	help
		Messages relating to the ROS Computation Graph. These are generally considered to be low-level messages that end users do not interact with.
```

## buildroot/package/rockchip/ros/ros-comm-msgs/std-srvs/Config.in
```kconfig
config BR2_PACKAGE_STD_SRVS
    bool "std-srvs"
    help
        Common service definitions. Currently just the 'Empty' service
```

## buildroot/package/rockchip/ros/ros-comm/Config.in
```kconfig
menuconfig BR2_PACKAGE_ROS_COMM_SET
    bool "ros ros-comm"
    depends on BR2_PACKAGE_HOST_CATKIN

if BR2_PACKAGE_ROS_COMM_SET
source "package/rockchip/ros/ros-comm/ros-comm/Config.in"
source "package/rockchip/ros/ros-comm/roswtf/Config.in"
source "package/rockchip/ros/ros-comm/rospy/Config.in"
source "package/rockchip/ros/ros-comm/rostopic/Config.in"
source "package/rockchip/ros/ros-comm/rosout/Config.in"
source "package/rockchip/ros/ros-comm/rosnode/Config.in"
source "package/rockchip/ros/ros-comm/rosservice/Config.in"
source "package/rockchip/ros/ros-comm/rosparam/Config.in"
source "package/rockchip/ros/ros-comm/rosgraph/Config.in"
source "package/rockchip/ros/ros-comm/rosmaster/Config.in"
source "package/rockchip/ros/ros-comm/rosmsg/Config.in"
source "package/rockchip/ros/ros-comm/roslaunch/Config.in"
source "package/rockchip/ros/ros-comm/rosbag/Config.in"
source "package/rockchip/ros/ros-comm/rosbag-storage/Config.in"
source "package/rockchip/ros/ros-comm/roslz4/Config.in"
source "package/rockchip/ros/ros-comm/message-filters/Config.in"
source "package/rockchip/ros/ros-comm/roscpp/Config.in"
source "package/rockchip/ros/ros-comm/rosconsole/Config.in"
source "package/rockchip/ros/ros-comm/rostest/Config.in"
source "package/rockchip/ros/ros-comm/xmlrpcpp/Config.in"
source "package/rockchip/ros/ros-comm/topic-tools/Config.in"

endif
```

## buildroot/package/rockchip/ros/ros-comm/message-filters/Config.in
```kconfig
config BR2_PACKAGE_MESSAGE_FILTERS
    bool "message-filters"
    select BR2_PACKAGE_ROSCONSOLE
    select BR2_PACKAGE_ROSCPP
    select BR2_PACKAGE_XMLRPCPP
    select BR2_PACKAGE_BOOST_SIGNALS
    select BR2_PACKAGE_BOOST_THREAD
    select BR2_PACKAGE_ROSTEST
    help
        A set of message filters which take in messages and may
        output those messages at a later time, based on the
        conditions that filter needs met
```

## buildroot/package/rockchip/ros/ros-comm/rosbag-storage/Config.in
```kconfig
config BR2_PACKAGE_ROSBAG_STORAGE
    bool "rosbag-storage"
    select BR2_PACKAGE_ROSLZ4
    help
        This is a set of tools for recording from and playing
        back ROS message without relying on the ROS client
        library
```

## buildroot/package/rockchip/ros/ros-comm/rosbag/Config.in
```kconfig
config BR2_PACKAGE_ROSBAG
    bool "rosbag"
    select BR2_PACKAGE_TOPIC_TOOLS

    select BR2_PACKAGE_ROSBAG_STORAGE
    select BR2_PACKAGE_TOPIC_TOOLS
    select BR2_PACKAGE_BZIP2
    select BR2_PACKAGE_BOOST_DATE_TIME
    select BR2_PACKAGE_BOOST_REGEX
    select BR2_PACKAGE_BOOST_PROGRAM_OPTIONS
    select BR2_PACKAGE_BOOST_FILESYSTEM
    help
        This is a set of tools for recording from and playing
        back to ROS topics. It's intended to be high performance
        and avoids deserialization and reserialization of the
        messages
```

## buildroot/package/rockchip/ros/ros-comm/rosconsole/Config.in
```kconfig
config BR2_PACKAGE_ROSCONSOLE
	bool "rosconsole"
	depends on BR2_PACKAGE_HOST_CATKIN
    select BR2_PACKAGE_ROSCPP_CORE_SET
    select BR2_PACKAGE_ROS_SET
	select BR2_PACKAGE_ROSUNIT
	select BR2_PACKAGE_BOOST_REGEX
	select BR2_PACKAGE_CPP_COMMON
	select BR2_PACKAGE_ROSTIME
	help
		ROS console output library.
```

## buildroot/package/rockchip/ros/ros-comm/roscpp/Config.in
```kconfig
config BR2_PACKAGE_ROSCPP
	bool "roscpp"
    select BR2_PACKAGE_ROS_COMM_MSGS_SET
	select BR2_PACKAGE_ROSGRAPH_MSGS
    select BR2_PACKAGE_BOOST_SIGNALS
	select BR2_PACKAGE_CPP_COMMON
	select BR2_PACKAGE_MESSAGE_GENERATION
	select BR2_PACKAGE_ROSCONSOLE
	select BR2_PACKAGE_ROSCPP_SERIALIZATION
	select BR2_PACKAGE_ROSCPP_TRAITS
	select BR2_PACKAGE_ROSTIME
	select BR2_PACKAGE_STD_MSGS
	select BR2_PACKAGE_XMLRPCPP
	help
		roscpp is a C++ implementation of ROS. It provides a client library that enables C++ programmers to quickly interface with ROS Topics, Services, and Parameters. roscpp is the most widely used ROS client library and is designed to be the high-performance library for ROS.
```

## buildroot/package/rockchip/ros/ros-comm/rosgraph/Config.in
```kconfig
config BR2_PACKAGE_ROSGRAPH
	bool "rosgraph for ros"
	depends on BR2_PACKAGE_PYTHON
	depends on BR2_PACKAGE_HOST_CATKIN
	help
		rosgraph contains the rosgraph command-line tool,
		which prints information about the ROS Computation
		Graph. It also provides an internal library that is
		used by the graphical version of this tool, rxgraph.
```

## buildroot/package/rockchip/ros/ros-comm/roslaunch/Config.in
```kconfig
config BR2_PACKAGE_ROSLAUNCH
    bool "roslaunch"
    help
        roslaunch is a tool for easily launching multiple ROS
        nodes locally and remotely via SSH, as well as setting
        parameters on the Parameter Server.
```

## buildroot/package/rockchip/ros/ros-comm/roslz4/Config.in
```kconfig
config BR2_PACKAGE_ROSLZ4
    bool "roslz4"
    select BR2_PACKAGE_LZ4
    select BR2_PACKAGE_BZIP2
    help
        A Python and C++ implementation of the LZ4 streaming format
```

## buildroot/package/rockchip/ros/ros-comm/rosmaster/Config.in
```kconfig
config BR2_PACKAGE_ROSMASTER
	bool "rosmaster"
	select BR2_PACKAGE_PYTHON_DEFUSEDXML
	select BR2_PACKAGE_PYTHON_HASHLIB
	help
		ROS Master implementation.
```

## buildroot/package/rockchip/ros/ros-comm/rosmsg/Config.in
```kconfig
config BR2_PACKAGE_ROSMSG
    bool "rosmsg"
    help
        rosmsg contains two command-line tools: rosmsg and
        rossrv, rosmsg is a command-line tools for displaying
        information about ROS Message types. rossrv is a
        command-line tool for displaying information about
        ROS Service types
```

## buildroot/package/rockchip/ros/ros-comm/rosnode/Config.in
```kconfig
config BR2_PACKAGE_ROSNODE
    bool "rosnode"
    select BR2_PACKAGE_ROSTEST
    help
        rosnode is a command-line tool for displaying debug
        information about ROS Nodes, including publications,
        subscriptions and connections
```

## buildroot/package/rockchip/ros/ros-comm/rosout/Config.in
```kconfig
config BR2_PACKAGE_ROSOUT
    bool "rosout"
    select BR2_PACKAGE_ROSCPP
    select BR2_PACKAGE_ROS_COMM_MSGS
    select BR2_PACKAGE_ROSGRAPH_MSGS
    help
        System-wide logging mechanism for message sent to
        the rosout topic
```

## buildroot/package/rockchip/ros/ros-comm/rosparam/Config.in
```kconfig
config BR2_PACKAGE_ROSPARAM
    bool "rosparam"
    help
        The rosparam command-line tool for getting and setting
        ROS Parameters on the Parameter Server using YAML-
        encoded files
```

## buildroot/package/rockchip/ros/ros-comm/rospy/Config.in
```kconfig
config BR2_PACKAGE_ROSPY
    bool "rospy"
    depends on BR2_PACKAGE_ROSPACK
    select BR2_PACKAGE_GENPY
    select BR2_PACKAGE_ROS_SET
    select BR2_PACKAGE_ROSLIB
    select BR2_PACKAGE_STD_MSGS
    select BR2_PACKAGE_ROSGRAPH
    select BR2_PACKAGE_ROS_COMM_MSGS_SET
    select BR2_PACKAGE_ROSGRAPH_MSGS
    select BR2_PACKAGE_ROSCPP
    select BR2_PACKAGE_PYTHON_PYYAML
    help
        rospy is a pure Python client library for ROS. The rospy
        client API enables Python programmers to quickly interface
        with ROS Topics, Services, and Parameters
```
