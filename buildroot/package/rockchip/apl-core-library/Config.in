## buildroot/package/rockchip/apl-core-library/Config.in
```kconfig
config BR2_PACKAGE_APL_CORE_LIBRARY
	bool "APL Core Library"
	help
	Amazon APL Core Library for rendering of screen layout at runtime
```

## buildroot/package/rockchip/apps/Config.in
```kconfig
source "package/rockchip/apps/multivideoplayer/Config.in"
source "package/rockchip/apps/qcamera/Config.in"
source "package/rockchip/apps/qfm/Config.in"
source "package/rockchip/apps/qlauncher/Config.in"
source "package/rockchip/apps/qplayer/Config.in"
source "package/rockchip/apps/qsetting/Config.in"
```

## buildroot/package/rockchip/apps/multivideoplayer/Config.in
```kconfig
config BR2_PACKAGE_MULTIVIDEOPLAYER
	bool "multivideo player"
	depends on BR2_PACKAGE_QT5
	help
	  Rockchip multivideo player application based on Qt
```

## buildroot/package/rockchip/apps/qsetting/Config.in
```kconfig
config BR2_PACKAGE_QSETTING
	bool "qsetting"
	depends on BR2_PACKAGE_QT5
	select BR2_PACKAGE_RKWIFIBT_APP
	help
	  Rockchip setting application based on Qt
```

## buildroot/package/rockchip/avs-device-sdk/Config.in
```kconfig
config BR2_PACKAGE_AVS_DEVICE_SDK
	bool "AVS Device SDK"
	help
	Amazon Alexa Voice Service Device SDK
```

## buildroot/package/rockchip/ble_wificonfig/Config.in
```kconfig
config BR2_PACKAGE_BLE_WIFICONFIG
	bool "ble wifi config service base on bluez gatt-service"
	depends on BR2_PACKAGE_BLUEZ_UTILS || BR2_PACKAGE_BLUEZ5_UTILS
	depends on BR2_USE_MMU # dbus, libglib2
	depends on BR2_USE_WCHAR # libglib2
	depends on BR2_TOOLCHAIN_HAS_THREADS # dbus, libglib2
	select BR2_PACKAGE_DBUS
	select BR2_PACKAGE_LIBGLIB2
	select BR2_PACKAGE_READLINE if BR2_PACKAGE_BLUEZ5_UTILS
```

## buildroot/package/rockchip/bootcontrol/Config.in
```kconfig
config BR2_PACKAGE_BOOTCONTROL
	bool "Rockchip bootcontrol for linux"
    select BR2_PACKAGE_LIBAVB 
    select BR2_PACKAGE_LIBAVB_USER 
    select BR2_PACKAGE_LIBAVB_AB 
	help
	  Rockchip bootcontrol for linux.
```

## buildroot/package/rockchip/broadcom_bsa/Config.in
```kconfig
config BR2_PACKAGE_BROADCOM_BSA
    bool "broadcom(ampak) bsa server and app"
    depends on BR2_PACKAGE_RKWIFIBT_VENDOR = "BROADCOM"
    help
	broadcom bsa server and app
```

## buildroot/package/rockchip/cae_vad/Config.in
```kconfig
config BR2_PACKAGE_CAE_VAD
	bool "Cae app using VAD"
	select BR2_PACKAGE_LIBPTHREAD_STUBS
	select BR2_PACKAGE_ALSA_LIB
	help
	  Cae app using VAD.
```

## buildroot/package/rockchip/camera-engine-rkaiq/Config.in
```kconfig
menuconfig BR2_PACKAGE_CAMERA_ENGINE_RKAIQ
	depends on BR2_PACKAGE_CAMERA_ENGINE
	depends on BR2_PACKAGE_ROCKCHIP_HAS_ISP2 || BR2_PACKAGE_ROCKCHIP_HAS_ISP3
	bool "Rockchip Camera Engine Rkaiq for SoC with ISP2 or ISP3"
	help
	  Rockchip camera engine rkaiq for linux.

if BR2_PACKAGE_CAMERA_ENGINE_RKAIQ

config BR2_PACKAGE_CAMERA_ENGINE_RKAIQ_FORCE_INSTALL_TO_ROOTFS
	bool "Rockchip Camera Engine install to rootfs"
	default n
	help
	  Rockchip Camera Engine install to rootfs.

config BR2_PACKAGE_CAMERA_ENGINE_RKAIQ_IQFILE
	string "Rockchip Camera Engine IQ xml file"
	default ""
	help
	  Rockchip sensor IQ xml file.

config BR2_PACKAGE_CAMERA_ENGINE_RKAIQ_IQFILE_USE_BIN
	bool "Rockchip Camera Engine IQ xml file conver to bin"
	default n
	help
	  Rockchip sensor IQ bin file.

config BR2_PACKAGE_CAMERA_ENGINE_RKAIQ_FAKE_CAMERA_IQFILE
	string "Rockchip Camera Engine fake camera IQ xml file"
	default ""
	help
	  Rockchip sensor fake camera IQ xml file.

config BR2_PACKAGE_CAMERA_ENGINE_RKAIQ_RKISP_DEMO
	depends on BR2_PACKAGE_ROCKCHIP_RGA
	bool "Build rkisp_demo"
	default n
	help
	  Build rkisp_demo

endif
```

## buildroot/package/rockchip/camera-engine-rkisp/Config.in
```kconfig
config BR2_PACKAGE_CAMERA_ENGINE_RKISP
	depends on BR2_PACKAGE_CAMERA_ENGINE
	depends on BR2_PACKAGE_ROCKCHIP_HAS_ISP1
	bool "Rockchip Camera Engine for SoC with ISP1"
	help
	  Rockchip camera engine for SoC with ISP1, e.g.
	  RK3288, RK3399, RK3326, PX30, RK1808 etc.

if BR2_PACKAGE_CAMERA_ENGINE_RKISP
config BR2_PACKAGE_CAMERA_ENGINE_RKISP_3A_SERVICE
	depends on BR2_PACKAGE_CAMERA_ENGINE_RKISP
	bool "Rockchip Camera Engine 3A service run in booting"
	default y
	help
	  Rockchip camera engine 3A service run in booting.

choice
	bool "Specify a directory to store xml speed up bin"
	help
	  Specify a directory to enable xml loading speed up

config BR2_PACKAGE_CAMERA_ENGINE_RKISP_3A_SPEEDUP_DISABLED
	bool "disabled"

config BR2_PACKAGE_CAMERA_ENGINE_RKISP_3A_SPEEDUP_DIR_ETC
	bool "/etc/iqfiles-db"

config BR2_PACKAGE_CAMERA_ENGINE_RKISP_3A_SPEEDUP_DIR_USERDATA
	bool "/userdata/iqfiles-db"

endchoice

config BR2_PACKAGE_CAMERA_ENGINE_RKISP_IQFILE
	depends on BR2_PACKAGE_CAMERA_ENGINE_RKISP
	string "Rockchip Camera Engine IQ xml file"
	default ""
	help
	  Rockchip camera engine for linux.
endif
```

## buildroot/package/rockchip/camera/Config.in
```kconfig
config BR2_PACKAGE_CAMERA
	bool "camera"
	depends on BR2_PACKAGE_QT5
	help
	  Rockchip camera application based on QT
```

## buildroot/package/rockchip/camera_engine_cifisp/Config.in
```kconfig
config BR2_PACKAGE_CAMERA_ENGINE_CIFISP
	bool "Rockchip Camera engine for cifisp"
	help
	  Rockchip camera engine for cifisp.
```

## buildroot/package/rockchip/camera_factory_test_server/Config.in
```kconfig
config BR2_PACKAGE_CAMERA_FACTORY_TEST_SERVER
	bool "CAMERA_FACTORY_TEST_SERVER"
	select BR2_PACKAGE_PROTOBUF
	select BR2_PACKAGE_LIBEVENT
	select BR2_PACKAGE_OPENSSL
```

## buildroot/package/rockchip/carmachine/Config.in
```kconfig
config BR2_PACKAGE_CARMACHINE
	bool "carmachine"
	depends on BR2_PACKAGE_QT5
	help
	  Rockchip carmachine application based on QT
```

## buildroot/package/rockchip/common_algorithm/Config.in
```kconfig
config BR2_PACKAGE_COMMON_ALGORITHM
	bool "rockchip common algorithm"
	help
	  rockchip common algorithm library

if BR2_PACKAGE_COMMON_ALGORITHM

choice
	default BR2_PACKAGE_COMMON_ALGORITHM_32
	prompt "target platform(32bit/64bit)"

config BR2_PACKAGE_COMMON_ALGORITHM_32
	bool "32bit"
	help
	  Use algorithm for 32bit system.

config BR2_PACKAGE_COMMON_ALGORITHM_64
	bool "64bit"
	help
	  Use algorithm for 64bit system.
endchoice

config BR2_PACKAGE_COMMON_ALGORITHM_AEC_ANR_AGC
	bool "RKAP-3A"
	default y
	help
	  Echo cancellation algorithm, applied to voice call scenarios

config BR2_PACKAGE_COMMON_ALGORITHM_ANR
	bool "RKAP-ANR"
	default n
	help
	  Automatic noise reduction algorithm, applied to recording scene

config BR2_PACKAGE_COMMON_ALGORITHM_RKAPPLUS
	bool "RKAP-PLUS"
	default n
	help
	  Audio 3A Algorithm Plus by Rockchip, applied talking scene

config BR2_PACKAGE_COMMON_ALGORITHM_TWO_MIC_BEAMFORM
	bool "beamforming of two mic"
	default n
	help
	  Beamforming algorithm of two mic

config BR2_PACKAGE_COMMON_ALGORITHM_MOVE_DETECT
	bool "move detection"
	default n
	help
	  Move detection algorithm

config BR2_PACKAGE_COMMON_ALGORITHM_OCCLUSION_DETECT
	bool "occlusion detection"
	default n
	help
	  Occlusion detection algorithm
endif
```

## buildroot/package/rockchip/cvr_app/Config.in
```kconfig
config BR2_PACKAGE_CVR_APP
	bool "cvr app"
        select BR2_PACKAGE_LVGL
        select BR2_PACKAGE_RKADK
        select BR2_PACKAGE_RKFSMK
	default n
	help
	  cvr app
```

## buildroot/package/rockchip/cypress_bsa/Config.in
```kconfig
config BR2_PACKAGE_CYPRESS_BSA
    bool "broadcom(cypress) bsa server and app"
    depends on BR2_PACKAGE_RKWIFIBT_VENDOR = "CYPRESS"
    help
	broadcom bsa server and app
```

## buildroot/package/rockchip/dbserver/Config.in
```kconfig
config BR2_PACKAGE_DBSERVER
	bool "rockchip dbserver"
	select BR2_PACKAGE_LIBGDBUS
	select BR2_PACKAGE_LIBRKDB
	help
	  rockchip dbserver

if BR2_PACKAGE_DBSERVER
config BR2_PACKAGE_DBSERVER_SANITIZER_DYNAMIC
	bool "enable dbserver sanitizer tools with dynamic linker"
	select BR2_PACKAGE_ADDRESS_SANITIZER
	help
	  Enable dbserver debug on sanitizer with dynamic linker.

config BR2_PACKAGE_DBSERVER_SANITIZER_STATIC
	bool "enable dbserver sanitizer tools with static linker"
	select BR2_PACKAGE_ADDRESS_SANITIZER
	help
	  Enable dbserver debug on sanitizer with static linker.

config BR2_PACKAGE_DBSERVER_MINILOGGER
	bool "enable dbserver miniloger print"
	select BR2_PACKAGE_MINILOGGER
	default y
	help
	  Enable dbserver miniloger print.
endif
```

## buildroot/package/rockchip/dbtool/Config.in.host
```kconfig
config BR2_PACKAGE_HOST_DBTOOL
	bool "rockchip host dbtool"
	help
		rockchip dbtool to convert between json file and sqlite db file
```

## buildroot/package/rockchip/deviceio/Config.in
```kconfig
config BR2_PACKAGE_DEVICEIO
	bool "basic device io library"
	select BR2_PACKAGE_ALSA_LIB
	select BR2_PACKAGE_BROADCOM_BSA if BR2_PACKAGE_RKWIFIBT_VENDOR = "BROADCOM"
	select BR2_PACKAGE_CYPRESS_BSA if BR2_PACKAGE_RKWIFIBT_VENDOR = "CYPRESS"
	select BR2_PACKAGE_BLUEZ_ALSA if BR2_PACKAGE_RKWIFIBT_VENDOR = "REALTEK"
	select BR2_PACKAGE_BLUEZ5_UTILS if BR2_PACKAGE_RKWIFIBT_VENDOR = "REALTEK"
	select BR2_PACKAGE_BLUEZ5_UTILS_OBEX if BR2_PACKAGE_RKWIFIBT_VENDOR = "REALTEK"
	select BR2_PACKAGE_BLUEZ5_UTILS_CLIENT if BR2_PACKAGE_RKWIFIBT_VENDOR = "REALTEK"
	select BR2_PACKAGE_BLUEZ5_UTILS_EXPERIMENTAL if BR2_PACKAGE_RKWIFIBT_VENDOR = "REALTEK"
	select BR2_PACKAGE_BLUEZ5_PLUGINS_SIXAXIS if BR2_PACKAGE_RKWIFIBT_VENDOR = "REALTEK"
```

## buildroot/package/rockchip/dui/Config.in
```kconfig
config BR2_PACKAGE_DUI
	bool "build dui application"
	select BR2_PACKAGE_DEVICEIO
	select BR2_PACKAGE_OPUS
```

## buildroot/package/rockchip/eptz_demo/Config.in
```kconfig
config BR2_PACKAGE_EPTZ_DEMO
    bool "eptz_demo"

    select BR2_PACKAGE_LIBV4L
    select BR2_PACKAGE_RKMEDIA
    select BR2_PACKAGE_RKMEDIA_MPP
    select BR2_PACKAGE_RKMEDIA_MPP_DECODER
    select BR2_PACKAGE_RKMEDIA_V4L2_CAPTURE
    select BR2_PACKAGE_RKMEDIA_RKRGA
    select BR2_PACKAGE_UVC_APP
    select BR2_PACKAGE_RKNPU
    select BR2_PACKAGE_ROCKX
    select BR2_PACKAGE_ROCKCHIP_RGA
    select BR2_PACKAGE_SDL2
    select BR2_PACKAGE_SDL2_TTF
    select BR2_PACKAGE_SDL2_GFX
```
