## buildroot/package/pm-utils/Config.in
```kconfig
config BR2_PACKAGE_PM_UTILS
	bool "pm-utils"
	help
	  pm-utils provides simple shell command line tools to suspend and
	  hibernate computer that can be used to run vendor, distribution, or
	  user supplied scripts on suspend and resume.

          http://pm-utils.freedesktop.org/wiki/
```

## buildroot/package/procrank_linux/Config.in
```kconfig
config BR2_PACKAGE_PROCRANK_LINUX
	bool "procrank_linux"
	help
	  procrank is a tool commonly used by Android platform
	  developers to find out how much memory is really being used.

	  https://github.com/csimmonds/procrank_linux

if BR2_PACKAGE_PROCRANK_LINUX

config BR2_PACKAGE_PROCRANK_LINUX_STATIC
	bool "Enable static"
	default y if BR2_STATIC_LIBS

endif
```

## buildroot/package/punybench/Config.in
```kconfig
config BR2_PACKAGE_PUNYBENCH
	bool "Punybench"
	help

	Punybench is a collection of micro benchmarks primarily for
	measuring specific file system oprations.

	https://chromium.googlesource.com/chromiumos/platform/punybench/
```

## buildroot/package/python-casttube/Config.in
```kconfig
config BR2_PACKAGE_PYTHON_CASTTUBE
	bool "python-zeroconf"
	help
	  YouTube Chromecast API.

	  https://github.com/ur1katz/casttube
```

## buildroot/package/python-dateutil/Config.in.host
```kconfig
config BR2_PACKAGE_HOST_PYTHON_DATEUTIL
	bool "host-python-dateutil"
	select BR2_PACKAGE_HOST_PYTHON_SIX
	help
	  Extensions to the standard Python datetime module.

	  https://dateutil.readthedocs.org
```

## buildroot/package/python-llvmlite/Config.in
```kconfig
config BR2_PACKAGE_PYTHON_LLVMLITE
	bool "python-llvmlite"
	select BR2_PACKAGE_LLVM
	help
	  A Lightweight LLVM Python Binding for Writing JIT Compilers.

	  http://llvmlite.pydata.org/
```

## buildroot/package/python-mkchromecast/Config.in
```kconfig
config BR2_PACKAGE_PYTHON_MKCHROMECAST
	bool "python-mkchromecast"
	depends on BR2_PACKAGE_PYTHON3
	select BR2_PACKAGE_PYTHON_NETIFACES
	select BR2_PACKAGE_PYTHON_FLASK
	select BR2_PACKAGE_PYTHON_PYQT5
	select BR2_PACKAGE_PYTHON_PSUTIL
	select BR2_PACKAGE_PYTHON_PYCHROMECAST
	help
	  Cast audio/video to your Google Cast devices.

	  https://github.com/muammar/mkchromecast
```

## buildroot/package/python-numba/Config.in
```kconfig
config BR2_PACKAGE_PYTHON_NUMBA
	bool "python-numba"
	select BR2_PACKAGE_PYTHON_LLVMLITE
	select BR2_PACKAGE_PYTHON_NUMPA
	help
	  Numba is an open source JIT compiler that translates a subset
	  of Python and NumPy code into fast machine code.

	  http://numba.pydata.org/
```

## buildroot/package/python-numpy/Config.in.host
```kconfig
config BR2_PACKAGE_HOST_PYTHON_NUMPY
	bool "host-python-numpy"
	help
	  NumPy is the fundamental package for scientific computing
	  with Python.

	  Note that NumPy needs fenv.h fully supported by the
	  C library.

	  http://www.numpy.org/
```

## buildroot/package/python-pychromecast/Config.in
```kconfig
config BR2_PACKAGE_PYTHON_PYCHROMECAST
	bool "python-pychromecast"
    depends on BR2_PACKAGE_PYTHON3
	select BR2_PACKAGE_PYTHON_REQUESTS
	select BR2_PACKAGE_PYTHON_PROTOBUF
	select BR2_PACKAGE_PYTHON_ZEROCONF
	select BR2_PACKAGE_PYTHON_CASTTUBE
	help
	  Library for Python 3 to communicate with the Google Chromecast.

	  https://github.com/balloob/pychromecast
```

## buildroot/package/python-pyyaml/Config.in.host
```kconfig
config BR2_PACKAGE_HOST_PYTHON_PYYAML
	bool "host-python-pyyaml"
	select BR2_PACKAGE_HOST_LIBYAML
	help
	  The PyYAML package contains binding to the libyaml API.

	  http://pyyaml.org/
```

## buildroot/package/qt5/qt5quick3d/Config.in
```kconfig
config BR2_PACKAGE_QT5QUICK3D
	bool "qt5quick3d"
	depends on BR2_PACKAGE_QT5_JSCORE_AVAILABLE # qt5declarative
	depends on BR2_PACKAGE_QT5_GL_AVAILABLE # qt5declarative_quick
	select BR2_PACKAGE_QT5BASE_GUI
	select BR2_PACKAGE_QT5DECLARATIVE
	select BR2_PACKAGE_QT5DECLARATIVE_QUICK
	help
	  Qt is a cross-platform application and UI framework for
	  developers using C++.

	  This package corresponds to the qt5quick3d module.

	  Enable the assimp package to gain the assimp sceneparser
	  plugin.

	  https://doc.qt.io/qt-5/qtquick3d-index.html

comment "qt5quick3d module needs an OpenGL-capable backend"
	depends on BR2_PACKAGE_QT5_JSCORE_AVAILABLE
	depends on !BR2_PACKAGE_QT5_GL_AVAILABLE
```

## buildroot/package/qt5/qt5wayland/Config.in
```kconfig
config BR2_PACKAGE_QT5WAYLAND
	bool "qt5wayland"
	depends on BR2_PACKAGE_WAYLAND
	default y
	help
	  Qt is a cross-platform application and UI framework for
	  developers using C++.

	  This package corresponds to the qt5wayland module.

	  http://qt.io

if BR2_PACKAGE_QT5WAYLAND

config BR2_PACKAGE_QT5WAYLAND_COMPOSITOR
	bool "Enable compositor (experimental)"
	help
	  The compositor API is still experimental, and not built by
	  default.

endif
```

## buildroot/package/retroarch/Config.in
```kconfig
# Libretro cores and retroarch
source "package/retroarch/retroarch/Config.in"

if BR2_PACKAGE_RETROARCH
menu "Retroarch Cores"
	source "package/retroarch/libretro-4do/Config.in"
	source "package/retroarch/libretro-81/Config.in"
	source "package/retroarch/libretro-armsnes/Config.in"
	source "package/retroarch/libretro-beetlelynx/Config.in"
	source "package/retroarch/libretro-beetlengp/Config.in"
	source "package/retroarch/libretro-beetlepcefast/Config.in"
	source "package/retroarch/libretro-beetlepcfx/Config.in"
	source "package/retroarch/libretro-beetlepsx/Config.in"
	source "package/retroarch/libretro-beetlesaturn/Config.in"
	source "package/retroarch/libretro-beetlesupergrafx/Config.in"
	source "package/retroarch/libretro-beetlevb/Config.in"
	source "package/retroarch/libretro-beetlewswan/Config.in"
	source "package/retroarch/libretro-bluemsx/Config.in"
	source "package/retroarch/libretro-bnes/Config.in"
	source "package/retroarch/libretro-bsnes/Config.in"
	source "package/retroarch/libretro-cap32/Config.in"
	source "package/retroarch/libretro-dosbox/Config.in"
	source "package/retroarch/libretro-fbalpha/Config.in"
	source "package/retroarch/libretro-fbalpha2012/Config.in"
	source "package/retroarch/libretro-fceumm/Config.in"
	source "package/retroarch/libretro-fceunext/Config.in"
	source "package/retroarch/libretro-fmsx/Config.in"
	source "package/retroarch/libretro-fuse/Config.in"
	source "package/retroarch/libretro-gambatte/Config.in"
	source "package/retroarch/libretro-gearboy/Config.in"
	source "package/retroarch/libretro-genesisplusgx/Config.in"
	source "package/retroarch/libretro-gpsp/Config.in"
	source "package/retroarch/libretro-gw/Config.in"
	source "package/retroarch/libretro-hatari/Config.in"
	source "package/retroarch/libretro-lutro/Config.in"
	source "package/retroarch/libretro-mame/Config.in"
	source "package/retroarch/libretro-mame2000/Config.in"
	source "package/retroarch/libretro-mame2003/Config.in"
	source "package/retroarch/libretro-mame2003plus/Config.in"
	source "package/retroarch/libretro-mame2010/Config.in"
	source "package/retroarch/libretro-mame2014/Config.in"
	source "package/retroarch/libretro-mame2016/Config.in"
	source "package/retroarch/libretro-meteor/Config.in"
	source "package/retroarch/libretro-mgba/Config.in"
	source "package/retroarch/libretro-mupen64plus/Config.in"
	source "package/retroarch/libretro-nestopia/Config.in"
	source "package/retroarch/libretro-nxengine/Config.in"
	source "package/retroarch/libretro-o2em/Config.in"
	source "package/retroarch/libretro-paralleln64/Config.in"
	source "package/retroarch/libretro-pcsx/Config.in"
	source "package/retroarch/libretro-picodrive/Config.in"
	source "package/retroarch/libretro-ppsspp/Config.in"
	source "package/retroarch/libretro-prboom/Config.in"
	source "package/retroarch/libretro-prosystem/Config.in"
	source "package/retroarch/libretro-quicknes/Config.in"
	source "package/retroarch/libretro-scummvm/Config.in"
	source "package/retroarch/libretro-snes9x/Config.in"
	source "package/retroarch/libretro-snes9x2002/Config.in"
	source "package/retroarch/libretro-snes9x2005/Config.in"
	source "package/retroarch/libretro-snes9x2010/Config.in"
	source "package/retroarch/libretro-stella/Config.in"
	source "package/retroarch/libretro-tgbdual/Config.in"
	source "package/retroarch/libretro-uae/Config.in"
	source "package/retroarch/libretro-vbam/Config.in"
	source "package/retroarch/libretro-vbanext/Config.in"
	source "package/retroarch/libretro-vecx/Config.in"
	source "package/retroarch/libretro-virtualjaguar/Config.in"
endmenu
endif
```

## buildroot/package/retroarch/libretro-4do/Config.in
```kconfig
config BR2_PACKAGE_LIBRETRO_4DO
        bool "libretro-4do"
	depends on BR2_PACKAGE_RETROARCH
	depends on BR2_INSTALL_LIBSTDCPP
        help
          libretro 4do core.

	  http://www.libretro.com

comment "LIBRETRO_4DO needs a toolchain w/ C++"
	depends on !BR2_INSTALL_LIBSTDCPP
```

## buildroot/package/retroarch/libretro-armsnes/Config.in
```kconfig
config BR2_PACKAGE_LIBRETRO_ARMSNES
        bool "libretro-armsnes"
	depends on BR2_PACKAGE_RETROARCH
	depends on BR2_INSTALL_LIBSTDCPP
        help
          libretro armsnes core.

	  http://www.libretro.com

comment "LIBRETRO_ARMSNES needs a toolchain w/ C++"
	depends on !BR2_INSTALL_LIBSTDCPP
```

## buildroot/package/retroarch/libretro-beetlelynx/Config.in
```kconfig
config BR2_PACKAGE_LIBRETRO_BEETLELYNX
        bool "libretro-beetle-lynx"
	depends on BR2_PACKAGE_RETROARCH
	depends on BR2_INSTALL_LIBSTDCPP
        help
          libretro beetle-lynx core.

	  http://www.libretro.com

comment "LIBRETRO_BEETLELYNX needs a toolchain w/ C++"
	depends on !BR2_INSTALL_LIBSTDCPP
```

## buildroot/package/retroarch/libretro-beetlengp/Config.in
```kconfig
config BR2_PACKAGE_LIBRETRO_BEETLENGP
        bool "libretro-beetle-ngp"
	depends on BR2_PACKAGE_RETROARCH
	depends on BR2_INSTALL_LIBSTDCPP
        help
          libretro beetle-ngp core.

	  http://www.libretro.com

comment "LIBRETRO_BEETLENGP needs a toolchain w/ C++"
	depends on !BR2_INSTALL_LIBSTDCPP
```

## buildroot/package/retroarch/libretro-beetlepcefast/Config.in
```kconfig
config BR2_PACKAGE_LIBRETRO_BEETLEPCEFAST
        bool "libretro-beetle-pce-fast"
	depends on BR2_PACKAGE_RETROARCH
	depends on BR2_INSTALL_LIBSTDCPP
        help
          libretro beetle-pce-fast core.

	  http://www.libretro.com

comment "LIBRETRO_BEETLEPCEFAST needs a toolchain w/ C++"
	depends on !BR2_INSTALL_LIBSTDCPP
```

## buildroot/package/retroarch/libretro-beetlepcfx/Config.in
```kconfig
config BR2_PACKAGE_LIBRETRO_BEETLEPCFX
        bool "libretro-beetle-pcfx"
	depends on BR2_PACKAGE_RETROARCH
	depends on BR2_INSTALL_LIBSTDCPP
        help
          libretro beetle-pcfx core.

	  http://www.libretro.com

comment "LIBRETRO_BEETLEPCFX needs a toolchain w/ C++"
	depends on !BR2_INSTALL_LIBSTDCPP
```

## buildroot/package/retroarch/libretro-beetlepsx/Config.in
```kconfig
config BR2_PACKAGE_LIBRETRO_BEETLEPSX
        bool "libretro-beetle-psx"
	depends on BR2_PACKAGE_RETROARCH
	depends on BR2_INSTALL_LIBSTDCPP
        help
          libretro beetle-psx core.

	  http://www.libretro.com

comment "LIBRETRO_BEETLEPSX needs a toolchain w/ C++"
	depends on !BR2_INSTALL_LIBSTDCPP
```

## buildroot/package/retroarch/libretro-beetlesaturn/Config.in
```kconfig
config BR2_PACKAGE_LIBRETRO_BEETLESATURN
        bool "libretro-beetlesaturn"
	depends on BR2_PACKAGE_RETROARCH
	depends on BR2_INSTALL_LIBSTDCPP
        help
          libretro beetle saturn core.

	  http://www.libretro.com

comment "LIBRETRO_BEETLESATURN needs a toolchain w/ C++"
	depends on !BR2_INSTALL_LIBSTDCPP
```

## buildroot/package/retroarch/libretro-beetlesupergrafx/Config.in
```kconfig
config BR2_PACKAGE_LIBRETRO_BEETLESUPERGRAFX
        bool "libretro-beetle-supergrafx"
	depends on BR2_PACKAGE_RETROARCH
	depends on BR2_INSTALL_LIBSTDCPP
        help
          libretro beetle-supergrafx core.

	  http://www.libretro.com

comment "LIBRETRO_BEETLESUPERGRAFX needs a toolchain w/ C++"
	depends on !BR2_INSTALL_LIBSTDCPP
```

## buildroot/package/retroarch/libretro-beetlevb/Config.in
```kconfig
config BR2_PACKAGE_LIBRETRO_BEETLEVB
        bool "libretro-beetlevb"
	depends on BR2_PACKAGE_RETROARCH
	depends on BR2_INSTALL_LIBSTDCPP
        help
          libretro beetlevb core.

	  http://www.libretro.com

comment "LIBRETRO_BEETLEVB needs a toolchain w/ C++"
	depends on !BR2_INSTALL_LIBSTDCPP
```

## buildroot/package/retroarch/libretro-beetlewswan/Config.in
```kconfig
config BR2_PACKAGE_LIBRETRO_BEETLEWSWAN
        bool "libretro-beetlewswan"
	depends on BR2_PACKAGE_RETROARCH
	depends on BR2_INSTALL_LIBSTDCPP
        help
          libretro beetlewswan core.

	  http://www.libretro.com

comment "LIBRETRO_BEETLEWSWAN needs a toolchain w/ C++"
	depends on !BR2_INSTALL_LIBSTDCPP
```
