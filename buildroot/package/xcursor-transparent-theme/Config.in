## buildroot/package/xcursor-transparent-theme/Config.in
```kconfig
config BR2_PACKAGE_XCURSOR_TRANSPARENT_THEME
	bool "xcursor-transparent-theme"
	help
	  Completely transparent theme for hiding the X11 cursor.

	  No upstream site.
```

## device/rockchip/.chips/rk3566_rk3568/zboot.its
```
/*
 * Copyright (C) 2020 Rockchip Electronics Co., Ltd
 *
 * SPDX-License-Identifier: GPL-2.0
 */

/dts-v1/;
/ {
    description = "U-Boot FIT source file for arm";

    images {
        fdt {
            data = /incbin/("@KERNEL_DTB@");
            type = "flat_dt";
            arch = "arm64";
            compression = "none";
            load = <0xffffff00>;

            hash {
                algo = "sha256";
            };
        };

        kernel {
            data = /incbin/("@KERNEL_IMG@");
            type = "kernel";
            arch = "arm64";
            os = "linux";
            compression = "lz4";
            entry = <0xffffff01>;
            load = <0xffffff01>;

            hash {
                algo = "sha256";
            };
        };

        resource {
            data = /incbin/("@RESOURCE_IMG@");
            type = "multi";
            arch = "arm64";
            compression = "none";

            hash {
                algo = "sha256";
            };
        };
    };

    configurations {
        default = "conf";

        conf {
            rollback-index = <0x00>;
            fdt = "fdt";
            kernel = "kernel";
            multi = "resource";

            signature {
                algo = "sha256,rsa2048";
                padding = "pss";
                key-name-hint = "dev";
                sign-images = "fdt", "kernel", "multi";
            };
        };
    };
};
```

## device/rockchip/common/configs/Config.in
```kconfig
#

mainmenu "Rockchip Linux SDK Configuration"

config RK_DEFCONFIG_FROM_ENV
	string
	option env="RK_DEFCONFIG"

config RK_DEFCONFIG
	string "Location to save defconfig"
	default RK_DEFCONFIG_FROM_ENV if RK_DEFCONFIG_FROM_ENV != ""
	default "defconfig"
	help
	  When running 'make savedefconfig', the defconfig file will be
	  saved in this location.

config RK_CHIP_FAMILY_FROM_ENV
	string
	option env="RK_CHIP_FAMILY"

config RK_CHIP_FAMILY
	string "SoC family"
	default RK_CHIP_FAMILY_FROM_ENV if RK_CHIP_FAMILY_FROM_ENV != ""
	help
	  Rockchip SoC family, available chip familys are in
	  <SDK>/device/rockchip/.

config RK_CHIP_FROM_ENV
	string
	option env="RK_CHIP"

config RK_CHIP
	string "SoC"
	default RK_CHIP_FROM_ENV if RK_CHIP_FROM_ENV != ""
	default RK_CHIP_FAMILY
	help
	  Rockchip SoC.

source "Config.in.rootfs"
source "Config.in.loader"
source "Config.in.kernel"
source "Config.in.boot"
source "Config.in.recovery"
source "Config.in.pcba"
source "Config.in.security"
source "Config.in.extra-part"
source "Config.in.firmware"
source "Config.in.update"
source "Config.in.others"
```

## device/rockchip/rk3308/yocto/build/conf/bblayers.conf
```bitbake
# POKY_BBLAYERS_CONF_VERSION is increased each time build/conf/bblayers.conf
# changes incompatibly
POKY_BBLAYERS_CONF_VERSION = "2"

BBPATH = "${TOPDIR}"
BBFILES ?= ""

BBLAYERS ?= " \
  ${TOPDIR}/../meta \
  ${TOPDIR}/../meta-poky \
  ${TOPDIR}/../meta-yocto-bsp \
  ${TOPDIR}/../meta-ros \
  ${TOPDIR}/../meta-rockchip \
  ${TOPDIR}/../meta-openembedded/meta-filesystems \
  ${TOPDIR}/../meta-openembedded/meta-oe \
  ${TOPDIR}/../meta-openembedded/meta-perl \
  ${TOPDIR}/../meta-openembedded/meta-python \
  ${TOPDIR}/../meta-openembedded/meta-multimedia \
  ${TOPDIR}/../meta-openembedded/meta-networking \
  ${TOPDIR}/../meta-openembedded/meta-webserver \
  "
```

## kernel/drivers/rongpin/Kconfig
```kconfig
menu "rongpin support"

config RP_POWER
	tristate "rongpin power_ctrl support"
	default y
	help 
		rp_power_ctrl

config RP_GPIO
	default y
	tristate "rongpin rp gpio_ctl support"

config RP_STM706
        tristate "rongpin rp stm706 support"
        default y

config RP_FAN
        default y
        tristate "rongpin rp fan_ctl support"
endmenu
```

## yocto/build/conf/bblayers.conf
```bitbake
# POKY_BBLAYERS_CONF_VERSION is increased each time build/conf/bblayers.conf
# changes incompatibly
POKY_BBLAYERS_CONF_VERSION = "2"

BBPATH = "${TOPDIR}"
BBFILES ?= ""

BBLAYERS ?= " \
  ${TOPDIR}/../meta-openembedded/meta-oe \
  ${TOPDIR}/../meta-openembedded/meta-python \
  ${TOPDIR}/../meta-qt5 \
  ${TOPDIR}/../meta-clang \
  ${TOPDIR}/../meta-rockchip \
  ${TOPDIR}/../poky/meta \
  ${TOPDIR}/../poky/meta-poky \
  ${TOPDIR}/../poky/meta-yocto-bsp \
"

BBLAYERS:append = " ${TOPDIR}/../meta-browser${@'/meta-chromium' if os.path.exists('${TOPDIR}/../meta-browser/meta-chromium') else ''}"
```
