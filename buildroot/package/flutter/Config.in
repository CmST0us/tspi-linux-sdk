## buildroot/package/flutter/Config.in
```kconfig
menu "Flutter"
	source "package/flutter/flutter-engine/Config.in"
	source "package/flutter/flutter-wayland/Config.in"
endmenu
```

## buildroot/package/flutter/flutter-engine/Config.in
```kconfig
config BR2_PACKAGE_FLUTTER_ENGINE
	bool "Flutter engine"
	depends on BR2_aarch64 || (BR2_ARM_EABIHF && BR2_arm)
	depends on BR2_TOOLCHAIN_GCC_AT_LEAST_9
	help
	  Flutter engine. Prebuilt from yocto's meta-flutter.

	  https://github.com/flutter/engine
```

## buildroot/package/flutter/flutter-wayland/Config.in
```kconfig
config BR2_PACKAGE_FLUTTER_WAYLAND
	bool "Flutter wayland"
	depends on BR2_PACKAGE_FLUTTER_ENGINE
	depends on BR2_PACKAGE_HAS_LIBEGL
	depends on BR2_PACKAGE_WAYLAND
	select BR2_PACKAGE_LIBXKBCOMMON
	select BR2_PACKAGE_RAPIDJSON
	select BR2_PACKAGE_WAYLANDPP
	help
	  A Flutter Embedder that talks to Wayland directly.

	  https://github.com/chinmaygarde/flutter_wayland
```

## buildroot/package/frecon/Config.in
```kconfig
config BR2_PACKAGE_FRECON
	bool "frecon"
	depends on BR2_INSTALL_LIBSTDCPP
	depends on BR2_PACKAGE_HAS_UDEV
	select BR2_PACKAGE_LIBDRM
	select BR2_PACKAGE_LIBPNG
	select BR2_PACKAGE_LIBTSM
	help
	  This is a terminal emulator that replaces the kernel Virtual
	  Terminal (VT) console.  It uses the Kernel Mode Setting (KMS)
	  support in the kernel.  It is similar to the kmscon project:
            https://www.freedesktop.org/wiki/Software/kmscon

if BR2_PACKAGE_FRECON

config BR2_PACKAGE_FRECON_USE_GETTY
	bool "use getty"
	default n if BR2_TARGET_SERIAL_SHELL_SH

config BR2_PACKAGE_FRECON_VTS
	bool "enable vts"
	default y

config BR2_PACKAGE_FRECON_VT1
	bool "enable vt1"
	default y if !BR2_PACKAGE_WESTON && !BR2_PACKAGE_XORG7

config BR2_PACKAGE_FRECON_ROTATE
	int
	default 90 if BR2_PACKAGE_FRECON_ROTATE_90
	default 180 if BR2_PACKAGE_FRECON_ROTATE_180
	default 270 if BR2_PACKAGE_FRECON_ROTATE_270

choice
        prompt "frecon rotate"
        default BR2_PACKAGE_FRECON_ROTATE_0

config BR2_PACKAGE_FRECON_ROTATE_0
        bool "0"

config BR2_PACKAGE_FRECON_ROTATE_90
        bool "90"

config BR2_PACKAGE_FRECON_ROTATE_180
        bool "180"

config BR2_PACKAGE_FRECON_ROTATE_270
        bool "270"

endchoice

config BR2_PACKAGE_FRECON_SCALE
	int "frecon scale"
	range 1 100

endif
```

## buildroot/package/gl4es/Config.in
```kconfig
config BR2_PACKAGE_GL4ES
	bool "gl4es"
	depends on BR2_PACKAGE_HAS_LIBEGL
	depends on BR2_PACKAGE_HAS_LIBGLES
	help
	  GL4ES is a OpenGL 2.1/1.5 to GL ES 2.0/1.1 translation library.

	  https://github.com/ptitSeb/gl4es
```

## buildroot/package/glibc/Config.in
```kconfig
if BR2_TOOLCHAIN_BUILDROOT_GLIBC

comment "Glibc Options"

config BR2_PACKAGE_GLIBC
	bool
	default y
	select BR2_PACKAGE_LINUX_HEADERS
	select BR2_TOOLCHAIN_HAS_SSP if BR2_PACKAGE_HOST_BINUTILS_SUPPORTS_CFI
	help
	  https://www.gnu.org/software/libc/

choice
        prompt "glibc version"
        default BR2_PACKAGE_GLIBC_LATEST

config BR2_PACKAGE_GLIBC_LATEST
        bool "glibc latest"

config BR2_PACKAGE_GLIBC_2_29
        bool "glibc 2.29"

endchoice

config BR2_PACKAGE_GLIBC_KERNEL_COMPAT
	bool "Enable compatibiltiy shims to run on older kernels"
	help
	  Say 'y' here if you plan on running your system on a kernel
	  older than the version used for the toolchain headers.

	  Enabling those compatibility shims may generate a slightly
	  bigger and slightly slower glibc library.

	  The oldest supported kernel version depends on the
	  architecture.

config BR2_PACKAGE_GLIBC_UTILS
	bool "Install glibc utilities"
	help
	  Enabling this option will compile and install the getconf,
	  ldconfig, ldd and locale glibc utilities for the target.

config BR2_PACKAGE_GLIBC_GEN_LD_CACHE
	bool "glibc gen ld.so.cache"
	default y
	depends on BR2_PACKAGE_HOST_QEMU
	depends on BR2_PACKAGE_HOST_QEMU_LINUX_USER_MODE

endif # BR2_TOOLCHAIN_BUILDROOT_GLIBC
```

## buildroot/package/gmp/Config.in
```kconfig
config BR2_PACKAGE_GMP
	bool "gmp"
	help
	  GNU Multiple Precision Arithmetic Library.

	  http://gmplib.org/

if BR2_PACKAGE_GMP

config BR2_PACKAGE_GMP_STATIC
	bool "Enable static"
	default y if BR2_STATIC_LIBS

endif
```

## buildroot/package/gstreamer1/gst1-devtools/Config.in
```kconfig
if BR2_PACKAGE_GSTREAMER1_18
source "package/gstreamer1/gst1-devtools/1.18.5/Config.in"
endif

if BR2_PACKAGE_GSTREAMER1_20
source "package/gstreamer1/gst1-devtools/1.20.0/Config.in"
endif
```

## buildroot/package/ifuse/Config.in
```kconfig
config BR2_PACKAGE_IFUSE
	bool "ifuse"
	select BR2_PACKAGE_LIBFUSE
	select BR2_PACKAGE_LIBIMOBILEDEVICE
	help
	  A fuse filesystem implementation to access the contents of iOS devices.

	  http://www.libimobiledevice.org/
```

## buildroot/package/intel-wds/Config.in
```kconfig
config BR2_PACKAGE_INTEL_WDS
	bool "intel-wds"
	select BR2_PACKAGE_LIBGLIB2
	select BR2_PACKAGE_GSTREAMER1
	select BR2_PACKAGE_CONNMAN
	select BR2_PACKAGE_CONNMAN_WIFI
	select BR2_PACKAGE_CONNMAN_CLIENT
	select BR2_PACKAGE_WPA_SUPPLICANT
	select BR2_PACKAGE_WPA_SUPPLICANT_AP_SUPPORT
	select BR2_PACKAGE_WPA_SUPPLICANT_DBUS_NEW
	select BR2_PACKAGE_WPA_SUPPLICANT_WIFI_DISPLAY
	help
	  Wireless Display Software For Linux OS (WDS).

	  https://github.com/intel/wds
```

## buildroot/package/jwm/Config.in
```kconfig
config BR2_PACKAGE_JWM
	bool "JWM (Joe's Window Manager)"
	depends on BR2_PACKAGE_XORG7
	select BR2_PACKAGE_XLIB_LIBX11
	help
	  JWM is a light-weight window manager for the X11 Window System.

	  http://joewing.net/projects/jwm/
```

## buildroot/package/kmscube/Config.in
```kconfig
config BR2_PACKAGE_KMSCUBE
	bool "kmscube"
	depends on BR2_PACKAGE_HAS_LIBGBM
	help
	  kmscube is an application to test kms/drm drivers.

	  https://cgit.freedesktop.org/mesa/kmscube/
```

## buildroot/package/libarm-memhook/Config.in
```kconfig
config BR2_PACKAGE_LIBARM_MEMHOOK
	bool "libarm-memhook"
	depends on BR2_arm && BR2_ARM_CPU_HAS_NEON
	help
	  A hook library for armv7-neon memcpy and memmove.

	  Based on glibc-2.34.

if BR2_PACKAGE_LIBARM_MEMHOOK
config BR2_PACKAGE_LIBARM_MEMHOOK_PRELOAD
	bool "preload"
	depends on !BR2_STATIC_LIBS
endif
```

## buildroot/package/libasio/Config.in
```kconfig
config BR2_PACKAGE_LIBASIO
	bool "libasio"
	depends on BR2_INSTALL_LIBSTDCPP
	depends on BR2_USE_MMU # fork()
	depends on BR2_USE_WCHAR
	depends on BR2_TOOLCHAIN_SUPPORTS_ALWAYS_LOCKFREE_ATOMIC_INTS
	depends on !BR2_TOOLCHAIN_HAS_GCC_BUG_64735 # exception_ptr
	help
	  Asio is a cross-platform C++ library for network and low-level
	  I/O programming that provides developers with a consistent
	  asynchronous model using a modern C++ approach.

	  This is a standalone library that does not require Boost.

	  https://github.com/chriskohlhoff/asio

comment "libasio needs a toolchain w/ C++, dynamic library, wchar"
	depends on BR2_USE_MMU
	depends on BR2_TOOLCHAIN_SUPPORTS_ALWAYS_LOCKFREE_ATOMIC_INTS
	depends on !BR2_INSTALL_LIBSTDCPP || !BR2_USE_WCHAR

comment "libasio needs exception_ptr"
	depends on BR2_TOOLCHAIN_HAS_GCC_BUG_64735
```

## buildroot/package/libcamera/Config.in
```kconfig
config BR2_PACKAGE_LIBCAMERA_ARCH_SUPPORTS
	bool
	default y
	# Invalid packing size of ControlValue struct on m68k
	depends on !BR2_m68k
	depends on !BR2_TOOLCHAIN_HAS_BINUTILS_BUG_27597

menuconfig BR2_PACKAGE_LIBCAMERA
	bool "libcamera"
	depends on BR2_PACKAGE_LIBCAMERA_ARCH_SUPPORTS
	depends on BR2_INSTALL_LIBSTDCPP
	depends on BR2_TOOLCHAIN_HAS_THREADS
	depends on BR2_TOOLCHAIN_GCC_AT_LEAST_8 # C++17
	depends on !BR2_STATIC_LIBS # gnutls
	depends on BR2_USE_WCHAR # gnutls
	select BR2_PACKAGE_GNUTLS
	select BR2_PACKAGE_LIBYAML
	select BR2_PACKAGE_LIBCAMERA_PIPELINE_UVCVIDEO if !BR2_PACKAGE_LIBCAMERA_HAS_PIPELINE
	help
	  libcamera provides a software stack to support
	  complex devices that need heavy hardware image
	  processing operations.

	  http://www.libcamera.org/

if BR2_PACKAGE_LIBCAMERA

config BR2_PACKAGE_LIBCAMERA_V4L2
	bool "libcamera v4l2 compatibility layer"
	default y
	help
	  libcamera v4l2 compatibility layer

config BR2_PACKAGE_LIBCAMERA_GST
	bool "libcamera gstreamer compatibility layer"
	depends on BR2_PACKAGE_GST1_PLUGINS_BASE
	select BR2_PACKAGE_LIBGLIB2
	default y
	help
	  libcamera gstreamer compatibility layer

config BR2_PACKAGE_LIBCAMERA_HAS_PIPELINE
	bool

config BR2_PACKAGE_LIBCAMERA_PIPELINE_IPU3
	bool "ipu3 pipeline"
	depends on BR2_i386 || BR2_x86_64
	select BR2_PACKAGE_LIBCAMERA_HAS_PIPELINE
	help
	  Pipeline for Intel IPU3.

config BR2_PACKAGE_LIBCAMERA_PIPELINE_RASPBERRYPI
	bool "raspberrypi pipeline"
	depends on BR2_arm || BR2_aarch64
	depends on BR2_USE_WCHAR # boost (already enforced for gnutls)
	select BR2_PACKAGE_BOOST
	select BR2_PACKAGE_LIBCAMERA_HAS_PIPELINE
	help
	  Pipeline for Raspberry Pi devices.

config BR2_PACKAGE_LIBCAMERA_PIPELINE_RKISP1
	bool "rkisp1 pipeline"
	depends on BR2_arm || BR2_aarch64
	select BR2_PACKAGE_LIBCAMERA_HAS_PIPELINE
	help
	  Pipeline for Rockchip ISP1.

config BR2_PACKAGE_LIBCAMERA_PIPELINE_SIMPLE
	bool "simple pipeline"
	select BR2_PACKAGE_LIBCAMERA_HAS_PIPELINE
	help
	  Pipeline for simple pipelines.

config BR2_PACKAGE_LIBCAMERA_PIPELINE_UVCVIDEO
	bool "uvcvideo pipeline"
	help
	  Pipeline for uvcvideo devices.

config BR2_PACKAGE_LIBCAMERA_PIPELINE_VIMC
	bool "vimc pipeline"
	select BR2_PACKAGE_LIBCAMERA_HAS_PIPELINE
	help
	  Pipeline for the vimc device.

config BR2_PACKAGE_LIBCAMERA_PIPELINE_CUSTOM
	bool "custom pipeline"
	select BR2_PACKAGE_LIBCAMERA_HAS_PIPELINE
	default y
	help
	  Pipeline for custom device.

if BR2_PACKAGE_LIBCAMERA_PIPELINE_CUSTOM

config BR2_PACKAGE_LIBCAMERA_CUSTOM_DRIVERS
	string "custom pipeline drivers"
	default "has:rkisp"

config BR2_PACKAGE_LIBCAMERA_CUSTOM_DEFAULT_ENTITY
	string "custom pipeline default media entity"
	default "has:mainpath"

config BR2_PACKAGE_LIBCAMERA_CUSTOM_FORMAT
	string "custom pipeline pixel format"
	default "NV12"
	help
	  NV12|YUV420|NV16|YUYV|ANY

config BR2_PACKAGE_LIBCAMERA_CUSTOM_BUFFER_COUNT
	int "custom pipeline buffer count"
	default 4

endif

config BR2_PACKAGE_LIBCAMERA_COMPLIANCE
	bool "lc-compliance test application"
	depends on BR2_USE_WCHAR # gtest
	depends on BR2_TOOLCHAIN_HAS_THREADS # gtest
	depends on BR2_INSTALL_LIBSTDCPP # gtest
	depends on BR2_TOOLCHAIN_GCC_AT_LEAST_5 # gtest
	depends on BR2_USE_MMU # gtest
	select BR2_PACKAGE_GTEST
	select BR2_PACKAGE_LIBEVENT
	help
	  lc-compliance test application

comment "lc-compliance test application needs a toolchain w/ C++, wchar, threads, gcc >= 5"
	depends on BR2_USE_MMU
	depends on !BR2_USE_WCHAR || !BR2_TOOLCHAIN_HAS_THREADS || \
		!BR2_INSTALL_LIBSTDCPP || !BR2_TOOLCHAIN_GCC_AT_LEAST_5

endif # BR2_PACKAGE_LIBCAMERA

comment "libcamera needs a toolchain w/ C++, threads, wchar, dynamic library, gcc >= 8"
	depends on BR2_PACKAGE_LIBCAMERA_ARCH_SUPPORTS
	depends on !BR2_INSTALL_LIBSTDCPP || !BR2_TOOLCHAIN_HAS_THREADS || \
		!BR2_TOOLCHAIN_GCC_AT_LEAST_8 || BR2_STATIC_LIBS || !BR2_USE_WCHAR
```

## buildroot/package/libdrm-cursor/Config.in
```kconfig
config BR2_PACKAGE_LIBDRM_CURSOR
	bool "A hook of drm cursor APIs to fake cursor plane."
	depends on BR2_PACKAGE_LIBDRM
	depends on BR2_PACKAGE_HAS_LIBGBM
	help
	  A hook of drm cursor APIs to fake cursor plane.
```

## buildroot/package/libimobiledevice-glue/Config.in
```kconfig
config BR2_PACKAGE_LIBIMOBILEDEVICE_GLUE
	bool "libimobiledevice-glue"
	select BR2_PACKAGE_LIBPLIST
	help
	  Library with common code used by the libraries and tools around
	  the libimobiledevice project.

	  http://www.libimobiledevice.org/
```

## buildroot/package/libimobiledevice/Config.in
```kconfig
config BR2_PACKAGE_LIBIMOBILEDEVICE
	bool "libimobiledevice"
	select BR2_PACKAGE_LIBIMOBILEDEVICE_GLUE
	select BR2_PACKAGE_LIBUSBMUXD
	help
	  A library to communicate with services on iOS devices using
	  native protocols.

	  http://www.libimobiledevice.org/
```

## buildroot/package/libsrt/Config.in
```kconfig
config BR2_PACKAGE_LIBSRT
	bool "libsrt"
	help
	  Secure Reliable Transport (SRT) Protocol.

	  https://github.com/Haivision/srt
```

## buildroot/package/libtsm/Config.in
```kconfig
menuconfig BR2_PACKAGE_LIBTSM
	bool "libtsm"
	select BR2_PACKAGE_LIBXKBCOMMON
	help
		TSM is a state machine for DEC VT100-VT520
		compatible terminal emulators. It tries to
		support all common standards while keeping
		compatibility to existing emulators.

		https://github.com/Aetf/libtsm
```

## buildroot/package/libusbmuxd/Config.in
```kconfig
config BR2_PACKAGE_LIBUSBMUXD
	bool "libusbmuxd"
	select BR2_PACKAGE_LIBPLIST
	help
	  A client library for applications to handle usbmux protocol
	  connections with iOS devices.

	  http://www.libimobiledevice.org/
```

## buildroot/package/libusrsctp/Config.in
```kconfig
config BR2_PACKAGE_LIBUSRSCTP
	bool "userland SCTP stack"
	help
	  A portable SCTP userland stack

	  https://github.com/sctplab/usrsctp
```

## buildroot/package/libyaml/Config.in.host
```kconfig
config BR2_PACKAGE_HOST_LIBYAML
	bool "host libyaml"
	help
	  LibYAML is a YAML 1.1 parser and emitter written in C.

	  http://pyyaml.org/wiki/LibYAML
```

## buildroot/package/linux-headers/Config.in
```kconfig
config BR2_PACKAGE_LINUX_HEADERS
	bool

if BR2_PACKAGE_LINUX_HEADERS

config BR2_PACKAGE_LINUX_HEADERS_AUTO_VERSION
	bool "auto detect header version"
	default y

endif
```
